#include <string.h>
#include "game.h"
#include "Color.h"


//Player Vars
#define INIT_X 42 //Mario initial X
#define INIT_Y 16 //Mario inital Y
#define MIN_X 42 //Minimum screen x value
#define MAX_X 3392 //Maximum screen x value
#define SCREEN_W 160
#define SCREEN_H 128
#define REFRESH 10
//Entity Vars
#define NUM_ENEMIES 10
#define NUM_BLOCKS 293
#define NUM_SCENERY 136
#define NUM_SHROOMS 8
//Scenery & Blocks
#define FLOAT 48 //Block float height
#define SCENERY_REPEAT_OFFSET 768 //X pixel value for scenery repeat
#define FLAG_X_OFFSET -64 //X offset between flag and castle
#define CASTLE_X 3232
//World
#define GRAVITY 2
#define JOYSTICK_BUFFER 250
#define JOYSTICK_THRESHOLD 0x7F5
#define POLE_SLIDE_SPEED 4
//Enemies
#define GOOMBA_SPEED 2
#define GOOMBA_LINGER 4

const unsigned char base_block_pixels[] = {
 BROWN, BLACK, BLACK, BLACK, BLACK, BLACK, BLACK, BROWN, PEACH, BLACK, BLACK, BLACK, BLACK, BLACK, BLACK, BROWN,
 PEACH, BROWN, BROWN, BROWN, BROWN, BROWN, BROWN, BLACK, PEACH, BROWN, BROWN, BROWN, BROWN, BROWN, BLACK, BLACK,
 PEACH, BROWN, BROWN, BROWN, PEACH, PEACH, PEACH, BLACK, PEACH, BROWN, BROWN, BROWN, BROWN, BROWN, BROWN, BLACK,
 PEACH, BROWN, PEACH, PEACH, BLACK, BLACK, BLACK, BLACK, PEACH, BROWN, BROWN, BROWN, BROWN, BROWN, BROWN, BLACK,
 PEACH, PEACH, BLACK, BLACK, BROWN, BROWN, BROWN, BROWN, BLACK, PEACH, BROWN, BROWN, BROWN, BROWN, BROWN, BLACK,
 BLACK, BLACK, BROWN, BROWN, BROWN, BROWN, BROWN, BROWN, BLACK, PEACH, BROWN, BROWN, BROWN, BROWN, BROWN, BLACK,
 PEACH, BROWN, BROWN, BROWN, BROWN, BROWN, BROWN, BROWN, BROWN, BLACK, PEACH, BROWN, BROWN, BROWN, BROWN, BLACK,
 PEACH, BROWN, BROWN, BROWN, BROWN, BROWN, BROWN, BROWN, BROWN, BLACK, PEACH, BROWN, BROWN, BROWN, BROWN, BLACK,
 PEACH, BROWN, BROWN, BROWN, BROWN, BROWN, BROWN, BROWN, BROWN, BLACK, PEACH, BROWN, BROWN, BROWN, BROWN, BLACK,
 PEACH, BROWN, BROWN, BROWN, BROWN, BROWN, BROWN, BROWN, BROWN, BLACK, PEACH, PEACH, PEACH, PEACH, PEACH, BLACK,
 PEACH, BROWN, BROWN, BROWN, BROWN, BROWN, BROWN, BROWN, BROWN, BLACK, BROWN, BLACK, BLACK, BLACK, BLACK, BROWN,
 PEACH, BROWN, BROWN, BROWN, BROWN, BROWN, BROWN, BROWN, BROWN, BLACK, PEACH, BLACK, BROWN, BROWN, BROWN, BLACK,
 PEACH, BROWN, BROWN, BROWN, BROWN, BROWN, BROWN, BROWN, BROWN, BLACK, PEACH, BROWN, BROWN, BROWN, BROWN, BLACK,
 PEACH, BROWN, BROWN, BROWN, BROWN, BROWN, BROWN, BROWN, BROWN, BLACK, PEACH, BROWN, BROWN, BROWN, BROWN, BLACK,
 PEACH, BROWN, BROWN, BROWN, BROWN, BROWN, BROWN, BROWN, BROWN, BLACK, PEACH, BROWN, BROWN, BROWN, BROWN, BLACK,
 BROWN, PEACH, PEACH, PEACH, PEACH, PEACH, PEACH, PEACH, PEACH, BLACK, BROWN, PEACH, PEACH, PEACH, PEACH, BROWN,
};
const unsigned char brick_block_pixels[] = {
 BLACK, BLACK, BLACK, BLACK, BLACK, BLACK, BLACK, BLACK, BLACK, BLACK, BLACK, BLACK, BLACK, BLACK, BLACK, BLACK,
 BROWN, BROWN, BROWN, BLACK, BROWN, BROWN, BROWN, BROWN, BROWN, BROWN, BROWN, BLACK, BROWN, BROWN, BROWN, BROWN,
 BROWN, BROWN, BROWN, BLACK, BROWN, BROWN, BROWN, BROWN, BROWN, BROWN, BROWN, BLACK, BROWN, BROWN, BROWN, BROWN,
 BROWN, BROWN, BROWN, BLACK, BROWN, BROWN, BROWN, BROWN, BROWN, BROWN, BROWN, BLACK, BROWN, BROWN, BROWN, BROWN,
 BLACK, BLACK, BLACK, BLACK, BLACK, BLACK, BLACK, BLACK, BLACK, BLACK, BLACK, BLACK, BLACK, BLACK, BLACK, BLACK,
 BROWN, BROWN, BROWN, BROWN, BROWN, BROWN, BROWN, BLACK, BROWN, BROWN, BROWN, BROWN, BROWN, BROWN, BROWN, BLACK,
 BROWN, BROWN, BROWN, BROWN, BROWN, BROWN, BROWN, BLACK, BROWN, BROWN, BROWN, BROWN, BROWN, BROWN, BROWN, BLACK,
 BROWN, BROWN, BROWN, BROWN, BROWN, BROWN, BROWN, BLACK, BROWN, BROWN, BROWN, BROWN, BROWN, BROWN, BROWN, BLACK,
 BLACK, BLACK, BLACK, BLACK, BLACK, BLACK, BLACK, BLACK, BLACK, BLACK, BLACK, BLACK, BLACK, BLACK, BLACK, BLACK,
 BROWN, BROWN, BROWN, BLACK, BROWN, BROWN, BROWN, BROWN, BROWN, BROWN, BROWN, BLACK, BROWN, BROWN, BROWN, BROWN,
 BROWN, BROWN, BROWN, BLACK, BROWN, BROWN, BROWN, BROWN, BROWN, BROWN, BROWN, BLACK, BROWN, BROWN, BROWN, BROWN,
 BROWN, BROWN, BROWN, BLACK, BROWN, BROWN, BROWN, BROWN, BROWN, BROWN, BROWN, BLACK, BROWN, BROWN, BROWN, BROWN,
 BLACK, BLACK, BLACK, BLACK, BLACK, BLACK, BLACK, BLACK, BLACK, BLACK, BLACK, BLACK, BLACK, BLACK, BLACK, BLACK,
 BROWN, BROWN, BROWN, BROWN, BROWN, BROWN, BROWN, BLACK, BROWN, BROWN, BROWN, BROWN, BROWN, BROWN, BROWN, BLACK,
 BROWN, BROWN, BROWN, BROWN, BROWN, BROWN, BROWN, BLACK, BROWN, BROWN, BROWN, BROWN, BROWN, BROWN, BROWN, BLACK,
 PEACH, PEACH, PEACH, PEACH, PEACH, PEACH, PEACH, PEACH, PEACH, PEACH, PEACH, PEACH, PEACH, PEACH, PEACH, PEACH,
};
const unsigned char bush_base_pixels[] = {
 BLACK, GREEN, GREEN, GREEN, GREEN, GREEN, GREEN, GREEN, GREEN, GREEN, GREEN, GREEN, GREEN, GREEN, GREEN, GREEN,
 GREEN, GREEN, GREEN, GREEN, GREEN, GREEN, GREEN, GREEN, GREEN, GREEN, GREEN, GREEN, GREEN, GREEN, GREEN, GREEN,
 GREEN, GREEN, GREEN, GREEN, GREEN, GREEN, GREEN, GREEN, GREEN, GREEN, GREEN, GREEN, GREEN, GREEN, GREEN, GREEN,
 GREEN, GREEN, GREEN, GREEN, GREEN, GREEN, GREEN, GREEN, GREEN, GREEN, GREEN, GREEN, GREEN, GREEN, GREEN, GREEN,
 GREEN, GREEN, GREEN, GREEN, GREEN, GREEN, GREEN, GREEN, GREEN, GREEN, GREEN, GREEN, GREEN, GREEN, GREEN, BLACK,
 SKY, BLACK, GREEN, GREEN, GREEN, GREEN, GREEN, GREEN, GREEN, GREEN, GREEN, GREEN, GREEN, GREEN, GREEN, GREEN,
 GREEN, GREEN, GREEN, GREEN, GREEN, GREEN, GREEN, GREEN, GREEN, GREEN, GREEN, GREEN, GREEN, GREEN, GREEN, GREEN,
 GREEN, GREEN, GREEN, GREEN, GREEN, GREEN, GREEN, GREEN, GREEN, GREEN, GREEN, GREEN, GREEN, GREEN, GREEN, GREEN,
 GREEN, GREEN, GREEN, GREEN, GREEN, GREEN, GREEN, GREEN, GREEN, GREEN, GREEN, GREEN, GREEN, GREEN, GREEN, GREEN,
 GREEN, GREEN, GREEN, GREEN, GREEN, GREEN, GREEN, GREEN, GREEN, GREEN, GREEN, GREEN, GREEN, GREEN, BLACK, SKY,
 SKY, SKY, BLACK, GREEN, GREEN, GREEN, GREEN, GREEN, GREEN, GREEN, GREEN, GREEN, GREEN, GREEN, GREEN, GREEN,
 GREEN, GREEN, GREEN, GREEN, GREEN, GREEN, GREEN, GREEN, GREEN, GREEN, GREEN, GREEN, GREEN, GREEN, GREEN, GREEN,
 GREEN, GREEN, GREEN, GREEN, GREEN, GREEN, GREEN, GREEN, GREEN, GREEN, GREEN, GREEN, GREEN, GREEN, GREEN, GREEN,
 GREEN, GREEN, GREEN, GREEN, GREEN, GREEN, GREEN, GREEN, GREEN, GREEN, GREEN, GREEN, GREEN, GREEN, GREEN, GREEN,
 GREEN, GREEN, GREEN, GREEN, GREEN, GREEN, GREEN, GREEN, GREEN, GREEN, GREEN, GREEN, GREEN, BLACK, SKY, SKY,
 SKY, SKY, SKY, BLACK, GREEN, GREEN, GREEN, GREEN, GREEN, GREEN, GREEN, GREEN, GREEN, GREEN, GREEN, GREEN,
 GREEN, GREEN, GREEN, GREEN, GREEN, GREEN, GREEN, GREEN, GREEN, GREEN, GREEN, GREEN, GREEN, GREEN, GREEN, GREEN,
 GREEN, GREEN, GREEN, GREEN, GREEN, GREEN, GREEN, GREEN, GREEN, GREEN, GREEN, GREEN, GREEN, GREEN, GREEN, GREEN,
 GREEN, GREEN, GREEN, GREEN, GREEN, GREEN, GREEN, GREEN, GREEN, GREEN, GREEN, GREEN, GREEN, GREEN, GREEN, GREEN,
 GREEN, GREEN, GREEN, GREEN, GREEN, GREEN, GREEN, GREEN, GREEN, GREEN, GREEN, GREEN, BLACK, SKY, SKY, SKY,
 SKY, SKY, SKY, SKY, BLACK, GREEN, GREEN, GREEN, GREEN, GREEN, GREEN, GREEN, GREEN, GREEN, GREEN, GREEN,
 GREEN, GREEN, GREEN, GREEN, GREEN, GREEN, GREEN, GREEN, GREEN, GREEN, GREEN, GREEN, GREEN, GREEN, GREEN, GREEN,
 GREEN, GREEN, GREEN, GREEN, GREEN, GREEN, GREEN, GREEN, GREEN, GREEN, GREEN, GREEN, GREEN, GREEN, GREEN, GREEN,
 GREEN, GREEN, GREEN, GREEN, GREEN, GREEN, GREEN, GREEN, GREEN, GREEN, GREEN, GREEN, GREEN, GREEN, GREEN, GREEN,
 GREEN, GREEN, GREEN, GREEN, GREEN, GREEN, GREEN, GREEN, GREEN, GREEN, GREEN, BLACK, SKY, SKY, SKY, SKY,
 SKY, SKY, SKY, SKY, SKY, BLACK, GREEN, GREEN, GREEN, GREEN, GREEN, GREEN, GREEN, GREEN, GREEN, GREEN,
 GREEN, GREEN, GREEN, GREEN, GREEN, GREEN, GREEN, GREEN, GREEN, GREEN, GREEN, GREEN, GREEN, GREEN, GREEN, GREEN,
 GREEN, GREEN, GREEN, GREEN, GREEN, GREEN, GREEN, GREEN, GREEN, GREEN, GREEN, GREEN, GREEN, GREEN, GREEN, GREEN,
 GREEN, GREEN, GREEN, GREEN, GREEN, GREEN, GREEN, GREEN, GREEN, GREEN, GREEN, GREEN, GREEN, GREEN, GREEN, GREEN,
 GREEN, GREEN, GREEN, GREEN, GREEN, GREEN, GREEN, GREEN, GREEN, GREEN, BLACK, SKY, SKY, SKY, SKY, SKY,
 SKY, SKY, SKY, SKY, SKY, SKY, BLACK, GREEN, GREEN, GREEN, GREEN, GREEN, GREEN, GREEN, GREEN, GREEN,
 GREEN, GREEN, GREEN, GREEN, GREEN, GREEN, GREEN, GREEN, GREEN, GREEN, GREEN, GREEN, GREEN, GREEN, GREEN, GREEN,
 GREEN, GREEN, GREEN, GREEN, GREEN, GREEN, GREEN, GREEN, GREEN, GREEN, GREEN, GREEN, GREEN, GREEN, GREEN, GREEN,
 GREEN, GREEN, GREEN, GREEN, GREEN, GREEN, GREEN, GREEN, GREEN, GREEN, GREEN, GREEN, GREEN, GREEN, GREEN, GREEN,
 GREEN, GREEN, GREEN, GREEN, GREEN, GREEN, GREEN, GREEN, GREEN, BLACK, SKY, SKY, SKY, SKY, SKY, SKY,
 SKY, SKY, SKY, SKY, SKY, SKY, SKY, BLACK, GREEN, GREEN, GREEN, GREEN, GREEN, GREEN, GREEN, GREEN,
 GREEN, GREEN, GREEN, GREEN, GREEN, GREEN, GREEN, GREEN, GREEN, GREEN, GREEN, GREEN, GREEN, GREEN, GREEN, GREEN,
 GREEN, GREEN, GREEN, GREEN, GREEN, GREEN, GREEN, GREEN, GREEN, GREEN, GREEN, GREEN, GREEN, GREEN, GREEN, GREEN,
 GREEN, GREEN, GREEN, GREEN, GREEN, GREEN, GREEN, GREEN, GREEN, GREEN, GREEN, GREEN, GREEN, GREEN, GREEN, GREEN,
 GREEN, GREEN, GREEN, GREEN, GREEN, GREEN, GREEN, GREEN, BLACK, SKY, SKY, SKY, SKY, SKY, SKY, SKY,
 SKY, SKY, SKY, SKY, SKY, SKY, SKY, SKY, BLACK, GREEN, GREEN, GREEN, GREEN, GREEN, GREEN, GREEN,
 GREEN, GREEN, GREEN, GREEN, GREEN, GREEN, GREEN, GREEN, GREEN, BLACK, BLACK, GREEN, GREEN, GREEN, GREEN, GREEN,
 GREEN, GREEN, GREEN, GREEN, GREEN, GREEN, GREEN, GREEN, GREEN, GREEN, GREEN, GREEN, GREEN, GREEN, GREEN, GREEN,
 GREEN, GREEN, GREEN, GREEN, GREEN, GREEN, GREEN, GREEN, GREEN, BLACK, BLACK, GREEN, GREEN, GREEN, GREEN, GREEN,
 GREEN, GREEN, GREEN, GREEN, GREEN, GREEN, GREEN, BLACK, SKY, SKY, SKY, SKY, SKY, SKY, SKY, SKY,
 SKY, SKY, SKY, SKY, SKY, SKY, SKY, SKY, SKY, BLACK, GREEN, GREEN, GREEN, GREEN, GREEN, GREEN,
 GREEN, GREEN, GREEN, GREEN, GREEN, GREEN, GREEN, GREEN, GREEN, BLACK, BLACK, GREEN, GREEN, GREEN, GREEN, GREEN,
 GREEN, GREEN, GREEN, GREEN, GREEN, GREEN, GREEN, GREEN, GREEN, GREEN, GREEN, GREEN, GREEN, GREEN, GREEN, GREEN,
 GREEN, GREEN, GREEN, GREEN, GREEN, GREEN, GREEN, GREEN, GREEN, BLACK, BLACK, GREEN, GREEN, GREEN, GREEN, GREEN,
 GREEN, GREEN, GREEN, GREEN, GREEN, GREEN, BLACK, SKY, SKY, SKY, SKY, SKY, SKY, SKY, SKY, SKY,
 SKY, SKY, SKY, SKY, SKY, SKY, SKY, SKY, SKY, SKY, BLACK, GREEN, GREEN, GREEN, GREEN, GREEN,
 GREEN, GREEN, GREEN, GREEN, GREEN, GREEN, GREEN, GREEN, GREEN, BLACK, BLACK, GREEN, GREEN, BLACK, GREEN, GREEN,
 GREEN, GREEN, GREEN, GREEN, GREEN, GREEN, GREEN, GREEN, GREEN, GREEN, GREEN, GREEN, GREEN, GREEN, GREEN, GREEN,
 GREEN, GREEN, GREEN, GREEN, GREEN, GREEN, GREEN, GREEN, GREEN, BLACK, BLACK, GREEN, GREEN, BLACK, GREEN, GREEN,
 GREEN, GREEN, GREEN, GREEN, GREEN, BLACK, SKY, SKY, SKY, SKY, SKY, SKY, SKY, SKY, SKY, SKY,
 SKY, SKY, SKY, SKY, SKY, SKY, SKY, SKY, SKY, SKY, SKY, BLACK, GREEN, GREEN, GREEN, GREEN,
 GREEN, GREEN, GREEN, GREEN, GREEN, GREEN, GREEN, GREEN, GREEN, BLACK, BLACK, GREEN, BLACK, BLACK, BLACK, GREEN,
 GREEN, GREEN, GREEN, GREEN, GREEN, GREEN, GREEN, GREEN, GREEN, GREEN, GREEN, GREEN, GREEN, GREEN, GREEN, GREEN,
 GREEN, GREEN, GREEN, GREEN, GREEN, GREEN, GREEN, GREEN, GREEN, BLACK, BLACK, GREEN, BLACK, BLACK, BLACK, GREEN,
 GREEN, GREEN, GREEN, GREEN, BLACK, SKY, SKY, SKY, SKY, SKY, SKY, SKY, SKY, SKY, SKY, SKY,
 SKY, SKY, SKY, SKY, SKY, SKY, SKY, SKY, SKY, SKY, SKY, SKY, BLACK, GREEN, GREEN, GREEN,
 GREEN, GREEN, GREEN, GREEN, GREEN, GREEN, GREEN, GREEN, GREEN, GREEN, GREEN, GREEN, BLACK, BLACK, BLACK, GREEN,
 GREEN, GREEN, GREEN, GREEN, GREEN, GREEN, GREEN, GREEN, GREEN, GREEN, GREEN, GREEN, GREEN, GREEN, GREEN, GREEN,
 GREEN, GREEN, GREEN, GREEN, GREEN, GREEN, GREEN, GREEN, GREEN, GREEN, GREEN, GREEN, BLACK, BLACK, BLACK, GREEN,
 GREEN, GREEN, GREEN, BLACK, SKY, SKY, SKY, SKY, SKY, SKY, SKY, SKY, SKY, SKY, SKY, SKY,
 SKY, SKY, SKY, SKY, SKY, SKY, SKY, SKY, SKY, SKY, SKY, SKY, SKY, BLACK, GREEN, GREEN,
 GREEN, GREEN, GREEN, GREEN, GREEN, GREEN, GREEN, GREEN, GREEN, GREEN, GREEN, GREEN, BLACK, BLACK, BLACK, GREEN,
 GREEN, GREEN, GREEN, GREEN, GREEN, GREEN, GREEN, GREEN, GREEN, GREEN, GREEN, GREEN, GREEN, GREEN, GREEN, GREEN,
 GREEN, GREEN, GREEN, GREEN, GREEN, GREEN, GREEN, GREEN, GREEN, GREEN, GREEN, GREEN, BLACK, BLACK, BLACK, GREEN,
 GREEN, GREEN, BLACK, SKY, SKY, SKY, SKY, SKY, SKY, SKY, SKY, SKY, SKY, SKY, SKY, SKY,
 SKY, SKY, SKY, SKY, SKY, SKY, SKY, SKY, SKY, SKY, SKY, SKY, SKY, SKY, BLACK, GREEN,
 GREEN, GREEN, GREEN, GREEN, GREEN, GREEN, GREEN, GREEN, GREEN, GREEN, GREEN, GREEN, BLACK, BLACK, BLACK, GREEN,
 GREEN, GREEN, GREEN, GREEN, GREEN, GREEN, GREEN, GREEN, GREEN, GREEN, GREEN, GREEN, GREEN, GREEN, GREEN, GREEN,
 GREEN, GREEN, GREEN, GREEN, GREEN, GREEN, GREEN, GREEN, GREEN, GREEN, GREEN, GREEN, BLACK, BLACK, BLACK, GREEN,
 GREEN, BLACK, SKY, SKY, SKY, SKY, SKY, SKY, SKY, SKY, SKY, SKY, SKY, SKY, SKY, SKY,
 SKY, SKY, SKY, SKY, SKY, SKY, SKY, SKY, SKY, SKY, SKY, SKY, SKY, SKY, SKY, BLACK,
 GREEN, GREEN, GREEN, GREEN, GREEN, GREEN, GREEN, GREEN, GREEN, GREEN, GREEN, GREEN, GREEN, BLACK, GREEN, GREEN,
 GREEN, GREEN, GREEN, GREEN, GREEN, GREEN, GREEN, GREEN, GREEN, GREEN, GREEN, GREEN, GREEN, GREEN, GREEN, GREEN,
 GREEN, GREEN, GREEN, GREEN, GREEN, GREEN, GREEN, GREEN, GREEN, GREEN, GREEN, GREEN, GREEN, BLACK, GREEN, GREEN,
 BLACK, SKY, SKY, SKY, SKY, SKY, SKY, SKY, SKY, SKY, SKY, SKY, SKY, SKY, SKY, SKY,
};
const unsigned char bush_top_pixels[] = {
 BLACK, GREEN, GREEN, GREEN, GREEN, GREEN, GREEN, GREEN, GREEN, GREEN, GREEN, GREEN, GREEN, GREEN, GREEN, GREEN,
 GREEN, GREEN, GREEN, GREEN, GREEN, GREEN, GREEN, GREEN, GREEN, GREEN, GREEN, GREEN, GREEN, GREEN, GREEN, GREEN,
 GREEN, GREEN, GREEN, GREEN, GREEN, GREEN, GREEN, GREEN, GREEN, GREEN, GREEN, GREEN, GREEN, GREEN, GREEN, BLACK,
 SKY, BLACK, GREEN, GREEN, GREEN, GREEN, GREEN, GREEN, GREEN, GREEN, GREEN, GREEN, GREEN, GREEN, GREEN, GREEN,
 GREEN, GREEN, GREEN, GREEN, GREEN, GREEN, GREEN, GREEN, GREEN, GREEN, GREEN, GREEN, GREEN, GREEN, GREEN, GREEN,
 GREEN, GREEN, GREEN, GREEN, GREEN, GREEN, GREEN, GREEN, GREEN, GREEN, GREEN, GREEN, GREEN, GREEN, BLACK, SKY,
 SKY, SKY, BLACK, GREEN, GREEN, GREEN, GREEN, GREEN, GREEN, GREEN, GREEN, GREEN, GREEN, GREEN, GREEN, GREEN,
 GREEN, GREEN, GREEN, GREEN, GREEN, GREEN, GREEN, GREEN, GREEN, GREEN, GREEN, GREEN, GREEN, GREEN, GREEN, GREEN,
 GREEN, GREEN, GREEN, GREEN, GREEN, GREEN, GREEN, GREEN, GREEN, GREEN, GREEN, GREEN, GREEN, BLACK, SKY, SKY,
 SKY, SKY, SKY, BLACK, GREEN, GREEN, GREEN, GREEN, GREEN, GREEN, GREEN, GREEN, GREEN, GREEN, GREEN, GREEN,
 GREEN, GREEN, GREEN, GREEN, GREEN, GREEN, GREEN, GREEN, GREEN, GREEN, GREEN, GREEN, GREEN, GREEN, GREEN, GREEN,
 GREEN, GREEN, GREEN, GREEN, GREEN, GREEN, GREEN, GREEN, GREEN, GREEN, GREEN, GREEN, BLACK, SKY, SKY, SKY,
 SKY, SKY, SKY, SKY, BLACK, GREEN, GREEN, GREEN, GREEN, GREEN, GREEN, GREEN, GREEN, GREEN, GREEN, GREEN,
 GREEN, GREEN, GREEN, GREEN, GREEN, GREEN, GREEN, GREEN, GREEN, GREEN, GREEN, GREEN, GREEN, GREEN, GREEN, GREEN,
 GREEN, GREEN, GREEN, GREEN, GREEN, GREEN, GREEN, GREEN, GREEN, GREEN, GREEN, BLACK, SKY, SKY, SKY, SKY,
 SKY, SKY, SKY, SKY, SKY, BLACK, GREEN, GREEN, GREEN, GREEN, GREEN, GREEN, GREEN, GREEN, GREEN, GREEN,
 GREEN, GREEN, GREEN, GREEN, GREEN, GREEN, GREEN, GREEN, GREEN, GREEN, GREEN, GREEN, GREEN, GREEN, GREEN, GREEN,
 GREEN, GREEN, GREEN, GREEN, GREEN, GREEN, GREEN, GREEN, GREEN, GREEN, BLACK, SKY, SKY, SKY, SKY, SKY,
 SKY, SKY, SKY, SKY, SKY, SKY, BLACK, GREEN, GREEN, GREEN, GREEN, GREEN, GREEN, GREEN, GREEN, GREEN,
 GREEN, GREEN, GREEN, GREEN, GREEN, GREEN, GREEN, GREEN, GREEN, GREEN, GREEN, GREEN, GREEN, GREEN, GREEN, GREEN,
 GREEN, GREEN, GREEN, GREEN, GREEN, GREEN, GREEN, GREEN, GREEN, BLACK, SKY, SKY, SKY, SKY, SKY, SKY,
 SKY, SKY, SKY, SKY, SKY, SKY, SKY, BLACK, GREEN, GREEN, GREEN, GREEN, GREEN, GREEN, GREEN, GREEN,
 GREEN, GREEN, GREEN, GREEN, GREEN, GREEN, GREEN, GREEN, GREEN, GREEN, GREEN, GREEN, GREEN, GREEN, GREEN, GREEN,
 GREEN, GREEN, GREEN, GREEN, GREEN, GREEN, GREEN, GREEN, BLACK, SKY, SKY, SKY, SKY, SKY, SKY, SKY,
 SKY, SKY, SKY, SKY, SKY, SKY, SKY, SKY, BLACK, GREEN, GREEN, GREEN, GREEN, GREEN, GREEN, GREEN,
 GREEN, GREEN, GREEN, GREEN, GREEN, GREEN, GREEN, GREEN, GREEN, BLACK, BLACK, GREEN, GREEN, GREEN, GREEN, GREEN,
 GREEN, GREEN, GREEN, GREEN, GREEN, GREEN, GREEN, BLACK, SKY, SKY, SKY, SKY, SKY, SKY, SKY, SKY,
 SKY, SKY, SKY, SKY, SKY, SKY, SKY, SKY, SKY, BLACK, GREEN, GREEN, GREEN, GREEN, GREEN, GREEN,
 GREEN, GREEN, GREEN, GREEN, GREEN, GREEN, GREEN, GREEN, GREEN, BLACK, BLACK, GREEN, GREEN, GREEN, GREEN, GREEN,
 GREEN, GREEN, GREEN, GREEN, GREEN, GREEN, BLACK, SKY, SKY, SKY, SKY, SKY, SKY, SKY, SKY, SKY,
 SKY, SKY, SKY, SKY, SKY, SKY, SKY, SKY, SKY, SKY, BLACK, GREEN, GREEN, GREEN, GREEN, GREEN,
 GREEN, GREEN, GREEN, GREEN, GREEN, GREEN, GREEN, GREEN, GREEN, BLACK, BLACK, GREEN, GREEN, BLACK, GREEN, GREEN,
 GREEN, GREEN, GREEN, GREEN, GREEN, BLACK, SKY, SKY, SKY, SKY, SKY, SKY, SKY, SKY, SKY, SKY,
 SKY, SKY, SKY, SKY, SKY, SKY, SKY, SKY, SKY, SKY, SKY, BLACK, GREEN, GREEN, GREEN, GREEN,
 GREEN, GREEN, GREEN, GREEN, GREEN, GREEN, GREEN, GREEN, GREEN, BLACK, BLACK, GREEN, BLACK, BLACK, BLACK, GREEN,
 GREEN, GREEN, GREEN, GREEN, BLACK, SKY, SKY, SKY, SKY, SKY, SKY, SKY, SKY, SKY, SKY, SKY,
 SKY, SKY, SKY, SKY, SKY, SKY, SKY, SKY, SKY, SKY, SKY, SKY, BLACK, GREEN, GREEN, GREEN,
 GREEN, GREEN, GREEN, GREEN, GREEN, GREEN, GREEN, GREEN, GREEN, GREEN, GREEN, GREEN, BLACK, BLACK, BLACK, GREEN,
 GREEN, GREEN, GREEN, BLACK, SKY, SKY, SKY, SKY, SKY, SKY, SKY, SKY, SKY, SKY, SKY, SKY,
 SKY, SKY, SKY, SKY, SKY, SKY, SKY, SKY, SKY, SKY, SKY, SKY, SKY, BLACK, GREEN, GREEN,
 GREEN, GREEN, GREEN, GREEN, GREEN, GREEN, GREEN, GREEN, GREEN, GREEN, GREEN, GREEN, BLACK, BLACK, BLACK, GREEN,
 GREEN, GREEN, BLACK, SKY, SKY, SKY, SKY, SKY, SKY, SKY, SKY, SKY, SKY, SKY, SKY, SKY,
 SKY, SKY, SKY, SKY, SKY, SKY, SKY, SKY, SKY, SKY, SKY, SKY, SKY, SKY, BLACK, GREEN,
 GREEN, GREEN, GREEN, GREEN, GREEN, GREEN, GREEN, GREEN, GREEN, GREEN, GREEN, GREEN, BLACK, BLACK, BLACK, GREEN,
 GREEN, BLACK, SKY, SKY, SKY, SKY, SKY, SKY, SKY, SKY, SKY, SKY, SKY, SKY, SKY, SKY,
 SKY, SKY, SKY, SKY, SKY, SKY, SKY, SKY, SKY, SKY, SKY, SKY, SKY, SKY, SKY, BLACK,
 GREEN, GREEN, GREEN, GREEN, GREEN, GREEN, GREEN, GREEN, GREEN, GREEN, GREEN, GREEN, GREEN, BLACK, GREEN, GREEN,
 BLACK, SKY, SKY, SKY, SKY, SKY, SKY, SKY, SKY, SKY, SKY, SKY, SKY, SKY, SKY, SKY,
 SKY, SKY, SKY, SKY, SKY, SKY, SKY, SKY, SKY, SKY, SKY, SKY, SKY, SKY, SKY, SKY,
 BLACK, BLACK, GREEN, GREEN, GREEN, GREEN, GREEN, GREEN, GREEN, GREEN, GREEN, GREEN, GREEN, GREEN, BLACK, BLACK,
 SKY, SKY, SKY, SKY, SKY, SKY, SKY, SKY, SKY, SKY, SKY, SKY, SKY, SKY, SKY, SKY,
 SKY, SKY, SKY, SKY, SKY, SKY, SKY, SKY, SKY, SKY, SKY, SKY, SKY, SKY, SKY, SKY,
 SKY, SKY, BLACK, BLACK, BLACK, GREEN, GREEN, GREEN, GREEN, GREEN, GREEN, BLACK, BLACK, BLACK, SKY, SKY,
 SKY, SKY, SKY, SKY, SKY, SKY, SKY, SKY, SKY, SKY, SKY, SKY, SKY, SKY, SKY, SKY,
 SKY, SKY, SKY, SKY, SKY, SKY, SKY, SKY, SKY, SKY, SKY, SKY, SKY, SKY, SKY, SKY,
 SKY, SKY, SKY, SKY, SKY, BLACK, BLACK, BLACK, BLACK, BLACK, BLACK, SKY, SKY, SKY, SKY, SKY,
 SKY, SKY, SKY, SKY, SKY, SKY, SKY, SKY, SKY, SKY, SKY, SKY, SKY, SKY, SKY, SKY,
};
const unsigned char castle_bottom_pixels[] = {
 BLACK, BLACK, BLACK, BLACK, BLACK, BLACK, BLACK, BLACK, BLACK, BLACK, BLACK, BLACK, BLACK, BLACK, BLACK, BLACK,
 BLACK, BLACK, BLACK, BLACK, BLACK, BLACK, BLACK, BLACK, BLACK, BLACK, BLACK, BLACK, BLACK, BLACK, BLACK, BLACK,
 BLACK, BLACK, BLACK, BLACK, BLACK, BLACK, BLACK, BLACK, BLACK, BLACK, BLACK, BLACK, BLACK, BLACK, BLACK, BLACK,
 BLACK, BLACK, BLACK, BLACK, BLACK, BLACK, BLACK, BLACK, BLACK, BLACK, BLACK, BLACK, BLACK, BLACK, BLACK, BLACK,
 BLACK, BLACK, BLACK, BLACK, BLACK, BLACK, BLACK, BLACK, BLACK, BLACK, BLACK, BLACK, BLACK, BLACK, BLACK, BLACK,
 BROWN, BROWN, BROWN, BLACK, BROWN, BROWN, BROWN, BROWN, BROWN, BROWN, BROWN, BLACK, BROWN, BROWN, BROWN, BROWN,
 BROWN, BROWN, BROWN, BLACK, BROWN, BROWN, BROWN, BROWN, BROWN, BROWN, BROWN, BLACK, BROWN, BROWN, BROWN, BROWN,
 BLACK, BLACK, BLACK, BLACK, BLACK, BLACK, BLACK, BLACK, BLACK, BLACK, BLACK, BLACK, BLACK, BLACK, BLACK, BLACK,
 BROWN, BROWN, BROWN, BLACK, BROWN, BROWN, BROWN, BROWN, BROWN, BROWN, BROWN, BLACK, BROWN, BROWN, BROWN, BROWN,
 BROWN, BROWN, BROWN, BLACK, BROWN, BROWN, BROWN, BROWN, BROWN, BROWN, BROWN, BLACK, BROWN, BROWN, BROWN, BROWN,
 BROWN, BROWN, BROWN, BLACK, BROWN, BROWN, BROWN, BROWN, BROWN, BROWN, BROWN, BLACK, BROWN, BROWN, BROWN, BROWN,
 BROWN, BROWN, BROWN, BLACK, BROWN, BROWN, BROWN, BROWN, BROWN, BROWN, BROWN, BLACK, BROWN, BROWN, BROWN, BROWN,
 BLACK, BLACK, BLACK, BLACK, BLACK, BLACK, BLACK, BLACK, BLACK, BLACK, BLACK, BLACK, BLACK, BLACK, BLACK, BLACK,
 BROWN, BROWN, BROWN, BLACK, BROWN, BROWN, BROWN, BROWN, BROWN, BROWN, BROWN, BLACK, BROWN, BROWN, BROWN, BROWN,
 BROWN, BROWN, BROWN, BLACK, BROWN, BROWN, BROWN, BROWN, BROWN, BROWN, BROWN, BLACK, BROWN, BROWN, BROWN, BROWN,
 BROWN, BROWN, BROWN, BLACK, BROWN, BROWN, BROWN, BROWN, BROWN, BROWN, BROWN, BLACK, BROWN, BROWN, BROWN, BROWN,
 BROWN, BROWN, BROWN, BLACK, BROWN, BROWN, BROWN, BROWN, BROWN, BROWN, BROWN, BLACK, BROWN, BROWN, BROWN, BROWN,
 BLACK, BLACK, BLACK, BLACK, BLACK, BLACK, BLACK, BLACK, BLACK, BLACK, BLACK, BLACK, BLACK, BLACK, BLACK, BLACK,
 BROWN, BROWN, BROWN, BLACK, BROWN, BROWN, BROWN, BROWN, BROWN, BROWN, BROWN, BLACK, BROWN, BROWN, BROWN, BROWN,
 BROWN, BROWN, BROWN, BLACK, BROWN, BROWN, BROWN, BROWN, BROWN, BROWN, BROWN, BLACK, BROWN, BROWN, BROWN, BROWN,
 BLACK, BLACK, BLACK, BLACK, BLACK, BLACK, BLACK, BLACK, BLACK, BLACK, BLACK, BLACK, BLACK, BLACK, BLACK, BLACK,
 BLACK, BLACK, BLACK, BLACK, BLACK, BLACK, BLACK, BLACK, BLACK, BLACK, BLACK, BLACK, BLACK, BLACK, BLACK, BLACK,
 BLACK, BLACK, BLACK, BLACK, BLACK, BLACK, BLACK, BLACK, BLACK, BLACK, BLACK, BLACK, BLACK, BLACK, BLACK, BLACK,
 BLACK, BLACK, BLACK, BLACK, BLACK, BLACK, BLACK, BLACK, BLACK, BLACK, BLACK, BLACK, BLACK, BLACK, BLACK, BLACK,
 BLACK, BLACK, BLACK, BLACK, BLACK, BLACK, BLACK, BLACK, BLACK, BLACK, BLACK, BLACK, BLACK, BLACK, BLACK, BLACK,
 BROWN, BROWN, BROWN, BROWN, BROWN, BROWN, BROWN, BLACK, BROWN, BROWN, BROWN, BROWN, BROWN, BROWN, BROWN, BLACK,
 BROWN, BROWN, BROWN, BROWN, BROWN, BROWN, BROWN, BLACK, BROWN, BROWN, BROWN, BROWN, BROWN, BROWN, BROWN, BLACK,
 BLACK, BLACK, BLACK, BLACK, BLACK, BLACK, BLACK, BLACK, BLACK, BLACK, BLACK, BLACK, BLACK, BLACK, BLACK, BLACK,
 BROWN, BROWN, BROWN, BROWN, BROWN, BROWN, BROWN, BLACK, BROWN, BROWN, BROWN, BROWN, BROWN, BROWN, BROWN, BLACK,
 BROWN, BROWN, BROWN, BROWN, BROWN, BROWN, BROWN, BLACK, BROWN, BROWN, BROWN, BROWN, BROWN, BROWN, BROWN, BLACK,
 BROWN, BROWN, BROWN, BROWN, BROWN, BROWN, BROWN, BLACK, BROWN, BROWN, BROWN, BROWN, BROWN, BROWN, BROWN, BLACK,
 BROWN, BROWN, BROWN, BROWN, BROWN, BROWN, BROWN, BLACK, BROWN, BROWN, BROWN, BROWN, BROWN, BROWN, BROWN, BLACK,
 BLACK, BLACK, BLACK, BLACK, BLACK, BLACK, BLACK, BLACK, BLACK, BLACK, BLACK, BLACK, BLACK, BLACK, BLACK, BLACK,
 BROWN, BROWN, BROWN, BROWN, BROWN, BROWN, BROWN, BLACK, BROWN, BROWN, BROWN, BROWN, BROWN, BROWN, BROWN, BLACK,
 BROWN, BROWN, BROWN, BROWN, BROWN, BROWN, BROWN, BLACK, BROWN, BROWN, BROWN, BROWN, BROWN, BROWN, BROWN, BLACK,
 BROWN, BROWN, BROWN, BROWN, BROWN, BROWN, BROWN, BLACK, BROWN, BROWN, BROWN, BROWN, BROWN, BROWN, BROWN, BLACK,
 BROWN, BROWN, BROWN, BROWN, BROWN, BROWN, BROWN, BLACK, BROWN, BROWN, BROWN, BROWN, BROWN, BROWN, BROWN, BLACK,
 BLACK, BLACK, BLACK, BLACK, BLACK, BLACK, BLACK, BLACK, BLACK, BLACK, BLACK, BLACK, BLACK, BLACK, BLACK, BLACK,
 BROWN, BROWN, BROWN, BROWN, BROWN, BROWN, BROWN, BLACK, BROWN, BROWN, BROWN, BROWN, BROWN, BROWN, BROWN, BLACK,
 BROWN, BROWN, BROWN, BROWN, BROWN, BROWN, BROWN, BLACK, BROWN, BROWN, BROWN, BROWN, BROWN, BROWN, BROWN, BLACK,
 BLACK, BLACK, BLACK, BLACK, BLACK, BLACK, BLACK, BLACK, BLACK, BLACK, BLACK, BLACK, BLACK, BLACK, BLACK, BLACK,
 BLACK, BLACK, BLACK, BLACK, BLACK, BLACK, BLACK, BLACK, BLACK, BLACK, BLACK, BLACK, BLACK, BLACK, BLACK, BLACK,
 BLACK, BLACK, BLACK, BLACK, BLACK, BLACK, BLACK, BLACK, BLACK, BLACK, BLACK, BLACK, BLACK, BLACK, BLACK, BLACK,
 BLACK, BLACK, BLACK, BLACK, BLACK, BLACK, BLACK, BLACK, BLACK, BLACK, BLACK, BLACK, BLACK, BLACK, BLACK, BLACK,
 BLACK, BLACK, BLACK, BLACK, BLACK, BLACK, BLACK, BLACK, BLACK, BLACK, BLACK, BLACK, BLACK, BLACK, BLACK, BLACK,
 BROWN, BROWN, BROWN, BLACK, BROWN, BROWN, BROWN, BROWN, BROWN, BROWN, BROWN, BLACK, BROWN, BROWN, BROWN, BROWN,
 BROWN, BROWN, BROWN, BLACK, BROWN, BROWN, BROWN, BROWN, BROWN, BROWN, BROWN, BLACK, BROWN, BROWN, BROWN, BROWN,
 BLACK, BLACK, BLACK, BLACK, BLACK, BLACK, BLACK, BLACK, BLACK, BLACK, BLACK, BLACK, BLACK, BLACK, BLACK, BLACK,
 BROWN, BROWN, BROWN, BLACK, BROWN, BROWN, BROWN, BROWN, BROWN, BROWN, BROWN, BLACK, BROWN, BROWN, BROWN, BROWN,
 BROWN, BROWN, BROWN, BLACK, BROWN, BROWN, BROWN, BROWN, BROWN, BROWN, BROWN, BLACK, BROWN, BROWN, BROWN, BROWN,
 BROWN, BROWN, BROWN, BLACK, BROWN, BROWN, BROWN, BROWN, BROWN, BROWN, BROWN, BLACK, BROWN, BROWN, BROWN, BROWN,
 BROWN, BROWN, BROWN, BLACK, BROWN, BROWN, BROWN, BROWN, BROWN, BROWN, BROWN, BLACK, BROWN, BROWN, BROWN, BROWN,
 BLACK, BLACK, BLACK, BLACK, BLACK, BLACK, BLACK, BLACK, BLACK, BLACK, BLACK, BLACK, BLACK, BLACK, BLACK, BLACK,
 BROWN, BROWN, BROWN, BLACK, BROWN, BROWN, BROWN, BROWN, BROWN, BROWN, BROWN, BLACK, BROWN, BROWN, BROWN, BROWN,
 BROWN, BROWN, BROWN, BLACK, BROWN, BROWN, BROWN, BROWN, BROWN, BROWN, BROWN, BLACK, BROWN, BROWN, BROWN, BROWN,
 BROWN, BROWN, BROWN, BLACK, BROWN, BROWN, BROWN, BROWN, BROWN, BROWN, BROWN, BLACK, BROWN, BROWN, BROWN, BROWN,
 BROWN, BROWN, BROWN, BLACK, BROWN, BROWN, BROWN, BROWN, BROWN, BROWN, BROWN, BLACK, BROWN, BROWN, BROWN, BROWN,
 BLACK, BLACK, BLACK, BLACK, BLACK, BLACK, BLACK, BLACK, BLACK, BLACK, BLACK, BLACK, BLACK, BLACK, BLACK, BLACK,
 BROWN, BROWN, BROWN, BLACK, BROWN, BROWN, BROWN, BROWN, BROWN, BROWN, BROWN, BLACK, BROWN, BROWN, BROWN, BROWN,
 BROWN, BROWN, BROWN, BLACK, BROWN, BROWN, BROWN, BROWN, BROWN, BROWN, BROWN, BLACK, BROWN, BROWN, BROWN, BROWN,
 BLACK, BLACK, BLACK, BLACK, BLACK, BLACK, BLACK, BLACK, BLACK, BLACK, BLACK, BLACK, BLACK, BLACK, BLACK, BLACK,
 BLACK, BLACK, BLACK, BLACK, BLACK, BLACK, BLACK, BLACK, BLACK, BLACK, BLACK, BLACK, BLACK, BLACK, BLACK, BLACK,
 BLACK, BLACK, BLACK, BLACK, BLACK, BLACK, BLACK, BLACK, BLACK, BLACK, BLACK, BLACK, BLACK, BLACK, BLACK, BLACK,
 BLACK, BLACK, BLACK, BLACK, BLACK, BLACK, BLACK, BLACK, BLACK, BLACK, BLACK, BLACK, BLACK, BLACK, BLACK, BLACK,
 BLACK, BLACK, BLACK, BLACK, BLACK, BLACK, BLACK, BLACK, BLACK, BLACK, BLACK, BLACK, BLACK, BLACK, BLACK, BLACK,
 BROWN, BROWN, BROWN, BROWN, BROWN, BROWN, BROWN, BLACK, BROWN, BROWN, BROWN, BROWN, BROWN, BROWN, BROWN, BLACK,
 BROWN, BROWN, BROWN, BROWN, BROWN, BROWN, BROWN, BLACK, BROWN, BROWN, BROWN, BROWN, BROWN, BROWN, BROWN, BLACK,
 BLACK, BLACK, BLACK, BLACK, BLACK, BLACK, BLACK, BLACK, BLACK, BLACK, BLACK, BLACK, BLACK, BLACK, BLACK, BLACK,
 BROWN, BROWN, BROWN, BROWN, BROWN, BROWN, BROWN, BLACK, BROWN, BROWN, BROWN, BROWN, BROWN, BROWN, BROWN, BLACK,
 BROWN, BROWN, BROWN, BROWN, BROWN, BROWN, BROWN, BLACK, BROWN, BROWN, BROWN, BROWN, BROWN, BROWN, BROWN, BLACK,
 BROWN, BROWN, BROWN, BROWN, BROWN, BROWN, BROWN, BLACK, BROWN, BROWN, BROWN, BROWN, BROWN, BROWN, BROWN, BLACK,
 BROWN, BROWN, BROWN, BROWN, BROWN, BROWN, BROWN, BLACK, BROWN, BROWN, BROWN, BROWN, BROWN, BROWN, BROWN, BLACK,
 BLACK, BLACK, BLACK, BLACK, BLACK, BLACK, BLACK, BLACK, BLACK, BLACK, BLACK, BLACK, BLACK, BLACK, BLACK, BLACK,
 BROWN, BROWN, BROWN, BROWN, BROWN, BROWN, BROWN, BLACK, BROWN, BROWN, BROWN, BROWN, BROWN, BROWN, BROWN, BLACK,
 BROWN, BROWN, BROWN, BROWN, BROWN, BROWN, BROWN, BLACK, BROWN, BROWN, BROWN, BROWN, BROWN, BROWN, BROWN, BLACK,
 BROWN, BROWN, BROWN, BROWN, BROWN, BROWN, BROWN, BLACK, BROWN, BROWN, BROWN, BROWN, BROWN, BROWN, BROWN, BLACK,
 BROWN, BROWN, BROWN, BROWN, BROWN, BROWN, BROWN, BLACK, BROWN, BROWN, BROWN, BROWN, BROWN, BROWN, BROWN, BLACK,
 BLACK, BLACK, BLACK, BLACK, BLACK, BLACK, BLACK, BLACK, BLACK, BLACK, BLACK, BLACK, BLACK, BLACK, BLACK, BLACK,
 BROWN, BROWN, BROWN, BROWN, BROWN, BROWN, BROWN, BLACK, BROWN, BROWN, BROWN, BROWN, BROWN, BROWN, BROWN, BLACK,
 BROWN, BROWN, BROWN, BROWN, BROWN, BROWN, BROWN, BLACK, BROWN, BROWN, BROWN, BROWN, BROWN, BROWN, BROWN, BLACK,
 BLACK, BLACK, BLACK, BLACK, BLACK, BLACK, BLACK, BLACK, BLACK, BLACK, BLACK, BLACK, BLACK, BLACK, BLACK, BLACK,
 BLACK, BLACK, BLACK, BLACK, BLACK, BLACK, BLACK, BLACK, BLACK, BLACK, BLACK, BLACK, BLACK, BLACK, BLACK, BLACK,
 BLACK, BLACK, BLACK, BLACK, BLACK, BLACK, BLACK, BLACK, BLACK, BLACK, BLACK, BLACK, BLACK, BLACK, BLACK, BLACK,
 BLACK, BLACK, BLACK, BLACK, BLACK, BLACK, BLACK, BLACK, BLACK, BLACK, BLACK, BLACK, BLACK, BLACK, BLACK, BLACK,
 BLACK, BLACK, BLACK, BLACK, BLACK, BLACK, BLACK, BLACK, BLACK, BLACK, BLACK, BLACK, BLACK, BLACK, BLACK, BLACK,
 BROWN, BROWN, BROWN, BLACK, BROWN, BROWN, BROWN, BROWN, BROWN, BROWN, BROWN, BLACK, BROWN, BROWN, BROWN, BROWN,
 BROWN, BROWN, BROWN, BLACK, BROWN, BROWN, BROWN, BROWN, BROWN, BROWN, BROWN, BLACK, BROWN, BROWN, BROWN, BROWN,
 BLACK, BLACK, BLACK, BLACK, BLACK, BLACK, BLACK, BLACK, BLACK, BLACK, BLACK, BLACK, BLACK, BLACK, BLACK, BLACK,
 BROWN, BROWN, BROWN, BLACK, BROWN, BROWN, BROWN, BROWN, BROWN, BROWN, BROWN, BLACK, BROWN, BROWN, BROWN, BROWN,
 BROWN, BROWN, BROWN, BLACK, BROWN, BROWN, BROWN, BROWN, BROWN, BROWN, BROWN, BLACK, BROWN, BROWN, BROWN, BROWN,
 BROWN, BROWN, BROWN, BLACK, BROWN, BROWN, BROWN, BROWN, BROWN, BROWN, BROWN, BLACK, BROWN, BROWN, BROWN, BROWN,
 BROWN, BROWN, BROWN, BLACK, BROWN, BROWN, BROWN, BROWN, BROWN, BROWN, BROWN, BLACK, BROWN, BROWN, BROWN, BROWN,
 BLACK, BLACK, BLACK, BLACK, BLACK, BLACK, BLACK, BLACK, BLACK, BLACK, BLACK, BLACK, BLACK, BLACK, BLACK, BLACK,
 BROWN, BROWN, BROWN, BLACK, BROWN, BROWN, BROWN, BROWN, BROWN, BROWN, BROWN, BLACK, BROWN, BROWN, BROWN, BROWN,
 BROWN, BROWN, BROWN, BLACK, BROWN, BROWN, BROWN, BROWN, BROWN, BROWN, BROWN, BLACK, BROWN, BROWN, BROWN, BROWN,
 BROWN, BROWN, BROWN, BLACK, BROWN, BROWN, BROWN, BROWN, BROWN, BROWN, BROWN, BLACK, BROWN, BROWN, BROWN, BROWN,
 BROWN, BROWN, BROWN, BLACK, BROWN, BROWN, BROWN, BROWN, BROWN, BROWN, BROWN, BLACK, BROWN, BROWN, BROWN, BROWN,
 BLACK, BLACK, BLACK, BLACK, BLACK, BLACK, BLACK, BLACK, BLACK, BLACK, BLACK, BLACK, BLACK, BLACK, BLACK, BLACK,
 BROWN, BROWN, BROWN, BLACK, BROWN, BROWN, BROWN, BROWN, BROWN, BROWN, BROWN, BLACK, BROWN, BROWN, BROWN, BROWN,
 BROWN, BROWN, BROWN, BLACK, BROWN, BROWN, BROWN, BROWN, BROWN, BROWN, BROWN, BLACK, BROWN, BROWN, BROWN, BROWN,
 BLACK, BLACK, BLACK, BLACK, BLACK, BLACK, BLACK, BLACK, BLACK, BLACK, BLACK, BLACK, BLACK, BLACK, BLACK, BLACK,
 BLACK, BLACK, BLACK, BLACK, BLACK, BLACK, BLACK, BLACK, BLACK, BLACK, BLACK, BLACK, BLACK, BLACK, BLACK, BLACK,
 BLACK, BLACK, BLACK, BLACK, BLACK, BLACK, BLACK, BLACK, BLACK, BLACK, BLACK, BLACK, BLACK, BLACK, BLACK, BLACK,
 BLACK, BLACK, BLACK, BLACK, BLACK, BLACK, BLACK, BLACK, BLACK, BLACK, BLACK, BLACK, BLACK, BLACK, BLACK, BLACK,
 BLACK, BLACK, BLACK, BLACK, BLACK, BLACK, BLACK, BLACK, BLACK, BLACK, BLACK, BLACK, BLACK, BLACK, BLACK, BLACK,
 BROWN, BROWN, BROWN, BROWN, BROWN, BROWN, BROWN, BLACK, BROWN, BROWN, BROWN, BROWN, BROWN, BROWN, BROWN, BLACK,
 BROWN, BROWN, BROWN, BROWN, BROWN, BROWN, BROWN, BLACK, BROWN, BROWN, BROWN, BROWN, BROWN, BROWN, BROWN, BLACK,
 BLACK, BLACK, BLACK, BLACK, BLACK, BLACK, BLACK, BLACK, BLACK, BLACK, BLACK, BLACK, BLACK, BLACK, BLACK, BLACK,
 BROWN, BROWN, BROWN, BROWN, BROWN, BROWN, BROWN, BLACK, BROWN, BROWN, BROWN, BROWN, BROWN, BROWN, BROWN, BLACK,
 BROWN, BROWN, BROWN, BROWN, BROWN, BROWN, BROWN, BLACK, BROWN, BROWN, BROWN, BROWN, BROWN, BROWN, BROWN, BLACK,
 BROWN, BROWN, BROWN, BROWN, BROWN, BROWN, BROWN, BLACK, BROWN, BROWN, BROWN, BROWN, BROWN, BROWN, BROWN, BLACK,
 BROWN, BROWN, BROWN, BROWN, BROWN, BROWN, BROWN, BLACK, BROWN, BROWN, BROWN, BROWN, BROWN, BROWN, BROWN, BLACK,
 BLACK, BLACK, BLACK, BLACK, BLACK, BLACK, BLACK, BLACK, BLACK, BLACK, BLACK, BLACK, BLACK, BLACK, BLACK, BLACK,
 BROWN, BROWN, BROWN, BROWN, BROWN, BROWN, BROWN, BLACK, BROWN, BROWN, BROWN, BROWN, BROWN, BROWN, BROWN, BLACK,
 BROWN, BROWN, BROWN, BROWN, BROWN, BROWN, BROWN, BLACK, BROWN, BROWN, BROWN, BROWN, BROWN, BROWN, BROWN, BLACK,
 BROWN, BROWN, BROWN, BROWN, BROWN, BROWN, BROWN, BLACK, BROWN, BROWN, BROWN, BROWN, BROWN, BROWN, BROWN, BLACK,
 BROWN, BROWN, BROWN, BROWN, BROWN, BROWN, BROWN, BLACK, BROWN, BROWN, BROWN, BROWN, BROWN, BROWN, BROWN, BLACK,
 BLACK, BLACK, BLACK, BLACK, BLACK, BLACK, BLACK, BLACK, BLACK, BLACK, BLACK, BLACK, BLACK, BLACK, BLACK, BLACK,
 BROWN, BROWN, BROWN, BROWN, BROWN, BROWN, BROWN, BLACK, BROWN, BROWN, BROWN, BROWN, BROWN, BROWN, BROWN, BLACK,
 BROWN, BROWN, BROWN, BROWN, BROWN, BROWN, BROWN, BLACK, BROWN, BROWN, BROWN, BROWN, BROWN, BROWN, BROWN, BLACK,
 BLACK, BLACK, BLACK, BLACK, BLACK, BLACK, BLACK, BLACK, BLACK, BLACK, BLACK, BLACK, BLACK, BLACK, BLACK, BLACK,
 BLACK, BLACK, BLACK, BLACK, BLACK, BLACK, BLACK, BLACK, BLACK, BLACK, BLACK, BLACK, BLACK, BLACK, BLACK, BLACK,
 BLACK, BLACK, BLACK, BLACK, BLACK, BLACK, BLACK, BLACK, BLACK, BLACK, BLACK, BLACK, BLACK, BLACK, BLACK, BLACK,
 BLACK, BLACK, BLACK, BLACK, BLACK, BLACK, BLACK, BLACK, BLACK, BLACK, BLACK, BLACK, BLACK, BLACK, BLACK, BLACK,
 BLACK, BLACK, BLACK, BLACK, BLACK, BLACK, BLACK, BLACK, BLACK, BLACK, BLACK, BLACK, BLACK, BLACK, BLACK, BLACK,
 BROWN, BROWN, BROWN, BLACK, BROWN, BROWN, BROWN, BROWN, BROWN, BROWN, BROWN, BLACK, BROWN, BROWN, BROWN, BROWN,
 BROWN, BROWN, BROWN, BLACK, BROWN, BROWN, BROWN, BROWN, BROWN, BROWN, BROWN, BLACK, BROWN, BROWN, BROWN, BROWN,
 BLACK, BLACK, BLACK, BLACK, BLACK, BLACK, BLACK, BLACK, BLACK, BLACK, BLACK, BLACK, BLACK, BLACK, BLACK, BLACK,
 BROWN, BROWN, BROWN, BLACK, BROWN, BROWN, BROWN, BROWN, BROWN, BROWN, BROWN, BLACK, BROWN, BROWN, BROWN, BROWN,
 BROWN, BROWN, BROWN, BLACK, BROWN, BROWN, BROWN, BROWN, BROWN, BROWN, BROWN, BLACK, BROWN, BROWN, BROWN, BROWN,
 BROWN, BROWN, BROWN, BLACK, BROWN, BROWN, BROWN, BROWN, BROWN, BROWN, BROWN, BLACK, BROWN, BROWN, BROWN, BROWN,
 BROWN, BROWN, BROWN, BLACK, BROWN, BROWN, BROWN, BROWN, BROWN, BROWN, BROWN, BLACK, BROWN, BROWN, BROWN, BROWN,
 BROWN, BLACK, BLACK, BLACK, BLACK, BLACK, BLACK, BLACK, BLACK, BLACK, BLACK, BLACK, BLACK, BLACK, BLACK, BROWN,
 BROWN, BROWN, BROWN, BLACK, BROWN, BROWN, BROWN, BROWN, BROWN, BROWN, BROWN, BLACK, BROWN, BROWN, BROWN, BROWN,
 BROWN, BROWN, BROWN, BLACK, BROWN, BROWN, BROWN, BROWN, BROWN, BROWN, BROWN, BLACK, BROWN, BROWN, BROWN, BROWN,
 BROWN, BROWN, BROWN, BLACK, BROWN, BROWN, BROWN, BROWN, BROWN, BROWN, BROWN, BLACK, BROWN, BROWN, BROWN, BROWN,
 BROWN, BROWN, BROWN, BLACK, BROWN, BROWN, BROWN, BROWN, BROWN, BROWN, BROWN, BLACK, BROWN, BROWN, BROWN, BROWN,
 BROWN, BLACK, BLACK, BLACK, BLACK, BLACK, BLACK, BLACK, BLACK, BLACK, BLACK, BLACK, BLACK, BLACK, BLACK, BROWN,
 BROWN, BROWN, BROWN, BLACK, BROWN, BROWN, BROWN, BROWN, BROWN, BROWN, BROWN, BLACK, BROWN, BROWN, BROWN, BROWN,
 BROWN, BROWN, BROWN, BLACK, BROWN, BROWN, BROWN, BROWN, BROWN, BROWN, BROWN, BLACK, BROWN, BROWN, BROWN, BROWN,
 BLACK, BLACK, BLACK, BLACK, BLACK, BLACK, BLACK, BLACK, BLACK, BLACK, BLACK, BLACK, BLACK, BLACK, BLACK, BLACK,
 BLACK, BLACK, BLACK, BLACK, BLACK, BLACK, BLACK, BLACK, BLACK, BLACK, BLACK, BLACK, BLACK, BLACK, BLACK, BLACK,
 BLACK, BLACK, BLACK, BLACK, BLACK, BLACK, BLACK, BLACK, BLACK, BLACK, BLACK, BLACK, BLACK, BLACK, BLACK, BLACK,
 BLACK, BLACK, BLACK, BLACK, BLACK, BLACK, BLACK, BLACK, BLACK, BLACK, BLACK, BLACK, BLACK, BLACK, BLACK, BLACK,
 BLACK, BLACK, BLACK, BLACK, BLACK, BLACK, BLACK, BLACK, BLACK, BLACK, BLACK, BLACK, BLACK, BLACK, BLACK, BLACK,
 BROWN, BROWN, BROWN, BROWN, BROWN, BROWN, BROWN, BLACK, BROWN, BROWN, BROWN, BROWN, BROWN, BROWN, BROWN, BLACK,
 BROWN, BROWN, BROWN, BROWN, BROWN, BROWN, BROWN, BLACK, BROWN, BROWN, BROWN, BROWN, BROWN, BROWN, BROWN, BLACK,
 BROWN, BROWN, BLACK, BLACK, BLACK, BLACK, BLACK, BLACK, BLACK, BLACK, BLACK, BLACK, BLACK, BLACK, BROWN, BLACK,
 BROWN, BROWN, BROWN, BROWN, BROWN, BROWN, BROWN, BLACK, BROWN, BROWN, BROWN, BROWN, BROWN, BROWN, BROWN, BLACK,
 BROWN, BROWN, BROWN, BROWN, BROWN, BROWN, BROWN, BLACK, BROWN, BROWN, BROWN, BROWN, BROWN, BROWN, BROWN, BLACK,
 BROWN, BROWN, BROWN, BROWN, BROWN, BROWN, BROWN, BLACK, BROWN, BROWN, BROWN, BROWN, BROWN, BROWN, BROWN, BLACK,
 BROWN, BROWN, BROWN, BROWN, BROWN, BROWN, BROWN, BLACK, BROWN, BROWN, BROWN, BROWN, BROWN, BROWN, BROWN, BLACK,
 BROWN, BROWN, BROWN, BLACK, BLACK, BLACK, BLACK, BLACK, BLACK, BLACK, BLACK, BLACK, BLACK, BROWN, BROWN, BLACK,
 BROWN, BROWN, BROWN, BROWN, BROWN, BROWN, BROWN, BLACK, BROWN, BROWN, BROWN, BROWN, BROWN, BROWN, BROWN, BLACK,
 BROWN, BROWN, BROWN, BROWN, BROWN, BROWN, BROWN, BLACK, BROWN, BROWN, BROWN, BROWN, BROWN, BROWN, BROWN, BLACK,
 BROWN, BROWN, BROWN, BROWN, BROWN, BROWN, BROWN, BLACK, BROWN, BROWN, BROWN, BROWN, BROWN, BROWN, BROWN, BLACK,
 BROWN, BROWN, BROWN, BROWN, BROWN, BROWN, BROWN, BLACK, BROWN, BROWN, BROWN, BROWN, BROWN, BROWN, BROWN, BLACK,
 BROWN, BROWN, BROWN, BROWN, BROWN, BLACK, BLACK, BLACK, BLACK, BLACK, BLACK, BROWN, BROWN, BROWN, BROWN, BLACK,
 BROWN, BROWN, BROWN, BROWN, BROWN, BROWN, BROWN, BLACK, BROWN, BROWN, BROWN, BROWN, BROWN, BROWN, BROWN, BLACK,
 BROWN, BROWN, BROWN, BROWN, BROWN, BROWN, BROWN, BLACK, BROWN, BROWN, BROWN, BROWN, BROWN, BROWN, BROWN, BLACK,
 BLACK, BLACK, BLACK, BLACK, BLACK, BLACK, BLACK, BLACK, BLACK, BLACK, BLACK, BLACK, BLACK, BLACK, BLACK, BLACK,
 BLACK, BLACK, BLACK, BLACK, BLACK, BLACK, BLACK, BLACK, BLACK, BLACK, BLACK, BLACK, BLACK, BLACK, BLACK, BLACK,
 BLACK, BLACK, BLACK, BLACK, BLACK, BLACK, BLACK, BLACK, BLACK, BLACK, BLACK, BLACK, BLACK, BLACK, BLACK, BLACK,
 BLACK, BLACK, BLACK, BLACK, BLACK, BLACK, BLACK, BLACK, BLACK, BLACK, BLACK, BLACK, BLACK, BLACK, BLACK, BLACK,
 BLACK, BLACK, BLACK, BLACK, BLACK, BLACK, BLACK, BLACK, BLACK, BLACK, BLACK, BLACK, BLACK, BLACK, BLACK, BLACK,
 BROWN, BROWN, BROWN, BLACK, BROWN, BROWN, BROWN, BROWN, BROWN, BROWN, BROWN, BLACK, BROWN, BROWN, BROWN, BROWN,
 BROWN, BROWN, BROWN, BLACK, BROWN, BROWN, BROWN, BROWN, BROWN, BROWN, BROWN, BLACK, BROWN, BROWN, BROWN, BROWN,
 BROWN, BROWN, BROWN, BLACK, BROWN, BROWN, BROWN, BROWN, BROWN, BROWN, BROWN, BLACK, BROWN, BROWN, BROWN, BROWN,
 BROWN, BROWN, BROWN, BLACK, BROWN, BROWN, BROWN, BROWN, BROWN, BROWN, BROWN, BLACK, BROWN, BROWN, BROWN, BROWN,
 BROWN, BROWN, BROWN, BLACK, BROWN, BROWN, BROWN, BROWN, BROWN, BROWN, BROWN, BLACK, BROWN, BROWN, BROWN, BROWN,
 BROWN, BROWN, BROWN, BLACK, BROWN, BROWN, BROWN, BROWN, BROWN, BROWN, BROWN, BLACK, BROWN, BROWN, BROWN, BROWN,
 BROWN, BROWN, BROWN, BLACK, BROWN, BROWN, BROWN, BROWN, BROWN, BROWN, BROWN, BLACK, BROWN, BROWN, BROWN, BROWN,
 BROWN, BROWN, BROWN, BLACK, BROWN, BROWN, BROWN, BROWN, BROWN, BROWN, BROWN, BLACK, BROWN, BROWN, BROWN, BROWN,
 BROWN, BROWN, BROWN, BLACK, BROWN, BROWN, BROWN, BROWN, BROWN, BROWN, BROWN, BLACK, BROWN, BROWN, BROWN, BROWN,
 BROWN, BROWN, BROWN, BLACK, BROWN, BROWN, BROWN, BROWN, BROWN, BROWN, BROWN, BLACK, BROWN, BROWN, BROWN, BROWN,
 BROWN, BROWN, BROWN, BLACK, BROWN, BROWN, BROWN, BROWN, BROWN, BROWN, BROWN, BLACK, BROWN, BROWN, BROWN, BROWN,
 BROWN, BROWN, BROWN, BLACK, BROWN, BROWN, BROWN, BROWN, BROWN, BROWN, BROWN, BLACK, BROWN, BROWN, BROWN, BROWN,
 BROWN, BROWN, BROWN, BLACK, BROWN, BROWN, BROWN, BROWN, BROWN, BROWN, BROWN, BLACK, BROWN, BROWN, BROWN, BROWN,
 BROWN, BROWN, BROWN, BLACK, BROWN, BROWN, BROWN, BROWN, BROWN, BROWN, BROWN, BLACK, BROWN, BROWN, BROWN, BROWN,
 BROWN, BROWN, BROWN, BLACK, BROWN, BROWN, BROWN, BROWN, BROWN, BROWN, BROWN, BLACK, BROWN, BROWN, BROWN, BROWN,
 BLACK, BLACK, BLACK, BLACK, BLACK, BLACK, BLACK, BLACK, BLACK, BLACK, BLACK, BLACK, BLACK, BLACK, BLACK, BLACK,
 BLACK, BLACK, BLACK, BLACK, BLACK, BLACK, BLACK, BLACK, BLACK, BLACK, BLACK, BLACK, BLACK, BLACK, BLACK, BLACK,
 BLACK, BLACK, BLACK, BLACK, BLACK, BLACK, BLACK, BLACK, BLACK, BLACK, BLACK, BLACK, BLACK, BLACK, BLACK, BLACK,
 BLACK, BLACK, BLACK, BLACK, BLACK, BLACK, BLACK, BLACK, BLACK, BLACK, BLACK, BLACK, BLACK, BLACK, BLACK, BLACK,
 BLACK, BLACK, BLACK, BLACK, BLACK, BLACK, BLACK, BLACK, BLACK, BLACK, BLACK, BLACK, BLACK, BLACK, BLACK, BLACK,
 BROWN, BROWN, BROWN, BROWN, BROWN, BROWN, BROWN, BLACK, BROWN, BROWN, BROWN, BROWN, BROWN, BROWN, BROWN, BLACK,
 BROWN, BROWN, BROWN, BROWN, BROWN, BROWN, BROWN, BLACK, BROWN, BROWN, BROWN, BROWN, BROWN, BROWN, BROWN, BLACK,
 BROWN, BROWN, BROWN, BROWN, BROWN, BROWN, BROWN, BLACK, BROWN, BROWN, BROWN, BROWN, BROWN, BROWN, BROWN, BLACK,
 BROWN, BROWN, BROWN, BROWN, BROWN, BROWN, BROWN, BLACK, BROWN, BROWN, BROWN, BROWN, BROWN, BROWN, BROWN, BLACK,
 BROWN, BROWN, BROWN, BROWN, BROWN, BROWN, BROWN, BLACK, BROWN, BROWN, BROWN, BROWN, BROWN, BROWN, BROWN, BLACK,
 BROWN, BROWN, BROWN, BROWN, BROWN, BROWN, BROWN, BLACK, BROWN, BROWN, BROWN, BROWN, BROWN, BROWN, BROWN, BLACK,
 BROWN, BROWN, BROWN, BROWN, BROWN, BROWN, BROWN, BLACK, BROWN, BROWN, BROWN, BROWN, BROWN, BROWN, BROWN, BLACK,
 BROWN, BROWN, BROWN, BROWN, BROWN, BROWN, BROWN, BLACK, BROWN, BROWN, BROWN, BROWN, BROWN, BROWN, BROWN, BLACK,
 BROWN, BROWN, BROWN, BROWN, BROWN, BROWN, BROWN, BLACK, BROWN, BROWN, BROWN, BROWN, BROWN, BROWN, BROWN, BLACK,
 BROWN, BROWN, BROWN, BROWN, BROWN, BROWN, BROWN, BLACK, BROWN, BROWN, BROWN, BROWN, BROWN, BROWN, BROWN, BLACK,
 BROWN, BROWN, BROWN, BROWN, BROWN, BROWN, BROWN, BLACK, BROWN, BROWN, BROWN, BROWN, BROWN, BROWN, BROWN, BLACK,
 BROWN, BROWN, BROWN, BROWN, BROWN, BROWN, BROWN, BLACK, BROWN, BROWN, BROWN, BROWN, BROWN, BROWN, BROWN, BLACK,
 BROWN, BROWN, BROWN, BROWN, BROWN, BROWN, BROWN, BLACK, BROWN, BROWN, BROWN, BROWN, BROWN, BROWN, BROWN, BLACK,
 BROWN, BROWN, BROWN, BROWN, BROWN, BROWN, BROWN, BLACK, BROWN, BROWN, BROWN, BROWN, BROWN, BROWN, BROWN, BLACK,
 BROWN, BROWN, BROWN, BROWN, BROWN, BROWN, BROWN, BLACK, BROWN, BROWN, BROWN, BROWN, BROWN, BROWN, BROWN, BLACK,
 BLACK, BLACK, BLACK, PEACH, PEACH, PEACH, PEACH, PEACH, PEACH, PEACH, PEACH, PEACH, BLACK, BLACK, BLACK, BLACK,
 BLACK, BLACK, BLACK, PEACH, PEACH, PEACH, PEACH, PEACH, PEACH, PEACH, PEACH, PEACH, BLACK, BLACK, BLACK, BLACK,
 BLACK, BLACK, BLACK, PEACH, PEACH, PEACH, PEACH, PEACH, PEACH, PEACH, PEACH, PEACH, BLACK, BLACK, BLACK, BLACK,
 BLACK, BLACK, BLACK, PEACH, PEACH, PEACH, PEACH, PEACH, PEACH, PEACH, PEACH, PEACH, BLACK, BLACK, BLACK, BLACK,
 BLACK, BLACK, BLACK, PEACH, PEACH, PEACH, PEACH, PEACH, PEACH, PEACH, PEACH, PEACH, BLACK, BLACK, BLACK, BLACK,
 BROWN, BROWN, BROWN, PEACH, SKY, SKY, SKY, SKY, SKY, SKY, SKY, PEACH, BROWN, BROWN, BROWN, BROWN,
 BROWN, BROWN, BROWN, PEACH, BROWN, BROWN, BROWN, BROWN, BROWN, BROWN, BROWN, PEACH, BROWN, BROWN, BROWN, BROWN,
 BROWN, BROWN, BROWN, PEACH, BROWN, BROWN, BROWN, BROWN, BROWN, BROWN, BROWN, PEACH, BROWN, BROWN, BROWN, BROWN,
 BROWN, BROWN, BROWN, PEACH, BROWN, BROWN, BROWN, BROWN, BROWN, BROWN, BROWN, PEACH, BROWN, BROWN, BROWN, BROWN,
 BROWN, BROWN, BROWN, PEACH, SKY, SKY, SKY, SKY, SKY, SKY, SKY, PEACH, BROWN, BROWN, BROWN, BROWN,
 BROWN, BROWN, BROWN, PEACH, SKY, SKY, SKY, SKY, SKY, SKY, SKY, PEACH, BROWN, BROWN, BROWN, BROWN,
 BROWN, BROWN, BROWN, PEACH, BROWN, BROWN, BROWN, BROWN, BROWN, BROWN, BROWN, PEACH, BROWN, BROWN, BROWN, BROWN,
 BROWN, BROWN, BROWN, PEACH, BROWN, BROWN, BROWN, BROWN, BROWN, BROWN, BROWN, PEACH, BROWN, BROWN, BROWN, BROWN,
 BROWN, BROWN, BROWN, PEACH, BROWN, BROWN, BROWN, BROWN, BROWN, BROWN, BROWN, PEACH, BROWN, BROWN, BROWN, BROWN,
 BROWN, BROWN, BROWN, PEACH, SKY, SKY, SKY, SKY, SKY, SKY, SKY, PEACH, BROWN, BROWN, BROWN, BROWN,
 BROWN, BROWN, BROWN, PEACH, SKY, SKY, SKY, SKY, SKY, SKY, SKY, PEACH, BROWN, BROWN, BROWN, BROWN,
 BROWN, BROWN, BROWN, PEACH, BROWN, BROWN, BROWN, BROWN, BROWN, BROWN, BROWN, PEACH, BROWN, BROWN, BROWN, BROWN,
 BROWN, BROWN, BROWN, PEACH, BROWN, BROWN, BROWN, BROWN, BROWN, BROWN, BROWN, PEACH, BROWN, BROWN, BROWN, BROWN,
 BROWN, BROWN, BROWN, PEACH, BROWN, BROWN, BROWN, BROWN, BROWN, BROWN, BROWN, PEACH, BROWN, BROWN, BROWN, BROWN,
 BROWN, BROWN, BROWN, PEACH, SKY, SKY, SKY, SKY, SKY, SKY, SKY, PEACH, BROWN, BROWN, BROWN, BROWN,
 BROWN, BROWN, BROWN, PEACH, SKY, SKY, SKY, SKY, SKY, SKY, SKY, PEACH, BROWN, BROWN, BROWN, BROWN,
 BROWN, BROWN, BROWN, PEACH, BLACK, BLACK, BLACK, BLACK, BLACK, BLACK, BLACK, PEACH, BROWN, BROWN, BROWN, BROWN,
 BROWN, BROWN, BROWN, PEACH, BLACK, BLACK, BLACK, BLACK, BLACK, BLACK, BLACK, PEACH, BROWN, BROWN, BROWN, BROWN,
 BROWN, BROWN, BROWN, PEACH, BLACK, BLACK, BLACK, BLACK, BLACK, BLACK, BLACK, PEACH, BROWN, BROWN, BROWN, BROWN,
 BROWN, BROWN, BROWN, PEACH, SKY, SKY, SKY, SKY, SKY, SKY, SKY, PEACH, BROWN, BROWN, BROWN, BROWN,
 BROWN, BROWN, BROWN, PEACH, SKY, SKY, SKY, SKY, SKY, SKY, SKY, PEACH, BROWN, BROWN, BROWN, BROWN,
 BROWN, BROWN, BROWN, PEACH, BROWN, BROWN, BROWN, BLACK, BROWN, BROWN, BROWN, PEACH, BROWN, BROWN, BROWN, BROWN,
 BROWN, BROWN, BROWN, PEACH, BROWN, BROWN, BROWN, BLACK, BROWN, BROWN, BROWN, PEACH, BROWN, BROWN, BROWN, BROWN,
 BROWN, BROWN, BROWN, PEACH, BROWN, BROWN, BROWN, BLACK, BROWN, BROWN, BROWN, PEACH, BROWN, BROWN, BROWN, BROWN,
 BROWN, BROWN, BROWN, PEACH, SKY, SKY, SKY, SKY, SKY, SKY, SKY, PEACH, BROWN, BROWN, BROWN, BROWN,
 BROWN, BROWN, BROWN, PEACH, SKY, SKY, SKY, SKY, SKY, SKY, SKY, PEACH, BROWN, BROWN, BROWN, BROWN,
 BROWN, BROWN, BROWN, PEACH, BROWN, BROWN, BROWN, BLACK, BROWN, BROWN, BROWN, PEACH, BROWN, BROWN, BROWN, BROWN,
 BROWN, BROWN, BROWN, PEACH, BROWN, BROWN, BROWN, BLACK, BROWN, BROWN, BROWN, PEACH, BROWN, BROWN, BROWN, BROWN,
 BROWN, BROWN, BROWN, PEACH, BROWN, BROWN, BROWN, BLACK, BROWN, BROWN, BROWN, PEACH, BROWN, BROWN, BROWN, BROWN,
 BROWN, BROWN, BROWN, PEACH, SKY, SKY, SKY, SKY, SKY, SKY, SKY, PEACH, BROWN, BROWN, BROWN, BROWN,
 PEACH, PEACH, PEACH, PEACH, SKY, SKY, SKY, SKY, SKY, SKY, SKY, PEACH, PEACH, PEACH, PEACH, PEACH,
 PEACH, PEACH, PEACH, PEACH, BROWN, BROWN, BROWN, BLACK, BROWN, BROWN, BROWN, PEACH, PEACH, PEACH, PEACH, PEACH,
 PEACH, PEACH, PEACH, PEACH, BROWN, BROWN, BROWN, BLACK, BROWN, BROWN, BROWN, PEACH, PEACH, PEACH, PEACH, PEACH,
 PEACH, PEACH, PEACH, PEACH, BROWN, BROWN, BROWN, BLACK, BROWN, BROWN, BROWN, PEACH, PEACH, PEACH, PEACH, PEACH,
 PEACH, PEACH, PEACH, PEACH, SKY, SKY, SKY, SKY, SKY, SKY, SKY, PEACH, PEACH, PEACH, PEACH, PEACH,
};
const unsigned char castle_top_pixels[] = {
 BLACK, BLACK, BLACK, BLACK, BLACK, BLACK, BLACK, BLACK, BLACK, BLACK, BLACK, BLACK, BLACK, BLACK, BLACK, BLACK,
 BLACK, BLACK, BLACK, BLACK, BLACK, BLACK, BLACK, BLACK, BLACK, BLACK, BLACK, BLACK, BLACK, BLACK, BLACK, BLACK,
 BLACK, BLACK, BLACK, BLACK, BLACK, BLACK, BLACK, BLACK, BLACK, BLACK, BLACK, BLACK, BLACK, BLACK, BLACK, BLACK,
 BROWN, BROWN, BROWN, BLACK, BROWN, BROWN, BROWN, BROWN, BLACK, BLACK, BLACK, BLACK, BLACK, BLACK, BLACK, BLACK,
 BROWN, BROWN, BROWN, BLACK, BROWN, BROWN, BROWN, BROWN, BROWN, BROWN, BROWN, BLACK, BROWN, BROWN, BROWN, BROWN,
 BLACK, BLACK, BLACK, BLACK, BLACK, BLACK, BLACK, BLACK, BROWN, BROWN, BROWN, BLACK, BROWN, BROWN, BROWN, BROWN,
 BROWN, BROWN, BROWN, BLACK, BROWN, BROWN, BROWN, BROWN, BLACK, BLACK, BLACK, BLACK, BLACK, BLACK, BLACK, BLACK,
 BROWN, BROWN, BROWN, BLACK, BROWN, BROWN, BROWN, BROWN, BROWN, BROWN, BROWN, BLACK, BROWN, BROWN, BROWN, BROWN,
 BLACK, BLACK, BLACK, BLACK, BLACK, BLACK, BLACK, BLACK, BROWN, BROWN, BROWN, BLACK, BROWN, BROWN, BROWN, BROWN,
 BROWN, BROWN, BROWN, BLACK, BROWN, BROWN, BROWN, BROWN, BLACK, BLACK, BLACK, BLACK, BLACK, BLACK, BLACK, BLACK,
 BROWN, BROWN, BROWN, BLACK, BROWN, BROWN, BROWN, BROWN, BROWN, BROWN, BROWN, BLACK, BROWN, BROWN, BROWN, BROWN,
 BLACK, BLACK, BLACK, BLACK, BLACK, BLACK, BLACK, BLACK, BROWN, BROWN, BROWN, BLACK, BROWN, BROWN, BROWN, BROWN,
 BLACK, BLACK, BLACK, BLACK, BLACK, BLACK, BLACK, BLACK, BLACK, BLACK, BLACK, BLACK, BLACK, BLACK, BLACK, BLACK,
 BLACK, BLACK, BLACK, BLACK, BLACK, BLACK, BLACK, BLACK, BLACK, BLACK, BLACK, BLACK, BLACK, BLACK, BLACK, BLACK,
 BLACK, BLACK, BLACK, BLACK, BLACK, BLACK, BLACK, BLACK, BLACK, BLACK, BLACK, BLACK, BLACK, BLACK, BLACK, BLACK,
 BROWN, BROWN, BROWN, BROWN, BROWN, BROWN, BROWN, BLACK, BLACK, BLACK, BLACK, BLACK, BLACK, BLACK, BLACK, BLACK,
 BROWN, BROWN, BROWN, BROWN, BROWN, BROWN, BROWN, BLACK, BROWN, BROWN, BROWN, BROWN, BROWN, BROWN, BROWN, BLACK,
 BLACK, BLACK, BLACK, BLACK, BLACK, BLACK, BLACK, BLACK, BROWN, BROWN, BROWN, BROWN, BROWN, BROWN, BROWN, BLACK,
 BROWN, BROWN, BROWN, BROWN, BROWN, BROWN, BROWN, BLACK, BLACK, BLACK, BLACK, BLACK, BLACK, BLACK, BLACK, BLACK,
 BROWN, BROWN, BROWN, BROWN, BROWN, BROWN, BROWN, BLACK, BROWN, BROWN, BROWN, BROWN, BROWN, BROWN, BROWN, BLACK,
 BLACK, BLACK, BLACK, BLACK, BLACK, BLACK, BLACK, BLACK, BROWN, BROWN, BROWN, BROWN, BROWN, BROWN, BROWN, BLACK,
 BROWN, BROWN, BROWN, BROWN, BROWN, BROWN, BROWN, BLACK, BLACK, BLACK, BLACK, BLACK, BLACK, BLACK, BLACK, BLACK,
 BROWN, BROWN, BROWN, BROWN, BROWN, BROWN, BROWN, BLACK, BROWN, BROWN, BROWN, BROWN, BROWN, BROWN, BROWN, BLACK,
 BLACK, BLACK, BLACK, BLACK, BLACK, BLACK, BLACK, BLACK, BROWN, BROWN, BROWN, BROWN, BROWN, BROWN, BROWN, BLACK,
 BLACK, BLACK, BLACK, BLACK, BLACK, BLACK, BLACK, BLACK, BLACK, BLACK, BLACK, BLACK, BLACK, BLACK, BLACK, BLACK,
 BLACK, BLACK, BLACK, BLACK, BLACK, BLACK, BLACK, BLACK, BLACK, BLACK, BLACK, BLACK, BLACK, BLACK, BLACK, BLACK,
 BLACK, BLACK, BLACK, BLACK, BLACK, BLACK, BLACK, BLACK, BLACK, BLACK, BLACK, BLACK, BLACK, BLACK, BLACK, BLACK,
 BROWN, BROWN, BROWN, BLACK, BROWN, BROWN, BROWN, BROWN, BLACK, BLACK, BLACK, BLACK, BLACK, BLACK, BLACK, BLACK,
 BROWN, BROWN, BROWN, BLACK, BROWN, BROWN, BROWN, BROWN, BROWN, BROWN, BROWN, BLACK, BROWN, BROWN, BROWN, BROWN,
 BLACK, BLACK, BLACK, BLACK, BLACK, BLACK, BLACK, BLACK, BROWN, BROWN, BROWN, BLACK, BROWN, BROWN, BROWN, BROWN,
 BROWN, BROWN, BROWN, BLACK, BROWN, BROWN, BROWN, BROWN, BLACK, BLACK, BLACK, BLACK, BLACK, BLACK, BLACK, BLACK,
 BROWN, BROWN, BROWN, BLACK, BROWN, BROWN, BROWN, BROWN, BROWN, BROWN, BROWN, BLACK, BROWN, BROWN, BROWN, BROWN,
 BLACK, BLACK, BLACK, BLACK, BLACK, BLACK, BLACK, BLACK, BROWN, BROWN, BROWN, BLACK, BROWN, BROWN, BROWN, BROWN,
 BROWN, BROWN, BROWN, BLACK, BROWN, BROWN, BROWN, BROWN, BLACK, BLACK, BLACK, BLACK, BLACK, BLACK, BLACK, BLACK,
 BROWN, BROWN, BROWN, BLACK, BROWN, BROWN, BROWN, BROWN, BROWN, BROWN, BROWN, BLACK, BROWN, BROWN, BROWN, BROWN,
 BLACK, BLACK, BLACK, BLACK, BLACK, BLACK, BLACK, BLACK, BROWN, BROWN, BROWN, BLACK, BROWN, BROWN, BROWN, BROWN,
 BLACK, BLACK, BLACK, BLACK, BLACK, BLACK, BLACK, BLACK, BLACK, BLACK, BLACK, BLACK, BLACK, BLACK, BLACK, BLACK,
 BLACK, BLACK, BLACK, BLACK, BLACK, BLACK, BLACK, BLACK, BLACK, BLACK, BLACK, BLACK, BLACK, BLACK, BLACK, BLACK,
 BLACK, BLACK, BLACK, BLACK, BLACK, BLACK, BLACK, BLACK, BLACK, BLACK, BLACK, BLACK, BLACK, BLACK, BLACK, BLACK,
 BROWN, BROWN, BROWN, BROWN, BROWN, BROWN, BROWN, BLACK, BLACK, BLACK, BLACK, BLACK, BLACK, BLACK, BLACK, BLACK,
 BROWN, BROWN, BROWN, BROWN, BROWN, BROWN, BROWN, BLACK, BROWN, BROWN, BROWN, BROWN, BROWN, BROWN, BROWN, BLACK,
 BLACK, BLACK, BLACK, BLACK, BLACK, BLACK, BLACK, BLACK, BROWN, BROWN, BROWN, BROWN, BROWN, BROWN, BROWN, BLACK,
 BROWN, BROWN, BROWN, BROWN, BROWN, BROWN, BROWN, BLACK, BLACK, BLACK, BLACK, BLACK, BLACK, BLACK, BLACK, BLACK,
 BROWN, BROWN, BROWN, BROWN, BROWN, BROWN, BROWN, BLACK, BROWN, BROWN, BROWN, BROWN, BROWN, BROWN, BROWN, BLACK,
 BLACK, BLACK, BLACK, BLACK, BLACK, BLACK, BLACK, BLACK, BROWN, BROWN, BROWN, BROWN, BROWN, BROWN, BROWN, BLACK,
 BROWN, BROWN, BROWN, BROWN, BROWN, BROWN, BROWN, BLACK, BLACK, BLACK, BLACK, BLACK, BLACK, BLACK, BLACK, BLACK,
 BROWN, BROWN, BROWN, BROWN, BROWN, BROWN, BROWN, BLACK, BROWN, BROWN, BROWN, BROWN, BROWN, BROWN, BROWN, BLACK,
 BLACK, BLACK, BLACK, BLACK, BLACK, BLACK, BLACK, BLACK, BROWN, BROWN, BROWN, BROWN, BROWN, BROWN, BROWN, BLACK,
 BLACK, BLACK, BLACK, BLACK, BLACK, BLACK, BLACK, BLACK, BLACK, BLACK, BLACK, BLACK, BLACK, BLACK, BLACK, BLACK,
 BLACK, BLACK, BLACK, BLACK, BLACK, BLACK, BLACK, BLACK, BLACK, BLACK, BLACK, BLACK, BLACK, BLACK, BLACK, BLACK,
 BLACK, BLACK, BLACK, BLACK, BLACK, BLACK, BLACK, BLACK, BLACK, BLACK, BLACK, BLACK, BLACK, BLACK, BLACK, BLACK,
 BROWN, BROWN, BROWN, BLACK, BROWN, BROWN, BROWN, BROWN, BROWN, BROWN, BROWN, BLACK, BROWN, BROWN, BROWN, BROWN,
 BROWN, BROWN, BROWN, BLACK, BROWN, BROWN, BROWN, BROWN, BROWN, BROWN, BROWN, BLACK, BROWN, BROWN, BROWN, BROWN,
 BROWN, BROWN, BROWN, BLACK, BROWN, BROWN, BROWN, BROWN, BROWN, BROWN, BROWN, BLACK, BROWN, BROWN, BROWN, BROWN,
 BROWN, BROWN, BROWN, BLACK, BROWN, BROWN, BROWN, BROWN, BROWN, BROWN, BROWN, BLACK, BROWN, BROWN, BROWN, BROWN,
 BROWN, BROWN, BROWN, BLACK, BROWN, BROWN, BROWN, BROWN, BROWN, BROWN, BROWN, BLACK, BROWN, BROWN, BROWN, BROWN,
 BROWN, BROWN, BROWN, BLACK, BROWN, BROWN, BROWN, BROWN, BROWN, BROWN, BROWN, BLACK, BROWN, BROWN, BROWN, BROWN,
 BROWN, BROWN, BROWN, BLACK, BROWN, BROWN, BROWN, BROWN, BROWN, BROWN, BROWN, BLACK, BROWN, BROWN, BROWN, BROWN,
 BROWN, BROWN, BROWN, BLACK, BROWN, BROWN, BROWN, BROWN, BROWN, BROWN, BROWN, BLACK, BROWN, BROWN, BROWN, BROWN,
 BROWN, BROWN, BROWN, BLACK, BROWN, BROWN, BROWN, BROWN, BROWN, BROWN, BROWN, BLACK, BROWN, BROWN, BROWN, BROWN,
 BLACK, BLACK, BLACK, BLACK, BLACK, BLACK, BLACK, BLACK, BLACK, BLACK, BLACK, BLACK, BLACK, BLACK, BLACK, BLACK,
 BLACK, BLACK, BLACK, BLACK, BLACK, BLACK, BLACK, BLACK, BLACK, BLACK, BLACK, BLACK, BLACK, BLACK, BLACK, BLACK,
 BLACK, BLACK, BLACK, BLACK, BLACK, BLACK, BLACK, BLACK, BLACK, BLACK, BLACK, BLACK, BLACK, BLACK, BLACK, BLACK,
 BROWN, BROWN, BROWN, BROWN, BROWN, BROWN, BROWN, BLACK, BROWN, BROWN, BROWN, BROWN, BROWN, BROWN, BROWN, BLACK,
 BROWN, BROWN, BROWN, BROWN, BROWN, BROWN, BROWN, BLACK, BROWN, BROWN, BROWN, BROWN, BROWN, BROWN, BROWN, BLACK,
 BROWN, BROWN, BROWN, BROWN, BROWN, BROWN, BROWN, BLACK, BROWN, BROWN, BROWN, BROWN, BROWN, BROWN, BROWN, BLACK,
 BROWN, BROWN, BROWN, BROWN, BROWN, BROWN, BROWN, BLACK, BROWN, BROWN, BROWN, BROWN, BROWN, BROWN, BROWN, BLACK,
 BROWN, BROWN, BROWN, BROWN, BROWN, BROWN, BROWN, BLACK, BROWN, BROWN, BROWN, BROWN, BROWN, BROWN, BROWN, BLACK,
 BROWN, BROWN, BROWN, BROWN, BROWN, BROWN, BROWN, BLACK, BROWN, BROWN, BROWN, BROWN, BROWN, BROWN, BROWN, BLACK,
 BROWN, BROWN, BROWN, BROWN, BROWN, BROWN, BROWN, BLACK, BROWN, BROWN, BROWN, BROWN, BROWN, BROWN, BROWN, BLACK,
 BROWN, BROWN, BROWN, BROWN, BROWN, BROWN, BROWN, BLACK, BROWN, BROWN, BROWN, BROWN, BROWN, BROWN, BROWN, BLACK,
 BROWN, BROWN, BROWN, BROWN, BROWN, BROWN, BROWN, BLACK, BROWN, BROWN, BROWN, BROWN, BROWN, BROWN, BROWN, BLACK,
 BLACK, BLACK, BLACK, PEACH, PEACH, PEACH, PEACH, PEACH, PEACH, PEACH, PEACH, PEACH, BLACK, BLACK, BLACK, BLACK,
 BLACK, BLACK, BLACK, PEACH, PEACH, PEACH, PEACH, PEACH, PEACH, PEACH, PEACH, PEACH, BLACK, BLACK, BLACK, BLACK,
 BLACK, BLACK, BLACK, PEACH, PEACH, PEACH, PEACH, PEACH, PEACH, PEACH, PEACH, PEACH, BLACK, BLACK, BLACK, BLACK,
 BROWN, BROWN, BROWN, PEACH, SKY, SKY, SKY, SKY, SKY, SKY, SKY, PEACH, BROWN, BROWN, BROWN, BROWN,
 BROWN, BROWN, BROWN, PEACH, SKY, SKY, SKY, SKY, SKY, SKY, SKY, PEACH, BROWN, BROWN, BROWN, BROWN,
 BROWN, BROWN, BROWN, PEACH, SKY, SKY, SKY, SKY, SKY, SKY, SKY, PEACH, BROWN, BROWN, BROWN, BROWN,
 BROWN, BROWN, BROWN, PEACH, SKY, SKY, SKY, SKY, SKY, SKY, SKY, PEACH, BROWN, BROWN, BROWN, BROWN,
 BROWN, BROWN, BROWN, PEACH, SKY, SKY, SKY, SKY, SKY, SKY, SKY, PEACH, BROWN, BROWN, BROWN, BROWN,
 BROWN, BROWN, BROWN, PEACH, SKY, SKY, SKY, SKY, SKY, SKY, SKY, PEACH, BROWN, BROWN, BROWN, BROWN,
 BROWN, BROWN, BROWN, PEACH, SKY, SKY, SKY, SKY, SKY, SKY, SKY, PEACH, BROWN, BROWN, BROWN, BROWN,
 BROWN, BROWN, BROWN, PEACH, SKY, SKY, SKY, SKY, SKY, SKY, SKY, PEACH, BROWN, BROWN, BROWN, BROWN,
 BROWN, BROWN, BROWN, PEACH, SKY, SKY, SKY, SKY, SKY, SKY, SKY, PEACH, BROWN, BROWN, BROWN, BROWN,
 BROWN, BROWN, BROWN, PEACH, SKY, SKY, SKY, SKY, SKY, SKY, SKY, PEACH, BROWN, BROWN, BROWN, BROWN,
 BROWN, BROWN, BROWN, PEACH, SKY, SKY, SKY, SKY, SKY, SKY, SKY, PEACH, BROWN, BROWN, BROWN, BROWN,
 BROWN, BROWN, BROWN, PEACH, SKY, SKY, SKY, SKY, SKY, SKY, SKY, PEACH, BROWN, BROWN, BROWN, BROWN,
 BROWN, BROWN, BROWN, PEACH, SKY, SKY, SKY, SKY, SKY, SKY, SKY, PEACH, BROWN, BROWN, BROWN, BROWN,
 BROWN, BROWN, BROWN, PEACH, SKY, SKY, SKY, SKY, SKY, SKY, SKY, PEACH, BROWN, BROWN, BROWN, BROWN,
 BROWN, BROWN, BROWN, PEACH, SKY, SKY, SKY, SKY, SKY, SKY, SKY, PEACH, BROWN, BROWN, BROWN, BROWN,
 BROWN, BROWN, BROWN, PEACH, SKY, SKY, SKY, SKY, SKY, SKY, SKY, PEACH, BROWN, BROWN, BROWN, BROWN,
 BROWN, BROWN, BROWN, PEACH, SKY, SKY, SKY, SKY, SKY, SKY, SKY, PEACH, BROWN, BROWN, BROWN, BROWN,
 BROWN, BROWN, BROWN, PEACH, SKY, SKY, SKY, SKY, SKY, SKY, SKY, PEACH, BROWN, BROWN, BROWN, BROWN,
 PEACH, PEACH, PEACH, PEACH, SKY, SKY, SKY, SKY, SKY, SKY, SKY, PEACH, PEACH, PEACH, PEACH, PEACH,
 PEACH, PEACH, PEACH, PEACH, SKY, SKY, SKY, SKY, SKY, SKY, SKY, PEACH, PEACH, PEACH, PEACH, PEACH,
 PEACH, PEACH, PEACH, PEACH, SKY, SKY, SKY, SKY, SKY, SKY, SKY, PEACH, PEACH, PEACH, PEACH, PEACH,

};
const unsigned char cloud_1_pixels[] = {
 SKY, SKY, SKY, SKY, SKY, BLACK, BLACK, BLACK, SKY, SKY, SKY, SKY, BLACK, WHITE, WHITE, WHITE,
 SKY, SKY, SKY, SKY, BLACK, WHITE, WHITE, BLUE, SKY, SKY, SKY, BLACK, WHITE, WHITE, BLUE, WHITE,
 SKY, SKY, BLACK, WHITE, WHITE, BLUE, WHITE, WHITE, SKY, BLACK, WHITE, WHITE, WHITE, WHITE, WHITE, WHITE,
 BLACK, WHITE, WHITE, WHITE, WHITE, WHITE, WHITE, WHITE, BLACK, WHITE, WHITE, WHITE, WHITE, WHITE, WHITE, WHITE,
 SKY, BLACK, BLACK, WHITE, WHITE, WHITE, WHITE, WHITE, SKY, SKY, SKY, WHITE, WHITE, WHITE, WHITE, WHITE,
 SKY, SKY, SKY, BLACK, WHITE, WHITE, WHITE, WHITE, SKY, SKY, SKY, SKY, BLACK, WHITE, WHITE, WHITE,
 SKY, SKY, SKY, SKY, SKY, BLACK, BLACK, BLACK,
};
const unsigned char cloud_2_pixels[] = {
 SKY, SKY, SKY, BLACK, BLACK, BLACK, SKY, SKY, SKY, SKY, BLACK, BLACK, BLACK, BLACK, SKY, SKY,
 SKY, BLACK, BLACK, WHITE, WHITE, WHITE, BLACK, SKY, BLACK, BLACK, WHITE, WHITE, WHITE, WHITE, BLACK, BLACK,
 BLACK, WHITE, WHITE, WHITE, WHITE, WHITE, WHITE, BLACK, WHITE, WHITE, WHITE, WHITE, WHITE, WHITE, WHITE, WHITE,
 WHITE, WHITE, WHITE, WHITE, BLUE, BLUE, WHITE, WHITE, WHITE, WHITE, BLUE, BLUE, BLUE, WHITE, WHITE, WHITE,
 WHITE, WHITE, BLUE, BLUE, BLUE, BLUE, BLUE, BLUE, WHITE, BLUE, BLUE, BLUE, BLUE, BLUE, WHITE, WHITE,
 BLUE, BLUE, BLUE, WHITE, WHITE, WHITE, BLUE, BLUE, BLUE, BLUE, WHITE, WHITE, WHITE, WHITE, BLUE, WHITE,
 WHITE, BLUE, WHITE, WHITE, WHITE, WHITE, WHITE, WHITE, BLUE, WHITE, WHITE, WHITE, WHITE, WHITE, WHITE, WHITE,
 WHITE, WHITE, WHITE, WHITE, WHITE, WHITE, WHITE, WHITE, WHITE, BLUE, WHITE, WHITE, WHITE, WHITE, WHITE, WHITE,
 WHITE, WHITE, WHITE, WHITE, WHITE, WHITE, WHITE, WHITE, WHITE, WHITE, WHITE, WHITE, WHITE, WHITE, WHITE, WHITE,
 WHITE, WHITE, WHITE, WHITE, WHITE, WHITE, WHITE, WHITE, WHITE, WHITE, WHITE, WHITE, WHITE, WHITE, WHITE, WHITE,
 WHITE, WHITE, WHITE, WHITE, WHITE, WHITE, WHITE, WHITE, WHITE, WHITE, WHITE, WHITE, WHITE, WHITE, WHITE, WHITE,
 WHITE, WHITE, WHITE, WHITE, WHITE, WHITE, WHITE, WHITE, WHITE, WHITE, WHITE, WHITE, WHITE, WHITE, WHITE, WHITE,
 WHITE, WHITE, WHITE, WHITE, WHITE, WHITE, WHITE, WHITE, WHITE, WHITE, WHITE, WHITE, WHITE, WHITE, WHITE, WHITE,
 WHITE, WHITE, WHITE, WHITE, WHITE, WHITE, WHITE, WHITE, WHITE, WHITE, WHITE, WHITE, WHITE, WHITE, WHITE, WHITE,
 WHITE, WHITE, WHITE, WHITE, WHITE, WHITE, WHITE, WHITE, WHITE, WHITE, WHITE, WHITE, WHITE, WHITE, WHITE, WHITE,
 WHITE, WHITE, WHITE, WHITE, WHITE, WHITE, WHITE, WHITE, WHITE, WHITE, WHITE, WHITE, WHITE, WHITE, WHITE, WHITE,
 BLACK, WHITE, WHITE, WHITE, BLUE, WHITE, WHITE, WHITE, WHITE, WHITE, WHITE, WHITE, WHITE, WHITE, WHITE, BLACK,
 SKY, BLACK, WHITE, WHITE, WHITE, BLUE, BLUE, WHITE, WHITE, WHITE, BLUE, WHITE, WHITE, WHITE, WHITE, BLACK,
 SKY, SKY, BLACK, WHITE, WHITE, WHITE, WHITE, WHITE, WHITE, BLUE, WHITE, WHITE, WHITE, WHITE, WHITE, BLACK,
 SKY, SKY, BLACK, WHITE, WHITE, WHITE, WHITE, WHITE, WHITE, WHITE, WHITE, WHITE, BLACK, WHITE, BLACK, SKY,
 SKY, SKY, BLACK, WHITE, WHITE, WHITE, WHITE, WHITE, WHITE, WHITE, WHITE, BLACK, SKY, BLACK, SKY, SKY,
 SKY, SKY, SKY, BLACK, BLACK, WHITE, WHITE, WHITE, WHITE, WHITE, WHITE, BLACK, SKY, SKY, SKY, SKY,
 SKY, SKY, SKY, SKY, SKY, BLACK, WHITE, WHITE, WHITE, WHITE, BLACK, SKY, SKY, SKY, SKY, SKY,
 SKY, SKY, SKY, SKY, SKY, SKY, BLACK, BLACK, BLACK, BLACK, SKY, SKY, SKY, SKY, SKY, SKY,
};
const unsigned char cloud_3_pixels[] = {
 SKY, BLACK, BLACK, SKY, SKY, SKY, SKY, SKY, BLACK, WHITE, WHITE, BLACK, BLACK, SKY, SKY, SKY,
 WHITE, WHITE, WHITE, WHITE, WHITE, BLACK, BLACK, SKY, WHITE, WHITE, WHITE, WHITE, WHITE, WHITE, WHITE, SKY,
 WHITE, WHITE, WHITE, WHITE, WHITE, WHITE, WHITE, BLACK, WHITE, WHITE, WHITE, WHITE, WHITE, WHITE, BLACK, SKY,
 WHITE, WHITE, WHITE, WHITE, WHITE, BLACK, SKY, SKY, WHITE, WHITE, WHITE, WHITE, WHITE, WHITE, BLACK, SKY,
 WHITE, WHITE, WHITE, WHITE, WHITE, WHITE, WHITE, BLACK, WHITE, WHITE, WHITE, WHITE, WHITE, WHITE, WHITE, BLACK,
 WHITE, WHITE, WHITE, WHITE, WHITE, BLACK, WHITE, BLACK, WHITE, WHITE, WHITE, WHITE, BLACK, SKY, BLACK, SKY,
 WHITE, BLACK, WHITE, WHITE, BLACK, SKY, SKY, SKY, BLACK, SKY, BLACK, WHITE, BLACK, SKY, SKY, SKY,
 BLACK, SKY, SKY, BLACK, SKY, SKY, SKY, SKY,
};
const unsigned char flag_ball_pixels[] = {
 SKY, SKY, BLACK, BLACK, BLACK, BLACK, SKY, SKY, SKY, BLACK, GREEN, GREEN, GREEN, GREEN, BLACK, SKY,
 BLACK, GREEN, GREEN, GREEN, GREEN, GREEN, GREEN, BLACK, BLACK, GREEN, GREEN, GREEN, GREEN, GREEN, GREEN, BLACK,
 BLACK, LIGHT_GREEN, GREEN, GREEN, GREEN, GREEN, GREEN, BLACK, BLACK, LIGHT_GREEN, GREEN, GREEN, GREEN, GREEN, GREEN, BLACK,
 SKY, BLACK, LIGHT_GREEN, GREEN, GREEN, GREEN, BLACK, SKY, SKY, SKY, BLACK, BLACK, BLACK, BLACK, SKY, SKY,
};
const unsigned char pipe_pixels[] = {
 BLACK, LIGHT_GREEN, LIGHT_GREEN, LIGHT_GREEN, GREEN, GREEN, LIGHT_GREEN, LIGHT_GREEN, LIGHT_GREEN, LIGHT_GREEN, LIGHT_GREEN, GREEN, LIGHT_GREEN, LIGHT_GREEN, GREEN, GREEN,
 GREEN, GREEN, GREEN, GREEN, GREEN, GREEN, GREEN, LIGHT_GREEN, GREEN, LIGHT_GREEN, LIGHT_GREEN, BLACK, BLACK, LIGHT_GREEN, LIGHT_GREEN, LIGHT_GREEN,
 GREEN, GREEN, LIGHT_GREEN, LIGHT_GREEN, LIGHT_GREEN, LIGHT_GREEN, LIGHT_GREEN, GREEN, LIGHT_GREEN, LIGHT_GREEN, GREEN, GREEN, GREEN, GREEN, GREEN, GREEN,
 GREEN, GREEN, LIGHT_GREEN, GREEN, LIGHT_GREEN, LIGHT_GREEN, LIGHT_GREEN, BLACK, BLACK, LIGHT_GREEN, LIGHT_GREEN, LIGHT_GREEN, GREEN, GREEN, LIGHT_GREEN, LIGHT_GREEN,
 LIGHT_GREEN, LIGHT_GREEN, LIGHT_GREEN, GREEN, LIGHT_GREEN, LIGHT_GREEN, GREEN, GREEN, GREEN, GREEN, GREEN, GREEN, GREEN, GREEN, GREEN, LIGHT_GREEN,
 GREEN, LIGHT_GREEN, LIGHT_GREEN, BLACK, BLACK, LIGHT_GREEN, LIGHT_GREEN, LIGHT_GREEN, GREEN, GREEN, LIGHT_GREEN, LIGHT_GREEN, LIGHT_GREEN, LIGHT_GREEN, LIGHT_GREEN, GREEN,
 LIGHT_GREEN, LIGHT_GREEN, GREEN, GREEN, GREEN, GREEN, GREEN, GREEN, GREEN, GREEN, LIGHT_GREEN, GREEN, LIGHT_GREEN, LIGHT_GREEN, LIGHT_GREEN, BLACK,
 BLACK, LIGHT_GREEN, LIGHT_GREEN, LIGHT_GREEN, GREEN, GREEN, LIGHT_GREEN, LIGHT_GREEN, LIGHT_GREEN, LIGHT_GREEN, LIGHT_GREEN, GREEN, LIGHT_GREEN, LIGHT_GREEN, GREEN, GREEN,
 GREEN, GREEN, GREEN, GREEN, GREEN, GREEN, GREEN, LIGHT_GREEN, GREEN, LIGHT_GREEN, LIGHT_GREEN, BLACK, BLACK, LIGHT_GREEN, LIGHT_GREEN, LIGHT_GREEN,
 GREEN, GREEN, LIGHT_GREEN, LIGHT_GREEN, LIGHT_GREEN, LIGHT_GREEN, LIGHT_GREEN, GREEN, LIGHT_GREEN, LIGHT_GREEN, GREEN, GREEN, GREEN, GREEN, GREEN, GREEN,
 GREEN, GREEN, LIGHT_GREEN, GREEN, LIGHT_GREEN, LIGHT_GREEN, LIGHT_GREEN, BLACK, BLACK, LIGHT_GREEN, LIGHT_GREEN, LIGHT_GREEN, GREEN, GREEN, LIGHT_GREEN, LIGHT_GREEN,
 LIGHT_GREEN, LIGHT_GREEN, LIGHT_GREEN, GREEN, LIGHT_GREEN, LIGHT_GREEN, GREEN, GREEN, GREEN, GREEN, GREEN, GREEN, GREEN, GREEN, GREEN, LIGHT_GREEN,
 GREEN, LIGHT_GREEN, LIGHT_GREEN, BLACK, BLACK, LIGHT_GREEN, LIGHT_GREEN, LIGHT_GREEN, GREEN, GREEN, LIGHT_GREEN, LIGHT_GREEN, LIGHT_GREEN, LIGHT_GREEN, LIGHT_GREEN, GREEN,
 LIGHT_GREEN, LIGHT_GREEN, GREEN, GREEN, GREEN, GREEN, GREEN, GREEN, GREEN, GREEN, LIGHT_GREEN, GREEN, LIGHT_GREEN, LIGHT_GREEN, LIGHT_GREEN, BLACK,
 BLACK, LIGHT_GREEN, LIGHT_GREEN, LIGHT_GREEN, GREEN, GREEN, LIGHT_GREEN, LIGHT_GREEN, LIGHT_GREEN, LIGHT_GREEN, LIGHT_GREEN, GREEN, LIGHT_GREEN, LIGHT_GREEN, GREEN, GREEN,
 GREEN, GREEN, GREEN, GREEN, GREEN, GREEN, GREEN, LIGHT_GREEN, GREEN, LIGHT_GREEN, LIGHT_GREEN, BLACK, BLACK, LIGHT_GREEN, LIGHT_GREEN, LIGHT_GREEN,
 GREEN, GREEN, LIGHT_GREEN, LIGHT_GREEN, LIGHT_GREEN, LIGHT_GREEN, LIGHT_GREEN, GREEN, LIGHT_GREEN, LIGHT_GREEN, GREEN, GREEN, GREEN, GREEN, GREEN, GREEN,
 GREEN, GREEN, LIGHT_GREEN, GREEN, LIGHT_GREEN, LIGHT_GREEN, LIGHT_GREEN, BLACK, BLACK, LIGHT_GREEN, LIGHT_GREEN, LIGHT_GREEN, GREEN, GREEN, LIGHT_GREEN, LIGHT_GREEN,
 LIGHT_GREEN, LIGHT_GREEN, LIGHT_GREEN, GREEN, LIGHT_GREEN, LIGHT_GREEN, GREEN, GREEN, GREEN, GREEN, GREEN, GREEN, GREEN, GREEN, GREEN, LIGHT_GREEN,
 GREEN, LIGHT_GREEN, LIGHT_GREEN, BLACK, BLACK, LIGHT_GREEN, LIGHT_GREEN, LIGHT_GREEN, GREEN, GREEN, LIGHT_GREEN, LIGHT_GREEN, LIGHT_GREEN, LIGHT_GREEN, LIGHT_GREEN, GREEN,
 LIGHT_GREEN, LIGHT_GREEN, GREEN, GREEN, GREEN, GREEN, GREEN, GREEN, GREEN, GREEN, LIGHT_GREEN, GREEN, LIGHT_GREEN, LIGHT_GREEN, LIGHT_GREEN, BLACK,
 BLACK, LIGHT_GREEN, LIGHT_GREEN, LIGHT_GREEN, GREEN, GREEN, LIGHT_GREEN, LIGHT_GREEN, LIGHT_GREEN, LIGHT_GREEN, LIGHT_GREEN, GREEN, LIGHT_GREEN, LIGHT_GREEN, GREEN, GREEN,
 GREEN, GREEN, GREEN, GREEN, GREEN, GREEN, GREEN, LIGHT_GREEN, GREEN, LIGHT_GREEN, LIGHT_GREEN, BLACK, BLACK, LIGHT_GREEN, LIGHT_GREEN, LIGHT_GREEN,
 GREEN, GREEN, LIGHT_GREEN, LIGHT_GREEN, LIGHT_GREEN, LIGHT_GREEN, LIGHT_GREEN, GREEN, LIGHT_GREEN, LIGHT_GREEN, GREEN, GREEN, GREEN, GREEN, GREEN, GREEN,
 GREEN, GREEN, LIGHT_GREEN, GREEN, LIGHT_GREEN, LIGHT_GREEN, LIGHT_GREEN, BLACK, BLACK, LIGHT_GREEN, LIGHT_GREEN, LIGHT_GREEN, GREEN, GREEN, LIGHT_GREEN, LIGHT_GREEN,
 LIGHT_GREEN, LIGHT_GREEN, LIGHT_GREEN, GREEN, LIGHT_GREEN, LIGHT_GREEN, GREEN, GREEN, GREEN, GREEN, GREEN, GREEN, GREEN, GREEN, GREEN, LIGHT_GREEN,
 GREEN, LIGHT_GREEN, LIGHT_GREEN, BLACK, BLACK, LIGHT_GREEN, LIGHT_GREEN, LIGHT_GREEN, GREEN, GREEN, LIGHT_GREEN, LIGHT_GREEN, LIGHT_GREEN, LIGHT_GREEN, LIGHT_GREEN, GREEN,
 LIGHT_GREEN, LIGHT_GREEN, GREEN, GREEN, GREEN, GREEN, GREEN, GREEN, GREEN, GREEN, LIGHT_GREEN, GREEN, LIGHT_GREEN, LIGHT_GREEN, LIGHT_GREEN, BLACK,
};
const unsigned char pipe_top_pixels[] = {
 SKY, SKY, BLACK, BLACK, BLACK, BLACK, BLACK, BLACK, BLACK, BLACK, BLACK, BLACK, BLACK, BLACK, BLACK, BLACK,
 BLACK, BLACK, BLACK, BLACK, BLACK, BLACK, BLACK, BLACK, BLACK, BLACK, BLACK, BLACK, BLACK, BLACK, SKY, SKY,
 BLACK, BLACK, BLACK, BLACK, BLACK, BLACK, BLACK, BLACK, BLACK, BLACK, BLACK, BLACK, BLACK, BLACK, BLACK, BLACK,
 BLACK, BLACK, BLACK, BLACK, BLACK, BLACK, BLACK, BLACK, BLACK, BLACK, BLACK, BLACK, BLACK, BLACK, BLACK, BLACK,
 BLACK, LIGHT_GREEN, LIGHT_GREEN, LIGHT_GREEN, GREEN, GREEN, LIGHT_GREEN, LIGHT_GREEN, LIGHT_GREEN, LIGHT_GREEN, LIGHT_GREEN, LIGHT_GREEN, GREEN, LIGHT_GREEN, LIGHT_GREEN, GREEN,
 GREEN, GREEN, GREEN, GREEN, GREEN, GREEN, GREEN, GREEN, GREEN, LIGHT_GREEN, GREEN, LIGHT_GREEN, GREEN, LIGHT_GREEN, LIGHT_GREEN, BLACK,
 BLACK, LIGHT_GREEN, LIGHT_GREEN, LIGHT_GREEN, GREEN, GREEN, LIGHT_GREEN, LIGHT_GREEN, LIGHT_GREEN, LIGHT_GREEN, LIGHT_GREEN, LIGHT_GREEN, GREEN, LIGHT_GREEN, LIGHT_GREEN, GREEN,
 GREEN, GREEN, GREEN, GREEN, GREEN, GREEN, GREEN, GREEN, GREEN, GREEN, LIGHT_GREEN, GREEN, LIGHT_GREEN, LIGHT_GREEN, LIGHT_GREEN, BLACK,
 BLACK, LIGHT_GREEN, LIGHT_GREEN, LIGHT_GREEN, GREEN, GREEN, LIGHT_GREEN, LIGHT_GREEN, LIGHT_GREEN, LIGHT_GREEN, LIGHT_GREEN, LIGHT_GREEN, GREEN, LIGHT_GREEN, LIGHT_GREEN, GREEN,
 GREEN, GREEN, GREEN, GREEN, GREEN, GREEN, GREEN, GREEN, GREEN, LIGHT_GREEN, GREEN, LIGHT_GREEN, GREEN, LIGHT_GREEN, LIGHT_GREEN, BLACK,
 BLACK, LIGHT_GREEN, LIGHT_GREEN, LIGHT_GREEN, GREEN, GREEN, LIGHT_GREEN, LIGHT_GREEN, LIGHT_GREEN, LIGHT_GREEN, LIGHT_GREEN, LIGHT_GREEN, GREEN, LIGHT_GREEN, LIGHT_GREEN, GREEN,
 GREEN, GREEN, GREEN, GREEN, GREEN, GREEN, GREEN, GREEN, GREEN, GREEN, LIGHT_GREEN, GREEN, LIGHT_GREEN, LIGHT_GREEN, LIGHT_GREEN, BLACK,
 BLACK, LIGHT_GREEN, LIGHT_GREEN, LIGHT_GREEN, GREEN, GREEN, LIGHT_GREEN, LIGHT_GREEN, LIGHT_GREEN, LIGHT_GREEN, LIGHT_GREEN, LIGHT_GREEN, GREEN, LIGHT_GREEN, LIGHT_GREEN, GREEN,
 GREEN, GREEN, GREEN, GREEN, GREEN, GREEN, GREEN, GREEN, GREEN, LIGHT_GREEN, GREEN, LIGHT_GREEN, GREEN, LIGHT_GREEN, LIGHT_GREEN, BLACK,
 BLACK, LIGHT_GREEN, LIGHT_GREEN, LIGHT_GREEN, GREEN, GREEN, LIGHT_GREEN, LIGHT_GREEN, LIGHT_GREEN, LIGHT_GREEN, LIGHT_GREEN, LIGHT_GREEN, GREEN, LIGHT_GREEN, LIGHT_GREEN, GREEN,
 GREEN, GREEN, GREEN, GREEN, GREEN, GREEN, GREEN, GREEN, GREEN, GREEN, LIGHT_GREEN, GREEN, LIGHT_GREEN, LIGHT_GREEN, LIGHT_GREEN, BLACK,
 BLACK, LIGHT_GREEN, LIGHT_GREEN, LIGHT_GREEN, GREEN, GREEN, LIGHT_GREEN, LIGHT_GREEN, LIGHT_GREEN, LIGHT_GREEN, LIGHT_GREEN, LIGHT_GREEN, GREEN, LIGHT_GREEN, LIGHT_GREEN, GREEN,
 GREEN, GREEN, GREEN, GREEN, GREEN, GREEN, GREEN, GREEN, GREEN, LIGHT_GREEN, GREEN, LIGHT_GREEN, GREEN, LIGHT_GREEN, LIGHT_GREEN, BLACK,
 BLACK, LIGHT_GREEN, LIGHT_GREEN, LIGHT_GREEN, GREEN, GREEN, LIGHT_GREEN, LIGHT_GREEN, LIGHT_GREEN, LIGHT_GREEN, LIGHT_GREEN, LIGHT_GREEN, GREEN, LIGHT_GREEN, LIGHT_GREEN, GREEN,
 GREEN, GREEN, GREEN, GREEN, GREEN, GREEN, GREEN, GREEN, GREEN, GREEN, LIGHT_GREEN, GREEN, LIGHT_GREEN, LIGHT_GREEN, LIGHT_GREEN, BLACK,
 BLACK, LIGHT_GREEN, LIGHT_GREEN, LIGHT_GREEN, GREEN, GREEN, LIGHT_GREEN, LIGHT_GREEN, LIGHT_GREEN, LIGHT_GREEN, LIGHT_GREEN, LIGHT_GREEN, GREEN, LIGHT_GREEN, LIGHT_GREEN, GREEN,
 GREEN, GREEN, GREEN, GREEN, GREEN, GREEN, GREEN, GREEN, GREEN, LIGHT_GREEN, GREEN, LIGHT_GREEN, GREEN, LIGHT_GREEN, LIGHT_GREEN, BLACK,
 BLACK, LIGHT_GREEN, LIGHT_GREEN, LIGHT_GREEN, GREEN, GREEN, LIGHT_GREEN, LIGHT_GREEN, LIGHT_GREEN, LIGHT_GREEN, LIGHT_GREEN, LIGHT_GREEN, GREEN, LIGHT_GREEN, LIGHT_GREEN, GREEN,
 GREEN, GREEN, GREEN, GREEN, GREEN, GREEN, GREEN, GREEN, GREEN, GREEN, LIGHT_GREEN, GREEN, LIGHT_GREEN, LIGHT_GREEN, LIGHT_GREEN, BLACK,
 BLACK, LIGHT_GREEN, LIGHT_GREEN, LIGHT_GREEN, GREEN, GREEN, LIGHT_GREEN, LIGHT_GREEN, LIGHT_GREEN, LIGHT_GREEN, LIGHT_GREEN, LIGHT_GREEN, GREEN, LIGHT_GREEN, LIGHT_GREEN, GREEN,
 GREEN, GREEN, GREEN, GREEN, GREEN, GREEN, GREEN, GREEN, GREEN, LIGHT_GREEN, GREEN, LIGHT_GREEN, GREEN, LIGHT_GREEN, LIGHT_GREEN, BLACK,
 BLACK, GREEN, GREEN, GREEN, GREEN, GREEN, LIGHT_GREEN, LIGHT_GREEN, LIGHT_GREEN, LIGHT_GREEN, LIGHT_GREEN, LIGHT_GREEN, GREEN, GREEN, GREEN, GREEN,
 GREEN, GREEN, GREEN, GREEN, GREEN, GREEN, GREEN, GREEN, GREEN, GREEN, GREEN, GREEN, GREEN, GREEN, GREEN, BLACK,
 BLACK, LIGHT_GREEN, LIGHT_GREEN, LIGHT_GREEN, LIGHT_GREEN, LIGHT_GREEN, LIGHT_GREEN, LIGHT_GREEN, LIGHT_GREEN, LIGHT_GREEN, LIGHT_GREEN, LIGHT_GREEN, LIGHT_GREEN, LIGHT_GREEN, LIGHT_GREEN, LIGHT_GREEN,
 LIGHT_GREEN, LIGHT_GREEN, LIGHT_GREEN, LIGHT_GREEN, LIGHT_GREEN, LIGHT_GREEN, LIGHT_GREEN, LIGHT_GREEN, LIGHT_GREEN, LIGHT_GREEN, LIGHT_GREEN, LIGHT_GREEN, LIGHT_GREEN, LIGHT_GREEN, LIGHT_GREEN, BLACK,
 BLACK, BLACK, BLACK, BLACK, BLACK, BLACK, BLACK, BLACK, BLACK, BLACK, BLACK, BLACK, BLACK, BLACK, BLACK, BLACK,
 BLACK, BLACK, BLACK, BLACK, BLACK, BLACK, BLACK, BLACK, BLACK, BLACK, BLACK, BLACK, BLACK, BLACK, BLACK, BLACK,
};
const unsigned char pole_pixels[] = {
 LIGHT_GREEN, LIGHT_GREEN, LIGHT_GREEN, LIGHT_GREEN, LIGHT_GREEN, LIGHT_GREEN, LIGHT_GREEN, LIGHT_GREEN, LIGHT_GREEN, LIGHT_GREEN, LIGHT_GREEN, LIGHT_GREEN, LIGHT_GREEN, LIGHT_GREEN, LIGHT_GREEN, LIGHT_GREEN,
 LIGHT_GREEN, LIGHT_GREEN, LIGHT_GREEN, LIGHT_GREEN, LIGHT_GREEN, LIGHT_GREEN, LIGHT_GREEN, LIGHT_GREEN, LIGHT_GREEN, LIGHT_GREEN, LIGHT_GREEN, LIGHT_GREEN, LIGHT_GREEN, LIGHT_GREEN, LIGHT_GREEN, LIGHT_GREEN,
 LIGHT_GREEN, LIGHT_GREEN, LIGHT_GREEN, LIGHT_GREEN, LIGHT_GREEN, LIGHT_GREEN, LIGHT_GREEN, LIGHT_GREEN, LIGHT_GREEN, LIGHT_GREEN, LIGHT_GREEN, LIGHT_GREEN, LIGHT_GREEN, LIGHT_GREEN, LIGHT_GREEN, LIGHT_GREEN,
 LIGHT_GREEN, LIGHT_GREEN, LIGHT_GREEN, LIGHT_GREEN, LIGHT_GREEN, LIGHT_GREEN, LIGHT_GREEN, LIGHT_GREEN, LIGHT_GREEN, LIGHT_GREEN, LIGHT_GREEN, LIGHT_GREEN, LIGHT_GREEN, LIGHT_GREEN, LIGHT_GREEN, LIGHT_GREEN,
 LIGHT_GREEN, LIGHT_GREEN, LIGHT_GREEN, LIGHT_GREEN, LIGHT_GREEN, LIGHT_GREEN, LIGHT_GREEN, LIGHT_GREEN, LIGHT_GREEN, LIGHT_GREEN, LIGHT_GREEN, LIGHT_GREEN, LIGHT_GREEN, LIGHT_GREEN, LIGHT_GREEN, LIGHT_GREEN,
 LIGHT_GREEN, LIGHT_GREEN, LIGHT_GREEN, LIGHT_GREEN, LIGHT_GREEN, LIGHT_GREEN, LIGHT_GREEN, LIGHT_GREEN, LIGHT_GREEN, LIGHT_GREEN, LIGHT_GREEN, LIGHT_GREEN, LIGHT_GREEN, LIGHT_GREEN, LIGHT_GREEN, LIGHT_GREEN,
 LIGHT_GREEN, LIGHT_GREEN, LIGHT_GREEN, LIGHT_GREEN, LIGHT_GREEN, LIGHT_GREEN, LIGHT_GREEN, LIGHT_GREEN, LIGHT_GREEN, LIGHT_GREEN, LIGHT_GREEN, LIGHT_GREEN, LIGHT_GREEN, LIGHT_GREEN, LIGHT_GREEN, LIGHT_GREEN,
 LIGHT_GREEN, LIGHT_GREEN, LIGHT_GREEN, LIGHT_GREEN, LIGHT_GREEN, LIGHT_GREEN, LIGHT_GREEN, LIGHT_GREEN, LIGHT_GREEN, LIGHT_GREEN, LIGHT_GREEN, LIGHT_GREEN, LIGHT_GREEN, LIGHT_GREEN, LIGHT_GREEN, LIGHT_GREEN,
};
const unsigned char question_block_1_pixels[] = {
 BLACK, BLACK, BLACK, BLACK, BLACK, BLACK, BLACK, BLACK, BLACK, BLACK, BLACK, BLACK, BLACK, BLACK, BLACK, BLACK,
 BROWN, ORANGE, ORANGE, ORANGE, ORANGE, ORANGE, ORANGE, ORANGE, ORANGE, ORANGE, ORANGE, ORANGE, ORANGE, ORANGE, ORANGE, BLACK,
 BROWN, ORANGE, BLACK, ORANGE, ORANGE, ORANGE, ORANGE, ORANGE, BLACK, BLACK, ORANGE, ORANGE, ORANGE, BLACK, ORANGE, BLACK,
 BROWN, ORANGE, ORANGE, ORANGE, ORANGE, ORANGE, ORANGE, BROWN, BROWN, BLACK, ORANGE, ORANGE, ORANGE, ORANGE, ORANGE, BLACK,
 BROWN, ORANGE, ORANGE, ORANGE, ORANGE, ORANGE, ORANGE, BROWN, BROWN, ORANGE, ORANGE, ORANGE, ORANGE, ORANGE, ORANGE, BLACK,
 BROWN, ORANGE, ORANGE, ORANGE, ORANGE, ORANGE, ORANGE, ORANGE, BLACK, BLACK, ORANGE, ORANGE, ORANGE, ORANGE, ORANGE, BLACK,
 BROWN, ORANGE, ORANGE, ORANGE, ORANGE, ORANGE, ORANGE, BROWN, BROWN, BLACK, ORANGE, ORANGE, ORANGE, ORANGE, ORANGE, BLACK,
 BROWN, ORANGE, ORANGE, ORANGE, ORANGE, ORANGE, ORANGE, BROWN, BROWN, BLACK, BLACK, BLACK, ORANGE, ORANGE, ORANGE, BLACK,
 BROWN, ORANGE, ORANGE, ORANGE, ORANGE, BLACK, BLACK, ORANGE, BROWN, BROWN, BROWN, BLACK, ORANGE, ORANGE, ORANGE, BLACK,
 BROWN, ORANGE, ORANGE, ORANGE, BROWN, BROWN, BLACK, ORANGE, ORANGE, BROWN, BROWN, BLACK, ORANGE, ORANGE, ORANGE, BLACK,
 BROWN, ORANGE, ORANGE, ORANGE, BROWN, BROWN, BLACK, ORANGE, ORANGE, BROWN, BROWN, BLACK, ORANGE, ORANGE, ORANGE, BLACK,
 BROWN, ORANGE, ORANGE, ORANGE, BROWN, BROWN, BLACK, BLACK, BLACK, BROWN, BROWN, ORANGE, ORANGE, ORANGE, ORANGE, BLACK,
 BROWN, ORANGE, ORANGE, ORANGE, ORANGE, BROWN, BROWN, BROWN, BROWN, BROWN, ORANGE, ORANGE, ORANGE, ORANGE, ORANGE, BLACK,
 BROWN, ORANGE, BLACK, ORANGE, ORANGE, ORANGE, ORANGE, ORANGE, ORANGE, ORANGE, ORANGE, ORANGE, ORANGE, BLACK, ORANGE, BLACK,
 BROWN, ORANGE, ORANGE, ORANGE, ORANGE, ORANGE, ORANGE, ORANGE, ORANGE, ORANGE, ORANGE, ORANGE, ORANGE, ORANGE, ORANGE, BLACK,
 CLEAR, BROWN, BROWN, BROWN, BROWN, BROWN, BROWN, BROWN, BROWN, BROWN, BROWN, BROWN, BROWN, BROWN, BROWN, CLEAR,
};
const unsigned char shrub_1_pixels[] = {
 SKY, BLACK, LIGHT_GREEN, LIGHT_GREEN, LIGHT_GREEN, LIGHT_GREEN, LIGHT_GREEN, BLACK, LIGHT_GREEN, LIGHT_GREEN, LIGHT_GREEN, LIGHT_GREEN, LIGHT_GREEN, LIGHT_GREEN, BLACK, LIGHT_GREEN,
 LIGHT_GREEN, LIGHT_GREEN, LIGHT_GREEN, LIGHT_GREEN, LIGHT_GREEN, SKY, BLACK, BLACK, LIGHT_GREEN, LIGHT_GREEN, LIGHT_GREEN, LIGHT_GREEN, SKY, SKY, SKY, LIGHT_GREEN,
 LIGHT_GREEN, LIGHT_GREEN, LIGHT_GREEN, SKY, SKY, SKY, BLACK, LIGHT_GREEN, LIGHT_GREEN, LIGHT_GREEN, SKY, SKY, SKY, SKY, BLACK, LIGHT_GREEN,
 LIGHT_GREEN, SKY, SKY, SKY, SKY, SKY, BLACK, BLACK,
};
const unsigned char shrub_2_pixels[] = {
 LIGHT_GREEN, LIGHT_GREEN, LIGHT_GREEN, LIGHT_GREEN, LIGHT_GREEN, LIGHT_GREEN, LIGHT_GREEN, LIGHT_GREEN, LIGHT_GREEN, LIGHT_GREEN, LIGHT_GREEN, LIGHT_GREEN, LIGHT_GREEN, LIGHT_GREEN, LIGHT_GREEN, LIGHT_GREEN,
 LIGHT_GREEN, LIGHT_GREEN, LIGHT_GREEN, LIGHT_GREEN, LIGHT_GREEN, LIGHT_GREEN, LIGHT_GREEN, LIGHT_GREEN, LIGHT_GREEN, LIGHT_GREEN, LIGHT_GREEN, LIGHT_GREEN, LIGHT_GREEN, LIGHT_GREEN, LIGHT_GREEN, LIGHT_GREEN,
 LIGHT_GREEN, LIGHT_GREEN, LIGHT_GREEN, LIGHT_GREEN, LIGHT_GREEN, LIGHT_GREEN, LIGHT_GREEN, LIGHT_GREEN, LIGHT_GREEN, LIGHT_GREEN, LIGHT_GREEN, LIGHT_GREEN, LIGHT_GREEN, LIGHT_GREEN, LIGHT_GREEN, LIGHT_GREEN,
 LIGHT_GREEN, LIGHT_GREEN, LIGHT_GREEN, LIGHT_GREEN, LIGHT_GREEN, LIGHT_GREEN, LIGHT_GREEN, LIGHT_GREEN, LIGHT_GREEN, LIGHT_GREEN, LIGHT_GREEN, LIGHT_GREEN, LIGHT_GREEN, LIGHT_GREEN, LIGHT_GREEN, LIGHT_GREEN,
 LIGHT_GREEN, LIGHT_GREEN, LIGHT_GREEN, LIGHT_GREEN, LIGHT_GREEN, LIGHT_GREEN, LIGHT_GREEN, LIGHT_GREEN, LIGHT_GREEN, LIGHT_GREEN, LIGHT_GREEN, LIGHT_GREEN, LIGHT_GREEN, LIGHT_GREEN, LIGHT_GREEN, LIGHT_GREEN,
 LIGHT_GREEN, LIGHT_GREEN, LIGHT_GREEN, LIGHT_GREEN, LIGHT_GREEN, LIGHT_GREEN, LIGHT_GREEN, LIGHT_GREEN, LIGHT_GREEN, LIGHT_GREEN, LIGHT_GREEN, LIGHT_GREEN, LIGHT_GREEN, LIGHT_GREEN, LIGHT_GREEN, LIGHT_GREEN,
 LIGHT_GREEN, LIGHT_GREEN, LIGHT_GREEN, LIGHT_GREEN, LIGHT_GREEN, LIGHT_GREEN, LIGHT_GREEN, LIGHT_GREEN, LIGHT_GREEN, LIGHT_GREEN, LIGHT_GREEN, LIGHT_GREEN, LIGHT_GREEN, LIGHT_GREEN, LIGHT_GREEN, LIGHT_GREEN,
 BLACK, LIGHT_GREEN, LIGHT_GREEN, LIGHT_GREEN, LIGHT_GREEN, LIGHT_GREEN, LIGHT_GREEN, LIGHT_GREEN, LIGHT_GREEN, LIGHT_GREEN, LIGHT_GREEN, LIGHT_GREEN, LIGHT_GREEN, LIGHT_GREEN, LIGHT_GREEN, LIGHT_GREEN,
 SKY, BLACK, LIGHT_GREEN, LIGHT_GREEN, LIGHT_GREEN, GREEN, LIGHT_GREEN, LIGHT_GREEN, LIGHT_GREEN, LIGHT_GREEN, LIGHT_GREEN, LIGHT_GREEN, LIGHT_GREEN, LIGHT_GREEN, LIGHT_GREEN, LIGHT_GREEN,
 SKY, SKY, BLACK, LIGHT_GREEN, LIGHT_GREEN, LIGHT_GREEN, GREEN, GREEN, LIGHT_GREEN, LIGHT_GREEN, LIGHT_GREEN, GREEN, LIGHT_GREEN, LIGHT_GREEN, LIGHT_GREEN, LIGHT_GREEN,
 SKY, SKY, SKY, BLACK, LIGHT_GREEN, LIGHT_GREEN, LIGHT_GREEN, LIGHT_GREEN, LIGHT_GREEN, LIGHT_GREEN, GREEN, LIGHT_GREEN, LIGHT_GREEN, LIGHT_GREEN, LIGHT_GREEN, LIGHT_GREEN,
 SKY, SKY, SKY, BLACK, LIGHT_GREEN, LIGHT_GREEN, LIGHT_GREEN, LIGHT_GREEN, LIGHT_GREEN, LIGHT_GREEN, LIGHT_GREEN, LIGHT_GREEN, LIGHT_GREEN, BLACK, LIGHT_GREEN, BLACK,
 SKY, SKY, SKY, BLACK, LIGHT_GREEN, LIGHT_GREEN, LIGHT_GREEN, LIGHT_GREEN, LIGHT_GREEN, LIGHT_GREEN, LIGHT_GREEN, LIGHT_GREEN, BLACK, SKY, BLACK, SKY,
 SKY, SKY, SKY, SKY, BLACK, BLACK, LIGHT_GREEN, LIGHT_GREEN, LIGHT_GREEN, LIGHT_GREEN, LIGHT_GREEN, LIGHT_GREEN, BLACK, SKY, SKY, SKY,
 SKY, SKY, SKY, SKY, SKY, SKY, BLACK, LIGHT_GREEN, LIGHT_GREEN, LIGHT_GREEN, LIGHT_GREEN, BLACK, SKY, SKY, SKY, SKY,
 SKY, SKY, SKY, SKY, SKY, SKY, SKY, BLACK, BLACK, BLACK, BLACK, SKY, SKY, SKY, SKY, SKY,
};
const unsigned char shrub_3_pixels[] = {
 LIGHT_GREEN, LIGHT_GREEN, LIGHT_GREEN, LIGHT_GREEN, LIGHT_GREEN, LIGHT_GREEN, LIGHT_GREEN, BLACK, SKY, LIGHT_GREEN, LIGHT_GREEN, LIGHT_GREEN, LIGHT_GREEN, LIGHT_GREEN, LIGHT_GREEN, LIGHT_GREEN,
 LIGHT_GREEN, BLACK, LIGHT_GREEN, LIGHT_GREEN, LIGHT_GREEN, LIGHT_GREEN, LIGHT_GREEN, LIGHT_GREEN, LIGHT_GREEN, LIGHT_GREEN, BLACK, LIGHT_GREEN, LIGHT_GREEN, LIGHT_GREEN, LIGHT_GREEN, LIGHT_GREEN,
 LIGHT_GREEN, BLACK, LIGHT_GREEN, BLACK, LIGHT_GREEN, LIGHT_GREEN, LIGHT_GREEN, LIGHT_GREEN, LIGHT_GREEN, BLACK, SKY, BLACK, SKY, LIGHT_GREEN, LIGHT_GREEN, BLACK,
 LIGHT_GREEN, LIGHT_GREEN, BLACK, SKY, SKY, SKY, LIGHT_GREEN, BLACK, SKY, BLACK, LIGHT_GREEN, BLACK, SKY, SKY, SKY, LIGHT_GREEN,
 BLACK, SKY, SKY, BLACK, SKY, SKY, SKY, SKY, BLACK, SKY, SKY, SKY, SKY, SKY, SKY, SKY,
 SKY, BLACK, SKY, SKY, SKY, SKY, SKY, SKY, SKY, SKY, BLACK, SKY, SKY, SKY, SKY, SKY,
 SKY, SKY, SKY,
};
const unsigned char strong_block_pixels[] = {
 BLACK, BLACK, BLACK, BLACK, BLACK, BLACK, BLACK, BLACK, BLACK, BLACK, BLACK, BLACK, BLACK, BLACK, BLACK, BROWN,
 PEACH, BLACK, BLACK, BLACK, BLACK, BLACK, BLACK, BLACK, BLACK, BLACK, BLACK, BLACK, BLACK, BLACK, BROWN, BLACK,
 PEACH, PEACH, BLACK, BLACK, BLACK, BLACK, BLACK, BLACK, BLACK, BLACK, BLACK, BLACK, BLACK, BROWN, BLACK, BLACK,
 PEACH, PEACH, PEACH, BLACK, BLACK, BLACK, BLACK, BLACK, BLACK, BLACK, BLACK, BLACK, BROWN, BLACK, BLACK, BLACK,
 PEACH, PEACH, PEACH, PEACH, BROWN, BROWN, BROWN, BROWN, BROWN, BROWN, BROWN, BROWN, BLACK, BLACK, BLACK, BLACK,
 PEACH, PEACH, PEACH, PEACH, BROWN, BROWN, BROWN, BROWN, BROWN, BROWN, BROWN, BROWN, BLACK, BLACK, BLACK, BLACK,
 PEACH, PEACH, PEACH, PEACH, BROWN, BROWN, BROWN, BROWN, BROWN, BROWN, BROWN, BROWN, BLACK, BLACK, BLACK, BLACK,
 PEACH, PEACH, PEACH, PEACH, BROWN, BROWN, BROWN, BROWN, BROWN, BROWN, BROWN, BROWN, BLACK, BLACK, BLACK, BLACK,
 PEACH, PEACH, PEACH, PEACH, BROWN, BROWN, BROWN, BROWN, BROWN, BROWN, BROWN, BROWN, BLACK, BLACK, BLACK, BLACK,
 PEACH, PEACH, PEACH, PEACH, BROWN, BROWN, BROWN, BROWN, BROWN, BROWN, BROWN, BROWN, BLACK, BLACK, BLACK, BLACK,
 PEACH, PEACH, PEACH, PEACH, BROWN, BROWN, BROWN, BROWN, BROWN, BROWN, BROWN, BROWN, BLACK, BLACK, BLACK, BLACK,
 PEACH, PEACH, PEACH, PEACH, BROWN, BROWN, BROWN, BROWN, BROWN, BROWN, BROWN, BROWN, BLACK, BLACK, BLACK, BLACK,
 PEACH, PEACH, PEACH, BROWN, PEACH, PEACH, PEACH, PEACH, PEACH, PEACH, PEACH, PEACH, BLACK, BLACK, BLACK, BLACK,
 PEACH, PEACH, BROWN, PEACH, PEACH, PEACH, PEACH, PEACH, PEACH, PEACH, PEACH, PEACH, PEACH, BLACK, BLACK, BLACK,
 PEACH, BROWN, PEACH, PEACH, PEACH, PEACH, PEACH, PEACH, PEACH, PEACH, PEACH, PEACH, PEACH, PEACH, BLACK, BLACK,
 BROWN, PEACH, PEACH, PEACH, PEACH, PEACH, PEACH, PEACH, PEACH, PEACH, PEACH, PEACH, PEACH, PEACH, PEACH, BLACK,
};

const unsigned char mario_1_stand_pixels[] = {
 CLEAR, CLEAR, OLIVE, OLIVE, OLIVE, OLIVE, CLEAR, CLEAR, CLEAR, CLEAR, OLIVE, OLIVE, OLIVE, OLIVE, CLEAR, CLEAR,
 CLEAR, CLEAR, CLEAR, OLIVE, OLIVE, OLIVE, CLEAR, CLEAR, CLEAR, CLEAR, OLIVE, OLIVE, OLIVE, CLEAR, CLEAR, CLEAR,
 CLEAR, CLEAR, CLEAR, CLEAR, RED, RED, RED, CLEAR, CLEAR, RED, RED, RED, CLEAR, CLEAR, CLEAR, CLEAR,
 CLEAR, CLEAR, ORANGE, ORANGE, RED, RED, RED, RED, RED, RED, RED, RED, ORANGE, ORANGE, CLEAR, CLEAR,
 CLEAR, CLEAR, ORANGE, ORANGE, ORANGE, RED, RED, RED, RED, RED, RED, ORANGE, ORANGE, ORANGE, CLEAR, CLEAR,
 CLEAR, CLEAR, ORANGE, ORANGE, OLIVE, RED, ORANGE, RED, RED, ORANGE, RED, OLIVE, ORANGE, ORANGE, CLEAR, CLEAR,
 CLEAR, CLEAR, OLIVE, OLIVE, OLIVE, OLIVE, RED, RED, RED, RED, OLIVE, OLIVE, OLIVE, OLIVE, CLEAR, CLEAR,
 CLEAR, CLEAR, CLEAR, OLIVE, OLIVE, OLIVE, RED, OLIVE, OLIVE, RED, OLIVE, OLIVE, OLIVE, CLEAR, CLEAR, CLEAR,
 CLEAR, CLEAR, CLEAR, CLEAR, OLIVE, OLIVE, RED, OLIVE, OLIVE, OLIVE, CLEAR, CLEAR, CLEAR, CLEAR, CLEAR, CLEAR,
 CLEAR, CLEAR, CLEAR, CLEAR, CLEAR, ORANGE, ORANGE, ORANGE, ORANGE, ORANGE, ORANGE, ORANGE, CLEAR, CLEAR, CLEAR, CLEAR,
 CLEAR, CLEAR, CLEAR, OLIVE, OLIVE, ORANGE, ORANGE, ORANGE, ORANGE, OLIVE, OLIVE, OLIVE, OLIVE, CLEAR, CLEAR, CLEAR,
 CLEAR, CLEAR, CLEAR, OLIVE, ORANGE, OLIVE, OLIVE, ORANGE, ORANGE, ORANGE, OLIVE, ORANGE, ORANGE, ORANGE, CLEAR, CLEAR,
 CLEAR, CLEAR, CLEAR, OLIVE, ORANGE, OLIVE, ORANGE, ORANGE, ORANGE, OLIVE, ORANGE, ORANGE, ORANGE, CLEAR, CLEAR, CLEAR,
 CLEAR, CLEAR, CLEAR, CLEAR, OLIVE, OLIVE, OLIVE, ORANGE, ORANGE, OLIVE, ORANGE, CLEAR, CLEAR, CLEAR, CLEAR, CLEAR,
 CLEAR, CLEAR, CLEAR, CLEAR, RED, RED, RED, RED, RED, RED, RED, RED, RED, CLEAR, CLEAR, CLEAR,
 CLEAR, CLEAR, CLEAR, CLEAR, CLEAR, RED, RED, RED, RED, RED, CLEAR, CLEAR, CLEAR, CLEAR, CLEAR, CLEAR,
};
const unsigned char mario_1_run_1_pixels[] = {
 CLEAR, CLEAR, CLEAR, CLEAR, CLEAR, CLEAR, CLEAR, OLIVE, OLIVE, OLIVE, OLIVE, CLEAR, CLEAR, CLEAR, CLEAR, CLEAR,
 CLEAR, CLEAR, OLIVE, CLEAR, CLEAR, CLEAR, CLEAR, OLIVE, OLIVE, OLIVE, CLEAR, CLEAR, CLEAR, CLEAR, CLEAR, CLEAR,
 CLEAR, CLEAR, OLIVE, OLIVE, RED, RED, RED, CLEAR, RED, RED, RED, CLEAR, CLEAR, CLEAR, CLEAR, CLEAR,
 CLEAR, CLEAR, CLEAR, OLIVE, RED, RED, RED, RED, RED, RED, RED, RED, CLEAR, CLEAR, CLEAR, CLEAR,
 CLEAR, CLEAR, CLEAR, OLIVE, OLIVE, RED, RED, RED, RED, RED, RED, RED, CLEAR, CLEAR, CLEAR, CLEAR,
 CLEAR, CLEAR, CLEAR, ORANGE, ORANGE, RED, OLIVE, OLIVE, OLIVE, OLIVE, OLIVE, ORANGE, ORANGE, CLEAR, CLEAR, CLEAR,
 CLEAR, CLEAR, CLEAR, CLEAR, ORANGE, OLIVE, OLIVE, OLIVE, OLIVE, OLIVE, OLIVE, ORANGE, ORANGE, ORANGE, CLEAR, CLEAR,
 CLEAR, CLEAR, CLEAR, CLEAR, CLEAR, OLIVE, OLIVE, OLIVE, OLIVE, RED, OLIVE, CLEAR, ORANGE, CLEAR, CLEAR, CLEAR,
 CLEAR, CLEAR, CLEAR, CLEAR, CLEAR, CLEAR, ORANGE, ORANGE, ORANGE, ORANGE, ORANGE, ORANGE, ORANGE, CLEAR, CLEAR, CLEAR,
 CLEAR, CLEAR, CLEAR, CLEAR, OLIVE, OLIVE, ORANGE, ORANGE, ORANGE, ORANGE, OLIVE, OLIVE, OLIVE, OLIVE, CLEAR, CLEAR,
 CLEAR, CLEAR, CLEAR, CLEAR, OLIVE, ORANGE, OLIVE, OLIVE, ORANGE, ORANGE, ORANGE, OLIVE, ORANGE, ORANGE, ORANGE, CLEAR,
 CLEAR, CLEAR, CLEAR, CLEAR, OLIVE, ORANGE, OLIVE, ORANGE, ORANGE, ORANGE, OLIVE, ORANGE, ORANGE, ORANGE, CLEAR, CLEAR,
 CLEAR, CLEAR, CLEAR, CLEAR, CLEAR, OLIVE, OLIVE, OLIVE, ORANGE, ORANGE, OLIVE, ORANGE, CLEAR, CLEAR, CLEAR, CLEAR,
 CLEAR, CLEAR, CLEAR, CLEAR, CLEAR, RED, RED, RED, RED, RED, RED, RED, RED, RED, CLEAR, CLEAR,
 CLEAR, CLEAR, CLEAR, CLEAR, CLEAR, CLEAR, RED, RED, RED, RED, RED, CLEAR, CLEAR, CLEAR, CLEAR, CLEAR,
 CLEAR, CLEAR, CLEAR, CLEAR, CLEAR, CLEAR, CLEAR, CLEAR, CLEAR, CLEAR, CLEAR, CLEAR, CLEAR, CLEAR, CLEAR, CLEAR,
};
const unsigned char mario_1_run_2_pixels[] = {
 CLEAR, CLEAR, CLEAR, CLEAR, CLEAR, OLIVE, OLIVE, OLIVE, OLIVE, CLEAR, CLEAR, CLEAR, CLEAR, CLEAR, CLEAR, CLEAR,
 CLEAR, CLEAR, CLEAR, CLEAR, CLEAR, OLIVE, OLIVE, OLIVE, OLIVE, OLIVE, OLIVE, OLIVE, CLEAR, CLEAR, CLEAR, CLEAR,
 CLEAR, CLEAR, CLEAR, CLEAR, CLEAR, RED, RED, RED, OLIVE, OLIVE, OLIVE, CLEAR, CLEAR, CLEAR, CLEAR, CLEAR,
 CLEAR, CLEAR, CLEAR, CLEAR, RED, OLIVE, ORANGE, ORANGE, RED, RED, RED, CLEAR, CLEAR, CLEAR, CLEAR, CLEAR,
 CLEAR, CLEAR, CLEAR, RED, OLIVE, OLIVE, ORANGE, ORANGE, ORANGE, RED, RED, RED, CLEAR, CLEAR, CLEAR, CLEAR,
 CLEAR, CLEAR, CLEAR, OLIVE, OLIVE, OLIVE, OLIVE, RED, RED, RED, RED, RED, CLEAR, CLEAR, CLEAR, CLEAR,
 CLEAR, CLEAR, CLEAR, OLIVE, OLIVE, OLIVE, RED, RED, ORANGE, RED, RED, ORANGE, CLEAR, CLEAR, CLEAR, CLEAR,
 CLEAR, CLEAR, CLEAR, OLIVE, OLIVE, OLIVE, OLIVE, RED, RED, OLIVE, OLIVE, CLEAR, CLEAR, CLEAR, CLEAR, CLEAR,
 CLEAR, CLEAR, CLEAR, CLEAR, OLIVE, OLIVE, RED, OLIVE, OLIVE, OLIVE, CLEAR, CLEAR, CLEAR, CLEAR, CLEAR, CLEAR,
 CLEAR, CLEAR, CLEAR, CLEAR, CLEAR, ORANGE, ORANGE, ORANGE, ORANGE, ORANGE, ORANGE, ORANGE, CLEAR, CLEAR, CLEAR, CLEAR,
 CLEAR, CLEAR, CLEAR, OLIVE, OLIVE, ORANGE, ORANGE, ORANGE, ORANGE, OLIVE, OLIVE, OLIVE, OLIVE, CLEAR, CLEAR, CLEAR,
 CLEAR, CLEAR, CLEAR, OLIVE, ORANGE, OLIVE, OLIVE, ORANGE, ORANGE, ORANGE, OLIVE, ORANGE, ORANGE, ORANGE, CLEAR, CLEAR,
 CLEAR, CLEAR, CLEAR, OLIVE, ORANGE, OLIVE, ORANGE, ORANGE, ORANGE, OLIVE, ORANGE, ORANGE, ORANGE, CLEAR, CLEAR, CLEAR,
 CLEAR, CLEAR, CLEAR, CLEAR, OLIVE, OLIVE, OLIVE, ORANGE, ORANGE, OLIVE, ORANGE, CLEAR, CLEAR, CLEAR, CLEAR, CLEAR,
 CLEAR, CLEAR, CLEAR, CLEAR, RED, RED, RED, RED, RED, RED, RED, RED, RED, CLEAR, CLEAR, CLEAR,
 CLEAR, CLEAR, CLEAR, CLEAR, CLEAR, RED, RED, RED, RED, RED, CLEAR, CLEAR, CLEAR, CLEAR, CLEAR, CLEAR,
};
const unsigned char mario_1_run_3_pixels[] = {
 CLEAR, CLEAR, CLEAR, OLIVE, OLIVE, OLIVE, CLEAR, CLEAR, CLEAR, CLEAR, CLEAR, CLEAR, CLEAR, CLEAR, CLEAR, CLEAR,
 CLEAR, CLEAR, OLIVE, OLIVE, OLIVE, CLEAR, CLEAR, CLEAR, CLEAR, CLEAR, CLEAR, CLEAR, CLEAR, CLEAR, CLEAR, CLEAR,
 CLEAR, CLEAR, OLIVE, OLIVE, RED, RED, RED, CLEAR, CLEAR, CLEAR, RED, RED, RED, OLIVE, OLIVE, CLEAR,
 CLEAR, CLEAR, CLEAR, RED, RED, RED, RED, RED, RED, RED, RED, RED, RED, OLIVE, OLIVE, CLEAR,
 CLEAR, CLEAR, CLEAR, CLEAR, RED, RED, RED, RED, RED, RED, RED, RED, RED, OLIVE, OLIVE, CLEAR,
 CLEAR, ORANGE, ORANGE, CLEAR, CLEAR, RED, RED, RED, RED, RED, RED, RED, CLEAR, CLEAR, OLIVE, CLEAR,
 CLEAR, ORANGE, ORANGE, ORANGE, CLEAR, OLIVE, OLIVE, RED, ORANGE, RED, RED, RED, OLIVE, OLIVE, ORANGE, ORANGE,
 CLEAR, ORANGE, ORANGE, OLIVE, OLIVE, OLIVE, OLIVE, RED, RED, RED, OLIVE, OLIVE, OLIVE, ORANGE, ORANGE, ORANGE,
 CLEAR, CLEAR, CLEAR, OLIVE, OLIVE, OLIVE, OLIVE, RED, RED, OLIVE, OLIVE, CLEAR, CLEAR, CLEAR, CLEAR, CLEAR,
 CLEAR, CLEAR, CLEAR, CLEAR, CLEAR, CLEAR, ORANGE, ORANGE, ORANGE, ORANGE, ORANGE, ORANGE, ORANGE, CLEAR, CLEAR, CLEAR,
 CLEAR, CLEAR, CLEAR, CLEAR, OLIVE, OLIVE, ORANGE, ORANGE, ORANGE, ORANGE, OLIVE, OLIVE, OLIVE, OLIVE, CLEAR, CLEAR,
 CLEAR, CLEAR, CLEAR, CLEAR, OLIVE, ORANGE, OLIVE, OLIVE, ORANGE, ORANGE, ORANGE, OLIVE, ORANGE, ORANGE, ORANGE, CLEAR,
 CLEAR, CLEAR, CLEAR, CLEAR, OLIVE, ORANGE, OLIVE, ORANGE, ORANGE, ORANGE, OLIVE, ORANGE, ORANGE, ORANGE, CLEAR, CLEAR,
 CLEAR, CLEAR, CLEAR, CLEAR, CLEAR, OLIVE, OLIVE, OLIVE, ORANGE, ORANGE, OLIVE, ORANGE, CLEAR, CLEAR, CLEAR, CLEAR,
 CLEAR, CLEAR, CLEAR, CLEAR, CLEAR, RED, RED, RED, RED, RED, RED, RED, RED, RED, CLEAR, CLEAR,
 CLEAR, CLEAR, CLEAR, CLEAR, CLEAR, CLEAR, RED, RED, RED, RED, RED, CLEAR, CLEAR, CLEAR, CLEAR, CLEAR,
};

const unsigned char mario_1_jump_pixels[] = {
 CLEAR, OLIVE, CLEAR, CLEAR, RED, RED, RED, RED, CLEAR, CLEAR, CLEAR, CLEAR, CLEAR, CLEAR, CLEAR, CLEAR,
 CLEAR, OLIVE, OLIVE, OLIVE, RED, RED, RED, RED, RED, RED, RED, CLEAR, CLEAR, CLEAR, CLEAR, CLEAR,
 CLEAR, CLEAR, OLIVE, OLIVE, OLIVE, RED, RED, RED, RED, RED, RED, RED, RED, RED, OLIVE, OLIVE,
 CLEAR, ORANGE, CLEAR, OLIVE, RED, RED, RED, RED, RED, RED, RED, RED, RED, RED, OLIVE, OLIVE,
 ORANGE, ORANGE, ORANGE, CLEAR, RED, RED, OLIVE, RED, RED, ORANGE, RED, RED, ORANGE, RED, OLIVE, OLIVE,
 ORANGE, ORANGE, OLIVE, OLIVE, OLIVE, OLIVE, OLIVE, OLIVE, RED, RED, RED, RED, RED, CLEAR, CLEAR, OLIVE,
 CLEAR, OLIVE, OLIVE, OLIVE, OLIVE, OLIVE, OLIVE, OLIVE, RED, OLIVE, OLIVE, OLIVE, RED, CLEAR, CLEAR, OLIVE,
 CLEAR, CLEAR, OLIVE, OLIVE, OLIVE, OLIVE, OLIVE, RED, OLIVE, OLIVE, OLIVE, RED, OLIVE, CLEAR, CLEAR, CLEAR,
 CLEAR, CLEAR, CLEAR, CLEAR, CLEAR, CLEAR, ORANGE, ORANGE, ORANGE, ORANGE, ORANGE, ORANGE, ORANGE, OLIVE, CLEAR, CLEAR,
 CLEAR, CLEAR, CLEAR, CLEAR, OLIVE, OLIVE, ORANGE, ORANGE, ORANGE, ORANGE, OLIVE, OLIVE, OLIVE, OLIVE, OLIVE, CLEAR,
 CLEAR, CLEAR, CLEAR, CLEAR, OLIVE, ORANGE, OLIVE, OLIVE, ORANGE, ORANGE, ORANGE, OLIVE, ORANGE, ORANGE, ORANGE, OLIVE,
 CLEAR, CLEAR, CLEAR, CLEAR, OLIVE, ORANGE, OLIVE, ORANGE, ORANGE, ORANGE, OLIVE, ORANGE, ORANGE, OLIVE, OLIVE, OLIVE,
 CLEAR, CLEAR, CLEAR, CLEAR, CLEAR, OLIVE, OLIVE, OLIVE, ORANGE, ORANGE, OLIVE, ORANGE, CLEAR, OLIVE, OLIVE, OLIVE,
 CLEAR, CLEAR, CLEAR, CLEAR, CLEAR, RED, RED, RED, RED, RED, RED, RED, RED, RED, ORANGE, ORANGE,
 CLEAR, CLEAR, CLEAR, CLEAR, CLEAR, CLEAR, RED, RED, RED, RED, RED, CLEAR, CLEAR, ORANGE, ORANGE, ORANGE,
 CLEAR, CLEAR, CLEAR, CLEAR, CLEAR, CLEAR, CLEAR, CLEAR, CLEAR, CLEAR, CLEAR, CLEAR, CLEAR, ORANGE, ORANGE, ORANGE,
};

const unsigned char flag_pixels[] = {
 CLEAR, CLEAR, CLEAR, CLEAR, CLEAR, CLEAR, CLEAR, CLEAR, CLEAR, CLEAR, CLEAR, CLEAR, CLEAR, CLEAR, CLEAR, WHITE,
 CLEAR, CLEAR, CLEAR, CLEAR, CLEAR, CLEAR, CLEAR, CLEAR, CLEAR, CLEAR, CLEAR, CLEAR, CLEAR, CLEAR, WHITE, WHITE,
 CLEAR, CLEAR, CLEAR, CLEAR, CLEAR, CLEAR, CLEAR, CLEAR, CLEAR, CLEAR, CLEAR, CLEAR, CLEAR, WHITE, WHITE, WHITE,
 CLEAR, CLEAR, CLEAR, CLEAR, CLEAR, CLEAR, CLEAR, CLEAR, CLEAR, CLEAR, CLEAR, CLEAR, WHITE, WHITE, WHITE, WHITE,
 CLEAR, CLEAR, CLEAR, CLEAR, CLEAR, CLEAR, CLEAR, CLEAR, CLEAR, CLEAR, CLEAR, WHITE, WHITE, WHITE, WHITE, WHITE,
 CLEAR, CLEAR, CLEAR, CLEAR, CLEAR, CLEAR, CLEAR, CLEAR, CLEAR, CLEAR, WHITE, WHITE, WHITE, WHITE, WHITE, WHITE,
 CLEAR, CLEAR, CLEAR, CLEAR, CLEAR, CLEAR, CLEAR, CLEAR, CLEAR, WHITE, WHITE, WHITE, WHITE, WHITE, WHITE, WHITE,
 CLEAR, CLEAR, CLEAR, CLEAR, CLEAR, CLEAR, CLEAR, CLEAR, WHITE, WHITE, WHITE, WHITE, WHITE, WHITE, WHITE, WHITE,
 CLEAR, CLEAR, CLEAR, CLEAR, CLEAR, CLEAR, CLEAR, WHITE, WHITE, WHITE, LIGHT_GREEN, LIGHT_GREEN, LIGHT_GREEN, WHITE, WHITE, WHITE,
 CLEAR, CLEAR, CLEAR, CLEAR, CLEAR, CLEAR, WHITE, WHITE, LIGHT_GREEN, LIGHT_GREEN, LIGHT_GREEN, LIGHT_GREEN, LIGHT_GREEN, LIGHT_GREEN, LIGHT_GREEN, WHITE,
 CLEAR, CLEAR, CLEAR, CLEAR, CLEAR, WHITE, WHITE, WHITE, LIGHT_GREEN, LIGHT_GREEN, LIGHT_GREEN, WHITE, LIGHT_GREEN, LIGHT_GREEN, LIGHT_GREEN, WHITE,
 CLEAR, CLEAR, CLEAR, CLEAR, WHITE, WHITE, WHITE, WHITE, LIGHT_GREEN, WHITE, LIGHT_GREEN, LIGHT_GREEN, LIGHT_GREEN, WHITE, LIGHT_GREEN, WHITE,
 CLEAR, CLEAR, CLEAR, WHITE, WHITE, WHITE, WHITE, WHITE, LIGHT_GREEN, WHITE, WHITE, LIGHT_GREEN, WHITE, WHITE, LIGHT_GREEN, WHITE,
 CLEAR, CLEAR, WHITE, WHITE, WHITE, WHITE, WHITE, WHITE, LIGHT_GREEN, LIGHT_GREEN, WHITE, LIGHT_GREEN, WHITE, LIGHT_GREEN, LIGHT_GREEN, WHITE,
 CLEAR, WHITE, WHITE, WHITE, WHITE, WHITE, WHITE, WHITE, WHITE, LIGHT_GREEN, LIGHT_GREEN, LIGHT_GREEN, LIGHT_GREEN, LIGHT_GREEN, WHITE, WHITE,
 WHITE, WHITE, WHITE, WHITE, WHITE, WHITE, WHITE, WHITE, WHITE, WHITE, WHITE, WHITE, WHITE, WHITE, WHITE, WHITE,
};

const unsigned char mario_1_flag_pixels[] = {
 CLEAR, CLEAR, CLEAR, CLEAR, RED, RED, RED, RED, RED, RED, RED, RED, RED, OLIVE, OLIVE, CLEAR,
 CLEAR, CLEAR, CLEAR, RED, RED, RED, RED, RED, RED, RED, RED, RED, RED, OLIVE, OLIVE, CLEAR,
 CLEAR, CLEAR, RED, RED, RED, RED, RED, RED, RED, RED, RED, RED, RED, OLIVE, OLIVE, CLEAR,
 CLEAR, CLEAR, RED, RED, RED, RED, RED, RED, RED, RED, CLEAR, CLEAR, CLEAR, OLIVE, OLIVE, CLEAR,
 CLEAR, CLEAR, RED, RED, RED, RED, RED, RED, BLUE, RED, CLEAR, CLEAR, CLEAR, CLEAR, CLEAR, CLEAR,
 CLEAR, CLEAR, RED, RED, RED, RED, OLIVE, OLIVE, OLIVE, OLIVE, OLIVE, OLIVE, ORANGE, ORANGE, ORANGE, CLEAR,
 CLEAR, CLEAR, CLEAR, RED, RED, RED, OLIVE, OLIVE, OLIVE, OLIVE, OLIVE, OLIVE, ORANGE, ORANGE, ORANGE, CLEAR,
 CLEAR, CLEAR, CLEAR, CLEAR, RED, RED, RED, OLIVE, OLIVE, OLIVE, OLIVE, OLIVE, ORANGE, ORANGE, CLEAR, CLEAR,
 CLEAR, CLEAR, CLEAR, CLEAR, ORANGE, ORANGE, ORANGE, ORANGE, ORANGE, ORANGE, ORANGE, ORANGE, CLEAR, CLEAR, CLEAR, CLEAR,
 CLEAR, CLEAR, OLIVE, OLIVE, OLIVE, ORANGE, ORANGE, ORANGE, ORANGE, OLIVE, OLIVE, OLIVE, OLIVE, CLEAR, CLEAR, CLEAR,
 CLEAR, CLEAR, OLIVE, OLIVE, ORANGE, OLIVE, OLIVE, ORANGE, ORANGE, ORANGE, OLIVE, ORANGE, ORANGE, ORANGE, CLEAR, CLEAR,
 CLEAR, CLEAR, OLIVE, OLIVE, ORANGE, OLIVE, ORANGE, ORANGE, ORANGE, OLIVE, ORANGE, ORANGE, ORANGE, CLEAR, CLEAR, CLEAR,
 CLEAR, CLEAR, CLEAR, OLIVE, OLIVE, OLIVE, OLIVE, ORANGE, ORANGE, OLIVE, ORANGE, CLEAR, CLEAR, CLEAR, CLEAR, CLEAR,
 CLEAR, CLEAR, CLEAR, RED, RED, RED, RED, RED, RED, RED, RED, RED, RED, CLEAR, CLEAR, CLEAR,
 CLEAR, CLEAR, CLEAR, CLEAR, RED, RED, RED, RED, RED, RED, CLEAR, CLEAR, CLEAR, CLEAR, CLEAR, CLEAR,
 CLEAR, CLEAR, CLEAR, CLEAR, CLEAR, CLEAR, CLEAR, CLEAR, CLEAR, CLEAR, CLEAR, CLEAR, CLEAR, CLEAR, CLEAR, CLEAR,
};

const unsigned char goomba_walk_1_pixels[] = {
 CLEAR, CLEAR, BLACK, BLACK, BLACK, BLACK, BLACK, CLEAR, CLEAR, BLACK, BLACK, BLACK, CLEAR, CLEAR, CLEAR, CLEAR,
 CLEAR, BLACK, BLACK, BLACK, BLACK, BLACK, BLACK, PEACH, PEACH, PEACH, BLACK, BLACK, BLACK, CLEAR, CLEAR, CLEAR,
 CLEAR, BLACK, BLACK, BLACK, BLACK, BLACK, PEACH, PEACH, PEACH, PEACH, PEACH, BLACK, BLACK, CLEAR, CLEAR, CLEAR,
 CLEAR, CLEAR, BLACK, BLACK, PEACH, PEACH, PEACH, PEACH, PEACH, PEACH, PEACH, PEACH, CLEAR, CLEAR, CLEAR, CLEAR,
 CLEAR, CLEAR, CLEAR, CLEAR, PEACH, PEACH, PEACH, PEACH, PEACH, PEACH, PEACH, PEACH, CLEAR, CLEAR, CLEAR, CLEAR,
 CLEAR, BROWN, BROWN, BROWN, BROWN, PEACH, PEACH, PEACH, PEACH, PEACH, PEACH, BROWN, BROWN, BROWN, BROWN, CLEAR,
 BROWN, BROWN, BROWN, BROWN, BROWN, BROWN, BROWN, BROWN, BROWN, BROWN, BROWN, BROWN, BROWN, BROWN, BROWN, BROWN,
 BROWN, BROWN, BROWN, BROWN, PEACH, PEACH, PEACH, BROWN, BROWN, PEACH, PEACH, PEACH, BROWN, BROWN, BROWN, BROWN,
 BROWN, BROWN, BROWN, BROWN, PEACH, BLACK, PEACH, BROWN, BROWN, PEACH, BLACK, PEACH, BROWN, BROWN, BROWN, BROWN,
 CLEAR, BROWN, BROWN, BROWN, PEACH, BLACK, BLACK, BLACK, BLACK, BLACK, BLACK, PEACH, BROWN, BROWN, BROWN, CLEAR,
 CLEAR, BROWN, BROWN, BROWN, PEACH, BLACK, BROWN, BROWN, BROWN, BROWN, BLACK, PEACH, BROWN, BROWN, BROWN, CLEAR,
 CLEAR, CLEAR, BROWN, BLACK, BLACK, BROWN, BROWN, BROWN, BROWN, BROWN, BROWN, BLACK, BLACK, BROWN, CLEAR, CLEAR,
 CLEAR, CLEAR, CLEAR, BROWN, BROWN, BROWN, BROWN, BROWN, BROWN, BROWN, BROWN, BROWN, BROWN, CLEAR, CLEAR, CLEAR,
 CLEAR, CLEAR, CLEAR, CLEAR, BROWN, BROWN, BROWN, BROWN, BROWN, BROWN, BROWN, BROWN, CLEAR, CLEAR, CLEAR, CLEAR,
 CLEAR, CLEAR, CLEAR, CLEAR, CLEAR, BROWN, BROWN, BROWN, BROWN, BROWN, BROWN, CLEAR, CLEAR, CLEAR, CLEAR, CLEAR,
 CLEAR, CLEAR, CLEAR, CLEAR, CLEAR, CLEAR, BROWN, BROWN, BROWN, BROWN, CLEAR, CLEAR, CLEAR, CLEAR, CLEAR, CLEAR,
};

const unsigned char goomba_walk_2_pixels[] = {
 CLEAR, CLEAR, CLEAR, CLEAR, BLACK, BLACK, BLACK, CLEAR, CLEAR, BLACK, BLACK, BLACK, BLACK, BLACK, CLEAR, CLEAR,
 CLEAR, CLEAR, CLEAR, BLACK, BLACK, BLACK, PEACH, PEACH, PEACH, BLACK, BLACK, BLACK, BLACK, BLACK, BLACK, CLEAR,
 CLEAR, CLEAR, CLEAR, BLACK, BLACK, PEACH, PEACH, PEACH, PEACH, PEACH, BLACK, BLACK, BLACK, BLACK, BLACK, CLEAR,
 CLEAR, CLEAR, CLEAR, CLEAR, PEACH, PEACH, PEACH, PEACH, PEACH, PEACH, PEACH, PEACH, BLACK, BLACK, CLEAR, CLEAR,
 CLEAR, CLEAR, CLEAR, CLEAR, PEACH, PEACH, PEACH, PEACH, PEACH, PEACH, PEACH, PEACH, CLEAR, CLEAR, CLEAR, CLEAR,
 CLEAR, BROWN, BROWN, BROWN, BROWN, PEACH, PEACH, PEACH, PEACH, PEACH, PEACH, BROWN, BROWN, BROWN, BROWN, CLEAR,
 BROWN, BROWN, BROWN, BROWN, BROWN, BROWN, BROWN, BROWN, BROWN, BROWN, BROWN, BROWN, BROWN, BROWN, BROWN, BROWN,
 BROWN, BROWN, BROWN, BROWN, PEACH, PEACH, PEACH, BROWN, BROWN, PEACH, PEACH, PEACH, BROWN, BROWN, BROWN, BROWN,
 BROWN, BROWN, BROWN, BROWN, PEACH, BLACK, PEACH, BROWN, BROWN, PEACH, BLACK, PEACH, BROWN, BROWN, BROWN, BROWN,
 CLEAR, BROWN, BROWN, BROWN, PEACH, BLACK, BLACK, BLACK, BLACK, BLACK, BLACK, PEACH, BROWN, BROWN, BROWN, CLEAR,
 CLEAR, BROWN, BROWN, BROWN, PEACH, BLACK, BROWN, BROWN, BROWN, BROWN, BLACK, PEACH, BROWN, BROWN, BROWN, CLEAR,
 CLEAR, CLEAR, BROWN, BLACK, BLACK, BROWN, BROWN, BROWN, BROWN, BROWN, BROWN, BLACK, BLACK, BROWN, CLEAR, CLEAR,
 CLEAR, CLEAR, CLEAR, BROWN, BROWN, BROWN, BROWN, BROWN, BROWN, BROWN, BROWN, BROWN, BROWN, CLEAR, CLEAR, CLEAR,
 CLEAR, CLEAR, CLEAR, CLEAR, BROWN, BROWN, BROWN, BROWN, BROWN, BROWN, BROWN, BROWN, CLEAR, CLEAR, CLEAR, CLEAR,
 CLEAR, CLEAR, CLEAR, CLEAR, CLEAR, BROWN, BROWN, BROWN, BROWN, BROWN, BROWN, CLEAR, CLEAR, CLEAR, CLEAR, CLEAR,
 CLEAR, CLEAR, CLEAR, CLEAR, CLEAR, CLEAR, BROWN, BROWN, BROWN, BROWN, CLEAR, CLEAR, CLEAR, CLEAR, CLEAR, CLEAR,
};

const unsigned char goomba_smash_pixels[] = {
 CLEAR, BLACK, BLACK, BLACK, BLACK, BLACK, CLEAR, CLEAR, CLEAR, CLEAR, BLACK, BLACK, BLACK, BLACK, BLACK, CLEAR,
 CLEAR, CLEAR, CLEAR, CLEAR, PEACH, PEACH, PEACH, PEACH, PEACH, PEACH, PEACH, PEACH, CLEAR, CLEAR, CLEAR, CLEAR,
 CLEAR, CLEAR, CLEAR, PEACH, PEACH, PEACH, PEACH, PEACH, PEACH, PEACH, PEACH, PEACH, PEACH, CLEAR, CLEAR, CLEAR,
 BROWN, BROWN, BROWN, BROWN, BROWN, BROWN, BROWN, BROWN, BROWN, BROWN, BROWN, BROWN, BROWN, BROWN, BROWN, BROWN,
 BROWN, BROWN, PEACH, PEACH, PEACH, PEACH, BLACK, BLACK, BLACK, BLACK, PEACH, PEACH, PEACH, PEACH, BROWN, BROWN,
 CLEAR, BROWN, BROWN, BLACK, BLACK, BLACK, BROWN, BROWN, BROWN, BROWN, BLACK, BLACK, BLACK, BROWN, BROWN, CLEAR,
 CLEAR, CLEAR, CLEAR, BROWN, BROWN, BROWN, BROWN, BROWN, BROWN, BROWN, BROWN, BROWN, BROWN, CLEAR, CLEAR, CLEAR,
 CLEAR, CLEAR, CLEAR, CLEAR, CLEAR, CLEAR, BROWN, BROWN, BROWN, BROWN, CLEAR, CLEAR, CLEAR, CLEAR, CLEAR, CLEAR,
};

const unsigned char mario_hit_pixels[] = {
 CLEAR, CLEAR, CLEAR, CLEAR, CLEAR, CLEAR, CLEAR, CLEAR, CLEAR, CLEAR, CLEAR, CLEAR, CLEAR, CLEAR, CLEAR, CLEAR,
 CLEAR, CLEAR, OLIVE, OLIVE, OLIVE, RED, RED, RED, RED, RED, RED, OLIVE, OLIVE, CLEAR, CLEAR, CLEAR,
 CLEAR, OLIVE, OLIVE, OLIVE, OLIVE, RED, RED, RED, RED, RED, RED, OLIVE, OLIVE, OLIVE, CLEAR, CLEAR,
 CLEAR, OLIVE, OLIVE, OLIVE, OLIVE, RED, ORANGE, RED, RED, ORANGE, RED, OLIVE, OLIVE, OLIVE, CLEAR, CLEAR,
 CLEAR, OLIVE, OLIVE, OLIVE, OLIVE, RED, RED, OLIVE, OLIVE, RED, RED, OLIVE, OLIVE, OLIVE, CLEAR, CLEAR,
 CLEAR, OLIVE, OLIVE, OLIVE, RED, RED, OLIVE, OLIVE, OLIVE, OLIVE, RED, RED, OLIVE, OLIVE, CLEAR, CLEAR,
 CLEAR, CLEAR, RED, RED, RED, RED, ORANGE, ORANGE, ORANGE, ORANGE, RED, RED, RED, CLEAR, CLEAR, CLEAR,
 CLEAR, CLEAR, CLEAR, OLIVE, OLIVE, ORANGE, ORANGE, ORANGE, ORANGE, ORANGE, ORANGE, OLIVE, CLEAR, CLEAR, CLEAR, CLEAR,
 CLEAR, CLEAR, CLEAR, OLIVE, OLIVE, ORANGE, OLIVE, OLIVE, OLIVE, OLIVE, ORANGE, OLIVE, CLEAR, CLEAR, CLEAR, CLEAR,
 CLEAR, CLEAR, OLIVE, OLIVE, OLIVE, OLIVE, OLIVE, ORANGE, ORANGE, OLIVE, OLIVE, OLIVE, OLIVE, CLEAR, CLEAR, CLEAR,
 ORANGE, ORANGE, ORANGE, OLIVE, OLIVE, OLIVE, ORANGE, ORANGE, ORANGE, ORANGE, OLIVE, OLIVE, OLIVE, ORANGE, ORANGE, CLEAR,
 ORANGE, ORANGE, ORANGE, OLIVE, OLIVE, ORANGE, OLIVE, ORANGE, ORANGE, OLIVE, ORANGE, OLIVE, OLIVE, ORANGE, ORANGE, CLEAR,
 ORANGE, ORANGE, ORANGE, ORANGE, OLIVE, ORANGE, OLIVE, ORANGE, ORANGE, OLIVE, ORANGE, OLIVE, ORANGE, ORANGE, ORANGE, CLEAR,
 CLEAR, CLEAR, ORANGE, ORANGE, RED, RED, RED, RED, RED, RED, RED, ORANGE, ORANGE, CLEAR, CLEAR, CLEAR,
 CLEAR, CLEAR, CLEAR, CLEAR, CLEAR, RED, RED, RED, RED, RED, CLEAR, CLEAR, CLEAR, CLEAR, CLEAR, CLEAR,
 CLEAR, CLEAR, CLEAR, CLEAR, CLEAR, CLEAR, CLEAR, CLEAR, CLEAR, CLEAR, CLEAR, CLEAR, CLEAR, CLEAR, CLEAR, CLEAR,
};

const unsigned char question_block_2_pixels[] = {
 BLACK, BLACK, BLACK, BLACK, BLACK, BLACK, BLACK, BLACK, BLACK, BLACK, BLACK, BLACK, BLACK, BLACK, BLACK, BLACK,
 BROWN, BROWN, BROWN, BROWN, BROWN, BROWN, BROWN, BROWN, BROWN, BROWN, BROWN, BROWN, BROWN, BROWN, BROWN, BLACK,
 BROWN, BROWN, BLACK, BROWN, BROWN, BROWN, BROWN, BROWN, BLACK, BLACK, BROWN, BROWN, BROWN, BLACK, BROWN, BLACK,
 BROWN, BROWN, BROWN, BROWN, BROWN, BROWN, BROWN, BROWN, BROWN, BLACK, BROWN, BROWN, BROWN, BROWN, BROWN, BLACK,
 BROWN, BROWN, BROWN, BROWN, BROWN, BROWN, BROWN, BROWN, BROWN, BROWN, BROWN, BROWN, BROWN, BROWN, BROWN, BLACK,
 BROWN, BROWN, BROWN, BROWN, BROWN, BROWN, BROWN, BROWN, BLACK, BLACK, BROWN, BROWN, BROWN, BROWN, BROWN, BLACK,
 BROWN, BROWN, BROWN, BROWN, BROWN, BROWN, BROWN, BROWN, BROWN, BLACK, BROWN, BROWN, BROWN, BROWN, BROWN, BLACK,
 BROWN, BROWN, BROWN, BROWN, BROWN, BROWN, BROWN, BROWN, BROWN, BLACK, BLACK, BLACK, BROWN, BROWN, BROWN, BLACK,
 BROWN, BROWN, BROWN, BROWN, BROWN, BLACK, BLACK, BROWN, BROWN, BROWN, BROWN, BLACK, BROWN, BROWN, BROWN, BLACK,
 BROWN, BROWN, BROWN, BROWN, BROWN, BROWN, BLACK, BROWN, BROWN, BROWN, BROWN, BLACK, BROWN, BROWN, BROWN, BLACK,
 BROWN, BROWN, BROWN, BROWN, BROWN, BROWN, BLACK, BROWN, BROWN, BROWN, BROWN, BLACK, BROWN, BROWN, BROWN, BLACK,
 BROWN, BROWN, BROWN, BROWN, BROWN, BROWN, BLACK, BLACK, BLACK, BROWN, BROWN, BROWN, BROWN, BROWN, BROWN, BLACK,
 BROWN, BROWN, BROWN, BROWN, BROWN, BROWN, BROWN, BROWN, BROWN, BROWN, BROWN, BROWN, BROWN, BROWN, BROWN, BLACK,
 BROWN, BROWN, BLACK, BROWN, BROWN, BROWN, BROWN, BROWN, BROWN, BROWN, BROWN, BROWN, BROWN, BLACK, BROWN, BLACK,
 BROWN, BROWN, BROWN, BROWN, BROWN, BROWN, BROWN, BROWN, BROWN, BROWN, BROWN, BROWN, BROWN, BROWN, BROWN, BLACK,
 CLEAR, BROWN, BROWN, BROWN, BROWN, BROWN, BROWN, BROWN, BROWN, BROWN, BROWN, BROWN, BROWN, BROWN, BROWN, CLEAR,
};

const unsigned char question_block_3_pixels[] = {
 BLACK, BLACK, BLACK, BLACK, BLACK, BLACK, BLACK, BLACK, BLACK, BLACK, BLACK, BLACK, BLACK, BLACK, BLACK, BLACK,
 BROWN, DARK_BROWN, DARK_BROWN, DARK_BROWN, DARK_BROWN, DARK_BROWN, DARK_BROWN, DARK_BROWN, DARK_BROWN, DARK_BROWN, DARK_BROWN, DARK_BROWN, DARK_BROWN, DARK_BROWN, DARK_BROWN, BLACK,
 BROWN, DARK_BROWN, BLACK, DARK_BROWN, DARK_BROWN, DARK_BROWN, DARK_BROWN, DARK_BROWN, BLACK, BLACK, DARK_BROWN, DARK_BROWN, DARK_BROWN, BLACK, DARK_BROWN, BLACK,
 BROWN, DARK_BROWN, DARK_BROWN, DARK_BROWN, DARK_BROWN, DARK_BROWN, DARK_BROWN, BROWN, BROWN, BLACK, DARK_BROWN, DARK_BROWN, DARK_BROWN, DARK_BROWN, DARK_BROWN, BLACK,
 BROWN, DARK_BROWN, DARK_BROWN, DARK_BROWN, DARK_BROWN, DARK_BROWN, DARK_BROWN, BROWN, BROWN, DARK_BROWN, DARK_BROWN, DARK_BROWN, DARK_BROWN, DARK_BROWN, DARK_BROWN, BLACK,
 BROWN, DARK_BROWN, DARK_BROWN, DARK_BROWN, DARK_BROWN, DARK_BROWN, DARK_BROWN, DARK_BROWN, BLACK, BLACK, DARK_BROWN, DARK_BROWN, DARK_BROWN, DARK_BROWN, DARK_BROWN, BLACK,
 BROWN, DARK_BROWN, DARK_BROWN, DARK_BROWN, DARK_BROWN, DARK_BROWN, DARK_BROWN, BROWN, BROWN, BLACK, DARK_BROWN, DARK_BROWN, DARK_BROWN, DARK_BROWN, DARK_BROWN, BLACK,
 BROWN, DARK_BROWN, DARK_BROWN, DARK_BROWN, DARK_BROWN, DARK_BROWN, DARK_BROWN, BROWN, BROWN, BLACK, BLACK, BLACK, DARK_BROWN, DARK_BROWN, DARK_BROWN, BLACK,
 BROWN, DARK_BROWN, DARK_BROWN, DARK_BROWN, DARK_BROWN, BLACK, BLACK, DARK_BROWN, BROWN, BROWN, BROWN, BLACK, DARK_BROWN, DARK_BROWN, DARK_BROWN, BLACK,
 BROWN, DARK_BROWN, DARK_BROWN, DARK_BROWN, BROWN, BROWN, BLACK, DARK_BROWN, DARK_BROWN, BROWN, BROWN, BLACK, DARK_BROWN, DARK_BROWN, DARK_BROWN, BLACK,
 BROWN, DARK_BROWN, DARK_BROWN, DARK_BROWN, BROWN, BROWN, BLACK, DARK_BROWN, DARK_BROWN, BROWN, BROWN, BLACK, DARK_BROWN, DARK_BROWN, DARK_BROWN, BLACK,
 BROWN, DARK_BROWN, DARK_BROWN, DARK_BROWN, BROWN, BROWN, BLACK, BLACK, BLACK, BROWN, BROWN, DARK_BROWN, DARK_BROWN, DARK_BROWN, DARK_BROWN, BLACK,
 BROWN, DARK_BROWN, DARK_BROWN, DARK_BROWN, DARK_BROWN, BROWN, BROWN, BROWN, BROWN, BROWN, DARK_BROWN, DARK_BROWN, DARK_BROWN, DARK_BROWN, DARK_BROWN, BLACK,
 BROWN, DARK_BROWN, BLACK, DARK_BROWN, DARK_BROWN, DARK_BROWN, DARK_BROWN, DARK_BROWN, DARK_BROWN, DARK_BROWN, DARK_BROWN, DARK_BROWN, DARK_BROWN, BLACK, DARK_BROWN, BLACK,
 BROWN, DARK_BROWN, DARK_BROWN, DARK_BROWN, DARK_BROWN, DARK_BROWN, DARK_BROWN, DARK_BROWN, DARK_BROWN, DARK_BROWN, DARK_BROWN, DARK_BROWN, DARK_BROWN, DARK_BROWN, DARK_BROWN, BLACK,
 CLEAR, BROWN, BROWN, BROWN, BROWN, BROWN, BROWN, BROWN, BROWN, BROWN, BROWN, BROWN, BROWN, BROWN, BROWN, CLEAR,
};

const unsigned char shroom_pixels[] = {
 CLEAR, CLEAR, CLEAR, CLEAR, CLEAR, WHITE, WHITE, WHITE, WHITE, ORANGE, WHITE, CLEAR, CLEAR, CLEAR, CLEAR, CLEAR,
 CLEAR, CLEAR, CLEAR, CLEAR, WHITE, WHITE, WHITE, WHITE, WHITE, WHITE, ORANGE, WHITE, CLEAR, CLEAR, CLEAR, CLEAR,
 CLEAR, CLEAR, CLEAR, CLEAR, WHITE, WHITE, WHITE, WHITE, WHITE, WHITE, ORANGE, WHITE, CLEAR, CLEAR, CLEAR, CLEAR,
 CLEAR, CLEAR, CLEAR, CLEAR, WHITE, WHITE, WHITE, WHITE, WHITE, WHITE, WHITE, WHITE, CLEAR, CLEAR, CLEAR, CLEAR,
 CLEAR, ORANGE, RED, RED, RED, WHITE, WHITE, WHITE, WHITE, WHITE, WHITE, RED, RED, RED, ORANGE, CLEAR,
 ORANGE, ORANGE, ORANGE, ORANGE, ORANGE, ORANGE, ORANGE, ORANGE, ORANGE, ORANGE, ORANGE, ORANGE, ORANGE, ORANGE, ORANGE, ORANGE,
 ORANGE, ORANGE, ORANGE, RED, RED, RED, ORANGE, ORANGE, ORANGE, ORANGE, ORANGE, ORANGE, ORANGE, RED, RED, ORANGE,
 ORANGE, ORANGE, RED, RED, RED, RED, RED, ORANGE, ORANGE, ORANGE, ORANGE, ORANGE, RED, RED, RED, ORANGE,
 ORANGE, ORANGE, RED, RED, RED, RED, RED, ORANGE, ORANGE, ORANGE, ORANGE, ORANGE, RED, RED, ORANGE, ORANGE,
 CLEAR, ORANGE, RED, RED, RED, RED, RED, ORANGE, ORANGE, ORANGE, ORANGE, ORANGE, ORANGE, ORANGE, ORANGE, CLEAR,
 CLEAR, ORANGE, ORANGE, RED, RED, RED, ORANGE, ORANGE, ORANGE, ORANGE, ORANGE, ORANGE, ORANGE, ORANGE, ORANGE, CLEAR,
 CLEAR, CLEAR, ORANGE, ORANGE, ORANGE, ORANGE, ORANGE, ORANGE, ORANGE, RED, RED, RED, ORANGE, ORANGE, CLEAR, CLEAR,
 CLEAR, CLEAR, CLEAR, ORANGE, ORANGE, ORANGE, ORANGE, ORANGE, RED, RED, RED, RED, RED, CLEAR, CLEAR, CLEAR,
 CLEAR, CLEAR, CLEAR, CLEAR, ORANGE, ORANGE, ORANGE, ORANGE, RED, RED, RED, RED, CLEAR, CLEAR, CLEAR, CLEAR,
 CLEAR, CLEAR, CLEAR, CLEAR, CLEAR, ORANGE, ORANGE, ORANGE, ORANGE, RED, RED, CLEAR, CLEAR, CLEAR, CLEAR, CLEAR,
 CLEAR, CLEAR, CLEAR, CLEAR, CLEAR, CLEAR, ORANGE, ORANGE, ORANGE, ORANGE, CLEAR, CLEAR, CLEAR, CLEAR, CLEAR, CLEAR,
};

const unsigned char question_block_empty_pixels[] = {
 CLEAR, BLACK, BLACK, BLACK, BLACK, BLACK, BLACK, BLACK, BLACK, BLACK, BLACK, BLACK, BLACK, BLACK, BLACK, CLEAR,
 BLACK, BROWN, BROWN, BROWN, BROWN, BROWN, BROWN, BROWN, BROWN, BROWN, BROWN, BROWN, BROWN, BROWN, BROWN, BLACK,
 BLACK, BROWN, BLACK, BROWN, BROWN, BROWN, BROWN, BROWN, BROWN, BROWN, BROWN, BROWN, BROWN, BLACK, BROWN, BLACK,
 BLACK, BROWN, BROWN, BROWN, BROWN, BROWN, BROWN, BROWN, BROWN, BROWN, BROWN, BROWN, BROWN, BROWN, BROWN, BLACK,
 BLACK, BROWN, BROWN, BROWN, BROWN, BROWN, BROWN, BROWN, BROWN, BROWN, BROWN, BROWN, BROWN, BROWN, BROWN, BLACK,
 BLACK, BROWN, BROWN, BROWN, BROWN, BROWN, BROWN, BROWN, BROWN, BROWN, BROWN, BROWN, BROWN, BROWN, BROWN, BLACK,
 BLACK, BROWN, BROWN, BROWN, BROWN, BROWN, BROWN, BROWN, BROWN, BROWN, BROWN, BROWN, BROWN, BROWN, BROWN, BLACK,
 BLACK, BROWN, BROWN, BROWN, BROWN, BROWN, BROWN, BROWN, BROWN, BROWN, BROWN, BROWN, BROWN, BROWN, BROWN, BLACK,
 BLACK, BROWN, BROWN, BROWN, BROWN, BROWN, BROWN, BROWN, BROWN, BROWN, BROWN, BROWN, BROWN, BROWN, BROWN, BLACK,
 BLACK, BROWN, BROWN, BROWN, BROWN, BROWN, BROWN, BROWN, BROWN, BROWN, BROWN, BROWN, BROWN, BROWN, BROWN, BLACK,
 BLACK, BROWN, BROWN, BROWN, BROWN, BROWN, BROWN, BROWN, BROWN, BROWN, BROWN, BROWN, BROWN, BROWN, BROWN, BLACK,
 BLACK, BROWN, BROWN, BROWN, BROWN, BROWN, BROWN, BROWN, BROWN, BROWN, BROWN, BROWN, BROWN, BROWN, BROWN, BLACK,
 BLACK, BROWN, BROWN, BROWN, BROWN, BROWN, BROWN, BROWN, BROWN, BROWN, BROWN, BROWN, BROWN, BROWN, BROWN, BLACK,
 BLACK, BROWN, BLACK, BROWN, BROWN, BROWN, BROWN, BROWN, BROWN, BROWN, BROWN, BROWN, BROWN, BLACK, BROWN, BLACK,
 BLACK, BROWN, BROWN, BROWN, BROWN, BROWN, BROWN, BROWN, BROWN, BROWN, BROWN, BROWN, BROWN, BROWN, BROWN, BLACK,
 CLEAR, BLACK, BLACK, BLACK, BLACK, BLACK, BLACK, BLACK, BLACK, BLACK, BLACK, BLACK, BLACK, BLACK, BLACK, CLEAR,
};

const unsigned char mario_2_stand_pixels[] = {
 OLIVE, OLIVE, OLIVE, OLIVE, OLIVE, OLIVE, CLEAR, CLEAR, CLEAR, CLEAR, OLIVE, OLIVE, OLIVE, OLIVE, OLIVE, OLIVE,
 OLIVE, OLIVE, OLIVE, OLIVE, OLIVE, OLIVE, CLEAR, CLEAR, CLEAR, CLEAR, OLIVE, OLIVE, OLIVE, OLIVE, OLIVE, OLIVE,
 CLEAR, CLEAR, OLIVE, OLIVE, OLIVE, OLIVE, CLEAR, CLEAR, CLEAR, CLEAR, OLIVE, OLIVE, OLIVE, OLIVE, CLEAR, CLEAR,
 CLEAR, CLEAR, OLIVE, OLIVE, OLIVE, OLIVE, CLEAR, CLEAR, CLEAR, CLEAR, OLIVE, OLIVE, OLIVE, OLIVE, CLEAR, CLEAR,
 CLEAR, RED, RED, RED, RED, RED, CLEAR, CLEAR, CLEAR, CLEAR, RED, RED, RED, RED, RED, CLEAR,
 CLEAR, RED, RED, RED, RED, RED, CLEAR, CLEAR, CLEAR, CLEAR, RED, RED, RED, RED, RED, CLEAR,
 CLEAR, RED, RED, RED, RED, RED, RED, CLEAR, CLEAR, RED, RED, RED, RED, RED, RED, CLEAR,
 CLEAR, CLEAR, RED, RED, RED, RED, RED, RED, RED, RED, RED, RED, RED, RED, CLEAR, CLEAR,
 CLEAR, ORANGE, ORANGE, RED, RED, RED, RED, RED, RED, RED, RED, RED, RED, ORANGE, ORANGE, CLEAR,
 CLEAR, ORANGE, ORANGE, ORANGE, RED, RED, RED, RED, RED, RED, RED, RED, ORANGE, ORANGE, ORANGE, CLEAR,
 ORANGE, ORANGE, ORANGE, ORANGE, RED, RED, RED, RED, RED, RED, RED, RED, ORANGE, ORANGE, ORANGE, ORANGE,
 ORANGE, ORANGE, ORANGE, ORANGE, RED, RED, RED, RED, RED, RED, RED, RED, ORANGE, ORANGE, ORANGE, ORANGE,
 OLIVE, OLIVE, OLIVE, OLIVE, RED, ORANGE, RED, RED, RED, RED, ORANGE, RED, OLIVE, OLIVE, OLIVE, OLIVE,
 OLIVE, OLIVE, OLIVE, OLIVE, RED, RED, RED, RED, RED, RED, RED, RED, OLIVE, OLIVE, OLIVE, OLIVE,
 OLIVE, OLIVE, OLIVE, OLIVE, RED, RED, OLIVE, OLIVE, OLIVE, OLIVE, RED, RED, OLIVE, OLIVE, OLIVE, OLIVE,
 CLEAR, OLIVE, OLIVE, OLIVE, RED, RED, OLIVE, OLIVE, OLIVE, OLIVE, RED, RED, OLIVE, OLIVE, OLIVE, CLEAR,
 CLEAR, OLIVE, OLIVE, OLIVE, OLIVE, RED, OLIVE, OLIVE, OLIVE, OLIVE, RED, OLIVE, OLIVE, OLIVE, OLIVE, CLEAR,
 CLEAR, CLEAR, OLIVE, OLIVE, OLIVE, RED, OLIVE, OLIVE, OLIVE, OLIVE, RED, OLIVE, OLIVE, OLIVE, CLEAR, CLEAR,
 CLEAR, CLEAR, CLEAR, OLIVE, OLIVE, RED, OLIVE, OLIVE, OLIVE, OLIVE, RED, OLIVE, OLIVE, CLEAR, CLEAR, CLEAR,
 CLEAR, CLEAR, CLEAR, CLEAR, OLIVE, RED, OLIVE, OLIVE, OLIVE, OLIVE, RED, OLIVE, CLEAR, CLEAR, CLEAR, CLEAR,
 CLEAR, CLEAR, CLEAR, CLEAR, RED, ORANGE, ORANGE, ORANGE, ORANGE, ORANGE, OLIVE, CLEAR, CLEAR, CLEAR, CLEAR, CLEAR,
 CLEAR, CLEAR, CLEAR, OLIVE, OLIVE, ORANGE, ORANGE, ORANGE, ORANGE, ORANGE, ORANGE, ORANGE, ORANGE, CLEAR, CLEAR, CLEAR,
 CLEAR, OLIVE, OLIVE, OLIVE, ORANGE, ORANGE, ORANGE, ORANGE, ORANGE, OLIVE, OLIVE, OLIVE, OLIVE, OLIVE, CLEAR, CLEAR,
 CLEAR, OLIVE, OLIVE, ORANGE, ORANGE, ORANGE, ORANGE, ORANGE, OLIVE, OLIVE, OLIVE, OLIVE, OLIVE, OLIVE, CLEAR, CLEAR,
 CLEAR, OLIVE, OLIVE, ORANGE, ORANGE, OLIVE, OLIVE, ORANGE, ORANGE, ORANGE, OLIVE, ORANGE, ORANGE, ORANGE, ORANGE, CLEAR,
 CLEAR, CLEAR, OLIVE, ORANGE, ORANGE, OLIVE, OLIVE, ORANGE, ORANGE, ORANGE, ORANGE, ORANGE, ORANGE, ORANGE, ORANGE, CLEAR,
 CLEAR, CLEAR, OLIVE, ORANGE, ORANGE, OLIVE, ORANGE, ORANGE, OLIVE, OLIVE, ORANGE, ORANGE, ORANGE, ORANGE, CLEAR, CLEAR,
 CLEAR, CLEAR, CLEAR, OLIVE, OLIVE, OLIVE, ORANGE, ORANGE, OLIVE, ORANGE, ORANGE, ORANGE, CLEAR, CLEAR, CLEAR, CLEAR,
 CLEAR, CLEAR, CLEAR, RED, RED, RED, RED, RED, RED, RED, RED, RED, RED, RED, CLEAR, CLEAR,
 CLEAR, CLEAR, CLEAR, RED, RED, RED, RED, RED, RED, ORANGE, ORANGE, CLEAR, CLEAR, CLEAR, CLEAR, CLEAR,
 CLEAR, CLEAR, CLEAR, CLEAR, RED, RED, RED, RED, RED, RED, ORANGE, CLEAR, CLEAR, CLEAR, CLEAR, CLEAR,
 CLEAR, CLEAR, CLEAR, CLEAR, CLEAR, CLEAR, RED, RED, RED, RED, RED, CLEAR, CLEAR, CLEAR, CLEAR, CLEAR,
};

const unsigned char mario_2_run_3_pixels[] = {
 CLEAR, CLEAR, CLEAR, CLEAR, CLEAR, CLEAR, OLIVE, OLIVE, OLIVE, OLIVE, OLIVE, CLEAR, CLEAR, CLEAR, CLEAR, CLEAR,
 CLEAR, CLEAR, CLEAR, CLEAR, OLIVE, OLIVE, OLIVE, OLIVE, OLIVE, OLIVE, OLIVE, CLEAR, CLEAR, CLEAR, CLEAR, CLEAR,
 CLEAR, CLEAR, CLEAR, CLEAR, OLIVE, OLIVE, OLIVE, OLIVE, OLIVE, CLEAR, CLEAR, CLEAR, CLEAR, CLEAR, CLEAR, CLEAR,
 CLEAR, CLEAR, CLEAR, CLEAR, CLEAR, OLIVE, OLIVE, OLIVE, OLIVE, CLEAR, OLIVE, OLIVE, CLEAR, CLEAR, CLEAR, CLEAR,
 CLEAR, CLEAR, CLEAR, CLEAR, CLEAR, OLIVE, RED, RED, RED, OLIVE, OLIVE, OLIVE, CLEAR, CLEAR, CLEAR, CLEAR,
 CLEAR, CLEAR, CLEAR, CLEAR, CLEAR, RED, RED, OLIVE, OLIVE, OLIVE, OLIVE, CLEAR, CLEAR, CLEAR, CLEAR, CLEAR,
 CLEAR, CLEAR, CLEAR, CLEAR, RED, RED, OLIVE, OLIVE, OLIVE, OLIVE, OLIVE, OLIVE, CLEAR, CLEAR, CLEAR, CLEAR,
 CLEAR, CLEAR, CLEAR, CLEAR, RED, RED, RED, OLIVE, OLIVE, OLIVE, OLIVE, OLIVE, OLIVE, CLEAR, CLEAR, CLEAR,
 CLEAR, CLEAR, CLEAR, RED, RED, RED, RED, RED, OLIVE, OLIVE, OLIVE, RED, RED, CLEAR, CLEAR, CLEAR,
 CLEAR, CLEAR, RED, RED, RED, RED, RED, RED, OLIVE, OLIVE, RED, RED, RED, RED, CLEAR, CLEAR,
 CLEAR, CLEAR, RED, RED, RED, RED, OLIVE, OLIVE, ORANGE, ORANGE, ORANGE, RED, RED, RED, CLEAR, CLEAR,
 CLEAR, CLEAR, RED, RED, RED, OLIVE, OLIVE, OLIVE, ORANGE, ORANGE, ORANGE, ORANGE, RED, RED, CLEAR, CLEAR,
 CLEAR, CLEAR, RED, RED, OLIVE, OLIVE, OLIVE, OLIVE, ORANGE, ORANGE, ORANGE, ORANGE, RED, CLEAR, CLEAR, CLEAR,
 CLEAR, CLEAR, OLIVE, RED, OLIVE, OLIVE, OLIVE, OLIVE, ORANGE, ORANGE, ORANGE, ORANGE, CLEAR, CLEAR, CLEAR, CLEAR,
 CLEAR, CLEAR, OLIVE, RED, OLIVE, OLIVE, OLIVE, OLIVE, OLIVE, ORANGE, ORANGE, OLIVE, CLEAR, CLEAR, CLEAR, CLEAR,
 CLEAR, CLEAR, OLIVE, RED, OLIVE, OLIVE, OLIVE, OLIVE, RED, RED, RED, OLIVE, CLEAR, CLEAR, CLEAR, CLEAR,
 CLEAR, CLEAR, OLIVE, RED, OLIVE, OLIVE, OLIVE, OLIVE, RED, RED, OLIVE, OLIVE, CLEAR, CLEAR, CLEAR, CLEAR,
 CLEAR, CLEAR, OLIVE, RED, OLIVE, OLIVE, OLIVE, OLIVE, RED, RED, OLIVE, CLEAR, CLEAR, CLEAR, CLEAR, CLEAR,
 CLEAR, CLEAR, CLEAR, OLIVE, RED, OLIVE, OLIVE, RED, RED, OLIVE, OLIVE, CLEAR, CLEAR, CLEAR, CLEAR, CLEAR,
 CLEAR, CLEAR, CLEAR, CLEAR, RED, RED, RED, RED, ORANGE, ORANGE, CLEAR, CLEAR, CLEAR, CLEAR, CLEAR, CLEAR,
 CLEAR, CLEAR, CLEAR, OLIVE, OLIVE, ORANGE, ORANGE, ORANGE, ORANGE, ORANGE, ORANGE, ORANGE, ORANGE, CLEAR, CLEAR, CLEAR,
 CLEAR, CLEAR, OLIVE, OLIVE, ORANGE, ORANGE, ORANGE, ORANGE, ORANGE, OLIVE, OLIVE, OLIVE, OLIVE, OLIVE, CLEAR, CLEAR,
 CLEAR, OLIVE, OLIVE, ORANGE, ORANGE, ORANGE, ORANGE, ORANGE, OLIVE, OLIVE, OLIVE, OLIVE, OLIVE, OLIVE, CLEAR, CLEAR,
 CLEAR, OLIVE, OLIVE, ORANGE, ORANGE, OLIVE, OLIVE, ORANGE, ORANGE, ORANGE, OLIVE, ORANGE, ORANGE, ORANGE, ORANGE, CLEAR,
 CLEAR, CLEAR, OLIVE, ORANGE, ORANGE, OLIVE, OLIVE, ORANGE, ORANGE, ORANGE, ORANGE, ORANGE, ORANGE, ORANGE, ORANGE, CLEAR,
 CLEAR, CLEAR, OLIVE, ORANGE, ORANGE, OLIVE, ORANGE, ORANGE, OLIVE, OLIVE, ORANGE, ORANGE, ORANGE, ORANGE, CLEAR, CLEAR,
 CLEAR, CLEAR, CLEAR, OLIVE, OLIVE, OLIVE, ORANGE, ORANGE, OLIVE, ORANGE, ORANGE, ORANGE, CLEAR, CLEAR, CLEAR, CLEAR,
 CLEAR, CLEAR, CLEAR, RED, RED, RED, RED, RED, RED, RED, RED, RED, RED, RED, CLEAR, CLEAR,
 CLEAR, CLEAR, CLEAR, RED, RED, RED, RED, RED, RED, ORANGE, ORANGE, CLEAR, CLEAR, CLEAR, CLEAR, CLEAR,
 CLEAR, CLEAR, CLEAR, CLEAR, RED, RED, RED, RED, RED, RED, ORANGE, CLEAR, CLEAR, CLEAR, CLEAR, CLEAR,
 CLEAR, CLEAR, CLEAR, CLEAR, CLEAR, CLEAR, RED, RED, RED, RED, RED, CLEAR, CLEAR, CLEAR, CLEAR, CLEAR,
 CLEAR, CLEAR, CLEAR, CLEAR, CLEAR, CLEAR, CLEAR, CLEAR, CLEAR, CLEAR, CLEAR, CLEAR, CLEAR, CLEAR, CLEAR, CLEAR,
};

const unsigned char mario_2_run_2_pixels[] = {
 CLEAR, CLEAR, CLEAR, CLEAR, CLEAR, CLEAR, CLEAR, CLEAR, CLEAR, CLEAR, CLEAR, CLEAR, CLEAR, CLEAR, CLEAR, CLEAR,
 CLEAR, CLEAR, CLEAR, CLEAR, CLEAR, CLEAR, CLEAR, CLEAR, CLEAR, OLIVE, OLIVE, OLIVE, OLIVE, OLIVE, OLIVE, CLEAR,
 OLIVE, CLEAR, CLEAR, CLEAR, CLEAR, CLEAR, CLEAR, CLEAR, CLEAR, OLIVE, OLIVE, OLIVE, OLIVE, OLIVE, OLIVE, CLEAR,
 OLIVE, OLIVE, CLEAR, CLEAR, CLEAR, CLEAR, CLEAR, CLEAR, CLEAR, OLIVE, OLIVE, OLIVE, OLIVE, CLEAR, CLEAR, CLEAR,
 OLIVE, OLIVE, OLIVE, OLIVE, CLEAR, CLEAR, CLEAR, CLEAR, CLEAR, OLIVE, OLIVE, OLIVE, OLIVE, CLEAR, CLEAR, CLEAR,
 OLIVE, OLIVE, OLIVE, OLIVE, RED, RED, RED, CLEAR, CLEAR, RED, RED, RED, RED, CLEAR, CLEAR, CLEAR,
 OLIVE, OLIVE, OLIVE, OLIVE, RED, RED, RED, RED, OLIVE, RED, RED, RED, RED, CLEAR, CLEAR, CLEAR,
 OLIVE, OLIVE, OLIVE, OLIVE, RED, RED, RED, RED, RED, OLIVE, OLIVE, RED, RED, RED, CLEAR, CLEAR,
 OLIVE, OLIVE, OLIVE, OLIVE, RED, RED, RED, RED, RED, RED, RED, OLIVE, RED, RED, CLEAR, CLEAR,
 CLEAR, CLEAR, CLEAR, RED, RED, RED, RED, RED, RED, RED, RED, RED, OLIVE, CLEAR, CLEAR, CLEAR,
 CLEAR, CLEAR, CLEAR, RED, RED, RED, RED, RED, RED, RED, RED, RED, RED, CLEAR, CLEAR, CLEAR,
 CLEAR, CLEAR, CLEAR, RED, RED, RED, RED, RED, RED, OLIVE, OLIVE, OLIVE, RED, CLEAR, CLEAR, CLEAR,
 CLEAR, CLEAR, CLEAR, RED, RED, RED, RED, OLIVE, OLIVE, OLIVE, OLIVE, OLIVE, OLIVE, ORANGE, ORANGE, ORANGE,
 CLEAR, CLEAR, CLEAR, RED, RED, RED, OLIVE, OLIVE, OLIVE, OLIVE, OLIVE, OLIVE, OLIVE, ORANGE, ORANGE, ORANGE,
 CLEAR, CLEAR, OLIVE, RED, RED, RED, OLIVE, OLIVE, OLIVE, OLIVE, OLIVE, OLIVE, ORANGE, ORANGE, ORANGE, ORANGE,
 CLEAR, CLEAR, OLIVE, RED, RED, OLIVE, OLIVE, OLIVE, OLIVE, OLIVE, OLIVE, OLIVE, ORANGE, ORANGE, ORANGE, ORANGE,
 CLEAR, CLEAR, OLIVE, OLIVE, RED, OLIVE, OLIVE, OLIVE, OLIVE, OLIVE, RED, RED, ORANGE, ORANGE, CLEAR, CLEAR,
 CLEAR, CLEAR, CLEAR, OLIVE, RED, OLIVE, OLIVE, OLIVE, OLIVE, RED, OLIVE, CLEAR, CLEAR, CLEAR, CLEAR, CLEAR,
 CLEAR, CLEAR, CLEAR, OLIVE, RED, OLIVE, OLIVE, OLIVE, RED, OLIVE, CLEAR, CLEAR, CLEAR, CLEAR, CLEAR, CLEAR,
 CLEAR, CLEAR, CLEAR, CLEAR, OLIVE, RED, RED, RED, ORANGE, ORANGE, ORANGE, CLEAR, CLEAR, CLEAR, CLEAR, CLEAR,
 CLEAR, CLEAR, CLEAR, CLEAR, CLEAR, OLIVE, ORANGE, ORANGE, ORANGE, ORANGE, ORANGE, ORANGE, ORANGE, ORANGE, CLEAR, CLEAR,
 CLEAR, CLEAR, CLEAR, OLIVE, OLIVE, ORANGE, ORANGE, ORANGE, ORANGE, ORANGE, OLIVE, OLIVE, OLIVE, OLIVE, OLIVE, CLEAR,
 CLEAR, CLEAR, OLIVE, OLIVE, ORANGE, ORANGE, ORANGE, ORANGE, ORANGE, OLIVE, OLIVE, OLIVE, OLIVE, OLIVE, OLIVE, CLEAR,
 CLEAR, CLEAR, OLIVE, OLIVE, ORANGE, ORANGE, OLIVE, OLIVE, ORANGE, ORANGE, ORANGE, OLIVE, ORANGE, ORANGE, ORANGE, ORANGE,
 CLEAR, CLEAR, CLEAR, OLIVE, ORANGE, ORANGE, OLIVE, OLIVE, ORANGE, ORANGE, ORANGE, ORANGE, ORANGE, ORANGE, ORANGE, ORANGE,
 CLEAR, CLEAR, CLEAR, OLIVE, ORANGE, ORANGE, OLIVE, ORANGE, ORANGE, OLIVE, OLIVE, ORANGE, ORANGE, ORANGE, ORANGE, CLEAR,
 CLEAR, CLEAR, CLEAR, CLEAR, OLIVE, OLIVE, OLIVE, ORANGE, ORANGE, OLIVE, ORANGE, ORANGE, ORANGE, CLEAR, CLEAR, CLEAR,
 CLEAR, CLEAR, CLEAR, CLEAR, RED, RED, RED, RED, RED, RED, RED, RED, RED, RED, RED, CLEAR,
 CLEAR, CLEAR, CLEAR, CLEAR, RED, RED, RED, RED, RED, RED, ORANGE, ORANGE, CLEAR, CLEAR, CLEAR, CLEAR,
 CLEAR, CLEAR, CLEAR, CLEAR, CLEAR, RED, RED, RED, RED, RED, RED, ORANGE, CLEAR, CLEAR, CLEAR, CLEAR,
 CLEAR, CLEAR, CLEAR, CLEAR, CLEAR, CLEAR, CLEAR, RED, RED, RED, RED, RED, CLEAR, CLEAR, CLEAR, CLEAR,
 CLEAR, CLEAR, CLEAR, CLEAR, CLEAR, CLEAR, CLEAR, CLEAR, CLEAR, CLEAR, CLEAR, CLEAR, CLEAR, CLEAR, CLEAR, CLEAR,
};

const unsigned char mario_2_run_1_pixels[] = {
 CLEAR, CLEAR, OLIVE, OLIVE, OLIVE, CLEAR, CLEAR, CLEAR, CLEAR, CLEAR, CLEAR, CLEAR, CLEAR, CLEAR, CLEAR, CLEAR,
 CLEAR, OLIVE, OLIVE, OLIVE, CLEAR, CLEAR, CLEAR, CLEAR, CLEAR, CLEAR, CLEAR, CLEAR, CLEAR, CLEAR, CLEAR, CLEAR,
 CLEAR, OLIVE, OLIVE, OLIVE, CLEAR, CLEAR, CLEAR, CLEAR, CLEAR, CLEAR, CLEAR, CLEAR, CLEAR, CLEAR, CLEAR, CLEAR,
 OLIVE, OLIVE, OLIVE, OLIVE, OLIVE, RED, CLEAR, CLEAR, CLEAR, CLEAR, CLEAR, CLEAR, CLEAR, CLEAR, CLEAR, CLEAR,
 OLIVE, OLIVE, OLIVE, OLIVE, RED, RED, RED, RED, CLEAR, CLEAR, CLEAR, OLIVE, OLIVE, OLIVE, OLIVE, OLIVE,
 OLIVE, OLIVE, OLIVE, RED, RED, RED, OLIVE, OLIVE, RED, RED, RED, OLIVE, OLIVE, OLIVE, OLIVE, OLIVE,
 CLEAR, CLEAR, OLIVE, RED, RED, OLIVE, RED, RED, RED, RED, RED, OLIVE, OLIVE, OLIVE, OLIVE, OLIVE,
 CLEAR, CLEAR, CLEAR, RED, OLIVE, RED, RED, RED, RED, RED, RED, OLIVE, OLIVE, OLIVE, OLIVE, OLIVE,
 CLEAR, ORANGE, ORANGE, ORANGE, RED, RED, RED, RED, RED, RED, RED, OLIVE, OLIVE, OLIVE, OLIVE, OLIVE,
 ORANGE, ORANGE, ORANGE, ORANGE, RED, RED, RED, RED, RED, RED, RED, RED, RED, CLEAR, OLIVE, OLIVE,
 ORANGE, ORANGE, ORANGE, ORANGE, ORANGE, RED, RED, RED, RED, RED, RED, RED, RED, CLEAR, CLEAR, OLIVE,
 ORANGE, ORANGE, ORANGE, ORANGE, ORANGE, RED, RED, RED, RED, RED, RED, RED, RED, CLEAR, CLEAR, CLEAR,
 OLIVE, OLIVE, OLIVE, OLIVE, RED, RED, RED, RED, RED, RED, RED, RED, RED, CLEAR, CLEAR, CLEAR,
 OLIVE, OLIVE, OLIVE, OLIVE, OLIVE, OLIVE, RED, RED, RED, ORANGE, RED, OLIVE, ORANGE, OLIVE, CLEAR, CLEAR,
 CLEAR, OLIVE, OLIVE, OLIVE, OLIVE, OLIVE, OLIVE, RED, RED, RED, OLIVE, OLIVE, RED, OLIVE, OLIVE, CLEAR,
 CLEAR, OLIVE, OLIVE, OLIVE, OLIVE, OLIVE, OLIVE, OLIVE, RED, RED, OLIVE, OLIVE, RED, OLIVE, ORANGE, OLIVE,
 CLEAR, OLIVE, OLIVE, OLIVE, OLIVE, OLIVE, OLIVE, OLIVE, RED, RED, OLIVE, OLIVE, RED, ORANGE, ORANGE, ORANGE,
 CLEAR, CLEAR, OLIVE, OLIVE, OLIVE, OLIVE, OLIVE, OLIVE, RED, RED, OLIVE, RED, OLIVE, ORANGE, ORANGE, ORANGE,
 CLEAR, CLEAR, CLEAR, OLIVE, OLIVE, OLIVE, OLIVE, RED, RED, OLIVE, OLIVE, RED, CLEAR, ORANGE, ORANGE, ORANGE,
 CLEAR, CLEAR, CLEAR, CLEAR, RED, RED, RED, RED, OLIVE, OLIVE, RED, CLEAR, CLEAR, CLEAR, ORANGE, CLEAR,
 CLEAR, CLEAR, CLEAR, CLEAR, CLEAR, OLIVE, OLIVE, OLIVE, ORANGE, ORANGE, CLEAR, CLEAR, CLEAR, CLEAR, CLEAR, CLEAR,
 CLEAR, CLEAR, CLEAR, OLIVE, OLIVE, ORANGE, ORANGE, ORANGE, ORANGE, ORANGE, ORANGE, ORANGE, ORANGE, CLEAR, CLEAR, CLEAR,
 CLEAR, OLIVE, OLIVE, OLIVE, ORANGE, ORANGE, ORANGE, ORANGE, ORANGE, OLIVE, OLIVE, OLIVE, OLIVE, OLIVE, CLEAR, CLEAR,
 CLEAR, OLIVE, OLIVE, ORANGE, ORANGE, ORANGE, ORANGE, ORANGE, OLIVE, OLIVE, OLIVE, OLIVE, OLIVE, OLIVE, CLEAR, CLEAR,
 CLEAR, OLIVE, OLIVE, ORANGE, ORANGE, OLIVE, OLIVE, ORANGE, ORANGE, ORANGE, OLIVE, ORANGE, ORANGE, ORANGE, ORANGE, CLEAR,
 CLEAR, CLEAR, OLIVE, ORANGE, ORANGE, OLIVE, OLIVE, ORANGE, ORANGE, ORANGE, ORANGE, ORANGE, ORANGE, ORANGE, ORANGE, CLEAR,
 CLEAR, CLEAR, OLIVE, ORANGE, ORANGE, OLIVE, ORANGE, ORANGE, OLIVE, OLIVE, ORANGE, ORANGE, ORANGE, ORANGE, CLEAR, CLEAR,
 CLEAR, CLEAR, CLEAR, OLIVE, OLIVE, OLIVE, ORANGE, ORANGE, OLIVE, ORANGE, ORANGE, ORANGE, CLEAR, CLEAR, CLEAR, CLEAR,
 CLEAR, CLEAR, CLEAR, RED, RED, RED, RED, RED, RED, RED, RED, RED, RED, RED, CLEAR, CLEAR,
 CLEAR, CLEAR, CLEAR, RED, RED, RED, RED, RED, RED, ORANGE, ORANGE, CLEAR, CLEAR, CLEAR, CLEAR, CLEAR,
 CLEAR, CLEAR, CLEAR, CLEAR, RED, RED, RED, RED, RED, RED, ORANGE, CLEAR, CLEAR, CLEAR, CLEAR, CLEAR,
 CLEAR, CLEAR, CLEAR, CLEAR, CLEAR, CLEAR, RED, RED, RED, RED, RED, CLEAR, CLEAR, CLEAR, CLEAR, CLEAR,
};

const unsigned char mario_2_jump_pixels[] = {
 OLIVE, CLEAR, CLEAR, CLEAR, CLEAR, CLEAR, CLEAR, CLEAR, CLEAR, CLEAR, CLEAR, CLEAR, CLEAR, CLEAR, CLEAR, CLEAR,
 OLIVE, OLIVE, CLEAR, CLEAR, CLEAR, CLEAR, CLEAR, CLEAR, CLEAR, CLEAR, CLEAR, CLEAR, CLEAR, CLEAR, CLEAR, CLEAR,
 OLIVE, OLIVE, OLIVE, RED, RED, RED, RED, CLEAR, CLEAR, CLEAR, CLEAR, CLEAR, CLEAR, CLEAR, CLEAR, CLEAR,
 OLIVE, OLIVE, OLIVE, RED, RED, RED, RED, RED, CLEAR, CLEAR, CLEAR, CLEAR, CLEAR, CLEAR, CLEAR, CLEAR,
 OLIVE, OLIVE, OLIVE, RED, RED, RED, RED, RED, CLEAR, CLEAR, RED, RED, OLIVE, OLIVE, OLIVE, OLIVE,
 OLIVE, OLIVE, OLIVE, RED, RED, RED, OLIVE, OLIVE, RED, RED, RED, RED, OLIVE, OLIVE, OLIVE, OLIVE,
 OLIVE, OLIVE, OLIVE, RED, OLIVE, OLIVE, RED, RED, RED, RED, RED, RED, OLIVE, OLIVE, OLIVE, OLIVE,
 CLEAR, CLEAR, CLEAR, OLIVE, RED, RED, RED, RED, RED, RED, RED, RED, OLIVE, OLIVE, OLIVE, OLIVE,
 CLEAR, CLEAR, CLEAR, RED, RED, RED, RED, RED, RED, RED, RED, RED, OLIVE, OLIVE, OLIVE, OLIVE,
 CLEAR, ORANGE, ORANGE, RED, RED, RED, RED, RED, RED, RED, RED, RED, RED, CLEAR, OLIVE, OLIVE,
 ORANGE, ORANGE, ORANGE, ORANGE, RED, RED, RED, RED, RED, RED, RED, RED, RED, CLEAR, CLEAR, OLIVE,
 ORANGE, ORANGE, ORANGE, ORANGE, ORANGE, RED, RED, RED, RED, RED, RED, RED, RED, CLEAR, CLEAR, CLEAR,
 ORANGE, ORANGE, ORANGE, ORANGE, ORANGE, OLIVE, RED, RED, RED, ORANGE, RED, RED, RED, CLEAR, CLEAR, CLEAR,
 OLIVE, ORANGE, ORANGE, ORANGE, ORANGE, OLIVE, OLIVE, RED, RED, RED, RED, OLIVE, ORANGE, CLEAR, CLEAR, CLEAR,
 OLIVE, OLIVE, ORANGE, ORANGE, OLIVE, OLIVE, OLIVE, OLIVE, RED, RED, OLIVE, OLIVE, RED, CLEAR, CLEAR, CLEAR,
 OLIVE, OLIVE, OLIVE, OLIVE, OLIVE, OLIVE, OLIVE, OLIVE, RED, RED, OLIVE, RED, OLIVE, CLEAR, CLEAR, CLEAR,
 OLIVE, OLIVE, OLIVE, OLIVE, OLIVE, OLIVE, OLIVE, OLIVE, RED, OLIVE, OLIVE, RED, OLIVE, OLIVE, CLEAR, CLEAR,
 CLEAR, OLIVE, OLIVE, OLIVE, OLIVE, OLIVE, OLIVE, RED, RED, OLIVE, RED, OLIVE, OLIVE, OLIVE, CLEAR, CLEAR,
 CLEAR, CLEAR, CLEAR, CLEAR, RED, RED, RED, RED, OLIVE, OLIVE, RED, OLIVE, OLIVE, OLIVE, OLIVE, CLEAR,
 CLEAR, CLEAR, CLEAR, OLIVE, OLIVE, ORANGE, ORANGE, ORANGE, ORANGE, ORANGE, ORANGE, ORANGE, ORANGE, OLIVE, OLIVE, CLEAR,
 CLEAR, OLIVE, OLIVE, OLIVE, OLIVE, ORANGE, ORANGE, ORANGE, ORANGE, OLIVE, OLIVE, OLIVE, OLIVE, ORANGE, OLIVE, CLEAR,
 CLEAR, OLIVE, OLIVE, ORANGE, ORANGE, ORANGE, ORANGE, ORANGE, OLIVE, OLIVE, OLIVE, OLIVE, OLIVE, OLIVE, OLIVE, CLEAR,
 CLEAR, CLEAR, OLIVE, ORANGE, ORANGE, OLIVE, OLIVE, ORANGE, ORANGE, ORANGE, OLIVE, ORANGE, ORANGE, ORANGE, ORANGE, OLIVE,
 CLEAR, CLEAR, OLIVE, ORANGE, ORANGE, OLIVE, OLIVE, ORANGE, ORANGE, ORANGE, ORANGE, ORANGE, ORANGE, ORANGE, ORANGE, OLIVE,
 CLEAR, CLEAR, OLIVE, ORANGE, ORANGE, OLIVE, ORANGE, ORANGE, OLIVE, ORANGE, ORANGE, ORANGE, ORANGE, ORANGE, OLIVE, OLIVE,
 CLEAR, CLEAR, CLEAR, OLIVE, OLIVE, OLIVE, ORANGE, ORANGE, OLIVE, ORANGE, ORANGE, ORANGE, OLIVE, OLIVE, OLIVE, OLIVE,
 CLEAR, CLEAR, CLEAR, RED, RED, RED, RED, RED, RED, RED, RED, RED, RED, RED, OLIVE, OLIVE,
 CLEAR, CLEAR, CLEAR, RED, RED, RED, RED, RED, RED, RED, RED, OLIVE, OLIVE, OLIVE, OLIVE, OLIVE,
 CLEAR, CLEAR, CLEAR, CLEAR, RED, RED, RED, RED, RED, RED, RED, ORANGE, ORANGE, ORANGE, ORANGE, ORANGE,
 CLEAR, CLEAR, CLEAR, CLEAR, CLEAR, CLEAR, RED, RED, RED, RED, RED, ORANGE, ORANGE, OLIVE, OLIVE, ORANGE,
 CLEAR, CLEAR, CLEAR, CLEAR, CLEAR, CLEAR, CLEAR, CLEAR, CLEAR, CLEAR, CLEAR, ORANGE, ORANGE, OLIVE, ORANGE, ORANGE,
 CLEAR, CLEAR, CLEAR, CLEAR, CLEAR, CLEAR, CLEAR, CLEAR, CLEAR, CLEAR, CLEAR, CLEAR, ORANGE, ORANGE, ORANGE, CLEAR,
};

const unsigned char mario_2_flag_pixels[] = {
 CLEAR, CLEAR, CLEAR, CLEAR, CLEAR, CLEAR, CLEAR, CLEAR, CLEAR, CLEAR, CLEAR, CLEAR, CLEAR, CLEAR, CLEAR, CLEAR,
 CLEAR, CLEAR, CLEAR, CLEAR, CLEAR, CLEAR, CLEAR, CLEAR, CLEAR, CLEAR, CLEAR, CLEAR, CLEAR, CLEAR, CLEAR, CLEAR,
 CLEAR, CLEAR, CLEAR, CLEAR, CLEAR, CLEAR, CLEAR, CLEAR, CLEAR, CLEAR, CLEAR, CLEAR, CLEAR, CLEAR, CLEAR, CLEAR,
 CLEAR, CLEAR, CLEAR, CLEAR, CLEAR, RED, RED, RED, RED, RED, RED, RED, OLIVE, OLIVE, OLIVE, OLIVE,
 CLEAR, CLEAR, CLEAR, CLEAR, RED, RED, RED, RED, RED, RED, RED, RED, OLIVE, OLIVE, OLIVE, OLIVE,
 CLEAR, CLEAR, CLEAR, CLEAR, RED, RED, RED, RED, RED, RED, RED, RED, OLIVE, OLIVE, OLIVE, OLIVE,
 CLEAR, CLEAR, CLEAR, RED, RED, RED, RED, RED, RED, RED, RED, RED, OLIVE, OLIVE, OLIVE, OLIVE,
 CLEAR, CLEAR, CLEAR, RED, RED, RED, RED, RED, RED, RED, RED, RED, RED, CLEAR, OLIVE, OLIVE,
 CLEAR, CLEAR, CLEAR, RED, RED, RED, RED, RED, RED, RED, RED, RED, OLIVE, CLEAR, CLEAR, CLEAR,
 CLEAR, CLEAR, CLEAR, RED, RED, RED, RED, RED, RED, RED, RED, RED, RED, CLEAR, CLEAR, CLEAR,
 CLEAR, CLEAR, CLEAR, RED, RED, RED, RED, RED, RED, OLIVE, OLIVE, OLIVE, RED, CLEAR, CLEAR, CLEAR,
 CLEAR, CLEAR, CLEAR, RED, RED, RED, RED, OLIVE, OLIVE, OLIVE, OLIVE, OLIVE, OLIVE, ORANGE, ORANGE, ORANGE,
 CLEAR, CLEAR, CLEAR, RED, RED, RED, OLIVE, OLIVE, OLIVE, OLIVE, OLIVE, OLIVE, OLIVE, ORANGE, ORANGE, ORANGE,
 CLEAR, CLEAR, OLIVE, RED, RED, RED, OLIVE, OLIVE, OLIVE, OLIVE, OLIVE, OLIVE, ORANGE, ORANGE, ORANGE, ORANGE,
 CLEAR, CLEAR, OLIVE, RED, RED, OLIVE, OLIVE, OLIVE, OLIVE, OLIVE, OLIVE, OLIVE, ORANGE, ORANGE, ORANGE, ORANGE,
 CLEAR, CLEAR, OLIVE, OLIVE, RED, OLIVE, OLIVE, OLIVE, OLIVE, OLIVE, RED, RED, ORANGE, ORANGE, CLEAR, CLEAR,
 CLEAR, CLEAR, CLEAR, OLIVE, RED, OLIVE, OLIVE, OLIVE, OLIVE, RED, OLIVE, CLEAR, CLEAR, CLEAR, CLEAR, CLEAR,
 CLEAR, CLEAR, CLEAR, OLIVE, RED, OLIVE, OLIVE, OLIVE, RED, OLIVE, CLEAR, CLEAR, CLEAR, CLEAR, CLEAR, CLEAR,
 CLEAR, CLEAR, CLEAR, CLEAR, OLIVE, RED, RED, RED, ORANGE, ORANGE, ORANGE, CLEAR, CLEAR, CLEAR, CLEAR, CLEAR,
 CLEAR, CLEAR, CLEAR, CLEAR, CLEAR, OLIVE, ORANGE, ORANGE, ORANGE, ORANGE, ORANGE, ORANGE, ORANGE, ORANGE, CLEAR, CLEAR,
 CLEAR, CLEAR, CLEAR, OLIVE, OLIVE, ORANGE, ORANGE, ORANGE, ORANGE, ORANGE, OLIVE, OLIVE, OLIVE, OLIVE, OLIVE, CLEAR,
 CLEAR, CLEAR, OLIVE, OLIVE, ORANGE, ORANGE, ORANGE, ORANGE, ORANGE, OLIVE, OLIVE, OLIVE, OLIVE, OLIVE, OLIVE, CLEAR,
 CLEAR, CLEAR, OLIVE, OLIVE, ORANGE, ORANGE, OLIVE, OLIVE, ORANGE, ORANGE, ORANGE, OLIVE, ORANGE, ORANGE, ORANGE, ORANGE,
 CLEAR, CLEAR, CLEAR, OLIVE, ORANGE, ORANGE, OLIVE, OLIVE, ORANGE, ORANGE, ORANGE, ORANGE, ORANGE, ORANGE, ORANGE, ORANGE,
 CLEAR, CLEAR, CLEAR, OLIVE, ORANGE, ORANGE, OLIVE, ORANGE, ORANGE, OLIVE, OLIVE, ORANGE, ORANGE, ORANGE, ORANGE, CLEAR,
 CLEAR, CLEAR, CLEAR, CLEAR, OLIVE, OLIVE, OLIVE, ORANGE, ORANGE, OLIVE, ORANGE, ORANGE, ORANGE, CLEAR, CLEAR, CLEAR,
 CLEAR, CLEAR, CLEAR, CLEAR, RED, RED, RED, RED, RED, RED, RED, RED, RED, RED, RED, CLEAR,
 CLEAR, CLEAR, CLEAR, CLEAR, RED, RED, RED, RED, RED, RED, ORANGE, ORANGE, CLEAR, CLEAR, CLEAR, CLEAR,
 CLEAR, CLEAR, CLEAR, CLEAR, CLEAR, RED, RED, RED, RED, RED, RED, ORANGE, CLEAR, CLEAR, CLEAR, CLEAR,
 CLEAR, CLEAR, CLEAR, CLEAR, CLEAR, CLEAR, CLEAR, RED, RED, RED, RED, RED, CLEAR, CLEAR, CLEAR, CLEAR,
 CLEAR, CLEAR, CLEAR, CLEAR, CLEAR, CLEAR, CLEAR, CLEAR, CLEAR, CLEAR, CLEAR, CLEAR, CLEAR, CLEAR, CLEAR, CLEAR,
};

const unsigned char mario_crouch_pixels[] = {
 OLIVE, OLIVE, OLIVE, OLIVE, OLIVE, OLIVE, CLEAR, CLEAR, CLEAR, CLEAR, OLIVE, OLIVE, OLIVE, OLIVE, OLIVE, OLIVE,
 CLEAR, CLEAR, OLIVE, OLIVE, OLIVE, OLIVE, CLEAR, CLEAR, CLEAR, CLEAR, OLIVE, OLIVE, OLIVE, OLIVE, CLEAR, CLEAR,
 CLEAR, RED, ORANGE, ORANGE, OLIVE, CLEAR, CLEAR, CLEAR, CLEAR, CLEAR, CLEAR, OLIVE, ORANGE, ORANGE, RED, CLEAR,
 RED, ORANGE, ORANGE, ORANGE, ORANGE, RED, RED, RED, RED, RED, RED, ORANGE, ORANGE, ORANGE, ORANGE, RED,
 RED, OLIVE, ORANGE, ORANGE, ORANGE, ORANGE, RED, RED, RED, RED, ORANGE, ORANGE, ORANGE, ORANGE, OLIVE, RED,
 OLIVE, OLIVE, OLIVE, ORANGE, ORANGE, ORANGE, RED, RED, RED, RED, ORANGE, ORANGE, ORANGE, OLIVE, OLIVE, OLIVE,
 OLIVE, OLIVE, OLIVE, OLIVE, OLIVE, RED, RED, RED, RED, RED, RED, OLIVE, OLIVE, OLIVE, OLIVE, OLIVE,
 OLIVE, OLIVE, OLIVE, OLIVE, RED, RED, RED, RED, RED, RED, RED, RED, OLIVE, OLIVE, OLIVE, OLIVE,
 OLIVE, OLIVE, OLIVE, OLIVE, RED, ORANGE, OLIVE, OLIVE, OLIVE, OLIVE, OLIVE, RED, RED, OLIVE, OLIVE, OLIVE,
 OLIVE, OLIVE, OLIVE, OLIVE, RED, OLIVE, OLIVE, OLIVE, OLIVE, OLIVE, OLIVE, OLIVE, RED, RED, OLIVE, OLIVE,
 OLIVE, OLIVE, OLIVE, OLIVE, RED, OLIVE, OLIVE, OLIVE, OLIVE, OLIVE, OLIVE, OLIVE, OLIVE, RED, OLIVE, CLEAR,
 CLEAR, OLIVE, OLIVE, OLIVE, RED, OLIVE, OLIVE, OLIVE, ORANGE, ORANGE, ORANGE, OLIVE, OLIVE, RED, OLIVE, CLEAR,
 CLEAR, OLIVE, OLIVE, OLIVE, RED, OLIVE, ORANGE, ORANGE, ORANGE, ORANGE, ORANGE, ORANGE, ORANGE, ORANGE, ORANGE, CLEAR,
 CLEAR, CLEAR, RED, RED, OLIVE, ORANGE, ORANGE, ORANGE, ORANGE, ORANGE, OLIVE, OLIVE, OLIVE, OLIVE, OLIVE, CLEAR,
 CLEAR, CLEAR, OLIVE, OLIVE, ORANGE, ORANGE, ORANGE, ORANGE, ORANGE, OLIVE, OLIVE, OLIVE, OLIVE, OLIVE, OLIVE, CLEAR,
 CLEAR, CLEAR, OLIVE, OLIVE, ORANGE, ORANGE, ORANGE, OLIVE, ORANGE, ORANGE, ORANGE, OLIVE, ORANGE, ORANGE, ORANGE, ORANGE,
 CLEAR, CLEAR, CLEAR, OLIVE, ORANGE, ORANGE, OLIVE, ORANGE, ORANGE, OLIVE, OLIVE, ORANGE, ORANGE, ORANGE, ORANGE, CLEAR,
 CLEAR, CLEAR, CLEAR, CLEAR, OLIVE, OLIVE, OLIVE, ORANGE, ORANGE, OLIVE, ORANGE, ORANGE, ORANGE, CLEAR, CLEAR, CLEAR,
 CLEAR, CLEAR, CLEAR, CLEAR, RED, RED, RED, RED, RED, RED, RED, RED, RED, RED, RED, CLEAR,
 CLEAR, CLEAR, CLEAR, CLEAR, RED, RED, RED, RED, RED, RED, ORANGE, ORANGE, CLEAR, CLEAR, CLEAR, CLEAR,
 CLEAR, CLEAR, CLEAR, CLEAR, CLEAR, RED, RED, RED, RED, RED, RED, ORANGE, CLEAR, CLEAR, CLEAR, CLEAR,
 CLEAR, CLEAR, CLEAR, CLEAR, CLEAR, CLEAR, CLEAR, RED, RED, RED, RED, RED, CLEAR, CLEAR, CLEAR, CLEAR,
};

const unsigned char mario_trans_pixels[] = {
 CLEAR, OLIVE, OLIVE, OLIVE, OLIVE, OLIVE, CLEAR, CLEAR, CLEAR, CLEAR, OLIVE, OLIVE, OLIVE, OLIVE, OLIVE, CLEAR,
 CLEAR, CLEAR, OLIVE, OLIVE, OLIVE, OLIVE, CLEAR, CLEAR, CLEAR, CLEAR, OLIVE, OLIVE, OLIVE, OLIVE, CLEAR, CLEAR,
 CLEAR, CLEAR, OLIVE, OLIVE, OLIVE, OLIVE, CLEAR, CLEAR, CLEAR, CLEAR, OLIVE, OLIVE, OLIVE, OLIVE, CLEAR, CLEAR,
 CLEAR, CLEAR, RED, RED, RED, RED, CLEAR, CLEAR, CLEAR, CLEAR, RED, RED, RED, RED, CLEAR, CLEAR,
 CLEAR, ORANGE, CLEAR, RED, RED, RED, RED, CLEAR, CLEAR, RED, RED, RED, RED, CLEAR, ORANGE, CLEAR,
 ORANGE, ORANGE, ORANGE, RED, RED, RED, RED, RED, RED, RED, RED, RED, RED, ORANGE, ORANGE, ORANGE,
 ORANGE, ORANGE, ORANGE, OLIVE, RED, RED, RED, RED, RED, RED, RED, RED, OLIVE, ORANGE, ORANGE, ORANGE,
 ORANGE, ORANGE, OLIVE, OLIVE, RED, ORANGE, RED, RED, RED, RED, ORANGE, RED, OLIVE, OLIVE, ORANGE, ORANGE,
 CLEAR, OLIVE, OLIVE, OLIVE, OLIVE, RED, OLIVE, OLIVE, OLIVE, OLIVE, RED, OLIVE, OLIVE, OLIVE, OLIVE, CLEAR,
 CLEAR, CLEAR, OLIVE, OLIVE, OLIVE, RED, OLIVE, OLIVE, OLIVE, OLIVE, RED, OLIVE, OLIVE, OLIVE, CLEAR, CLEAR,
 CLEAR, CLEAR, CLEAR, OLIVE, OLIVE, RED, OLIVE, OLIVE, OLIVE, OLIVE, RED, OLIVE, OLIVE, CLEAR, CLEAR, CLEAR,
 CLEAR, CLEAR, CLEAR, CLEAR, OLIVE, RED, OLIVE, OLIVE, OLIVE, OLIVE, RED, OLIVE, CLEAR, CLEAR, CLEAR, CLEAR,
 CLEAR, CLEAR, CLEAR, CLEAR, RED, ORANGE, ORANGE, ORANGE, ORANGE, ORANGE, CLEAR, CLEAR, CLEAR, CLEAR, CLEAR, CLEAR,
 CLEAR, CLEAR, CLEAR, OLIVE, OLIVE, ORANGE, ORANGE, ORANGE, ORANGE, ORANGE, ORANGE, ORANGE, ORANGE, CLEAR, CLEAR, CLEAR,
 CLEAR, OLIVE, OLIVE, OLIVE, ORANGE, ORANGE, ORANGE, ORANGE, ORANGE, OLIVE, OLIVE, OLIVE, OLIVE, OLIVE, CLEAR, CLEAR,
 CLEAR, OLIVE, OLIVE, ORANGE, ORANGE, ORANGE, ORANGE, ORANGE, OLIVE, OLIVE, OLIVE, OLIVE, OLIVE, OLIVE, CLEAR, CLEAR,
 CLEAR, OLIVE, OLIVE, ORANGE, ORANGE, OLIVE, OLIVE, ORANGE, ORANGE, ORANGE, OLIVE, ORANGE, ORANGE, ORANGE, ORANGE, CLEAR,
 CLEAR, CLEAR, OLIVE, ORANGE, ORANGE, OLIVE, OLIVE, ORANGE, ORANGE, ORANGE, ORANGE, ORANGE, ORANGE, ORANGE, ORANGE, CLEAR,
 CLEAR, CLEAR, OLIVE, ORANGE, ORANGE, OLIVE, ORANGE, ORANGE, OLIVE, OLIVE, ORANGE, ORANGE, ORANGE, ORANGE, CLEAR, CLEAR,
 CLEAR, CLEAR, CLEAR, OLIVE, OLIVE, OLIVE, ORANGE, ORANGE, OLIVE, ORANGE, ORANGE, ORANGE, CLEAR, CLEAR, CLEAR, CLEAR,
 CLEAR, CLEAR, CLEAR, RED, RED, RED, RED, RED, RED, RED, RED, RED, RED, RED, CLEAR, CLEAR,
 CLEAR, CLEAR, CLEAR, RED, RED, RED, RED, RED, RED, ORANGE, ORANGE, CLEAR, CLEAR, CLEAR, CLEAR, CLEAR,
 CLEAR, CLEAR, CLEAR, CLEAR, RED, RED, RED, RED, RED, RED, ORANGE, CLEAR, CLEAR, CLEAR, CLEAR, CLEAR,
 CLEAR, CLEAR, CLEAR, CLEAR, CLEAR, CLEAR, RED, RED, RED, RED, RED, CLEAR, CLEAR, CLEAR, CLEAR, CLEAR,
};

unsigned char sky_pixels[(SCREEN_H*SCREEN_W)];

Image base_block = {.w = 16, .h = 16, .pixels = base_block_pixels};
Image brick_block = {.w = 16, .h = 16, .pixels = brick_block_pixels};
Image bush_base = {.w = 80, .h = 16, .pixels = bush_base_pixels};
Image bush_top = {.w = 48, .h = 19, .pixels = bush_top_pixels};
Image castle_bottom = {.w = 80, .h = 48, .pixels = castle_bottom_pixels};
Image castle_top = {.w = 48, .h = 32, .pixels = castle_top_pixels};
Image cloud_1 = {.w = 8, .h = 13, .pixels = cloud_1_pixels};
Image cloud_2 = {.w = 16, .h=24, .pixels = cloud_2_pixels};
Image cloud_3 = {.w = 8, .h = 15, .pixels = cloud_3_pixels};
Image flag_ball = {.w = 8, .h = 8, .pixels = flag_ball_pixels};
Image pipe_top = {.w = 32, .h = 16, .pixels = pipe_top_pixels};
Image pipe = {.w = 28, .h = 16, .pixels = pipe_pixels};
Image pole = {.w = 2, .h = 64, .pixels = pole_pixels};
Image question_block_1 = {.w = 16, .h = 16, .pixels = question_block_1_pixels};
Image question_block_2 = {.w = 16, .h = 16, .pixels = question_block_2_pixels};
Image question_block_3 = {.w = 16, .h = 16, .pixels = question_block_3_pixels};
Image question_block_empty = {.w = 16, .h = 16, .pixels = question_block_empty_pixels};
Image shrub_1 = {.w = 7, .h = 8, .pixels = shrub_1_pixels};
Image shrub_2 = {.w = 16, .h = 16, .pixels = shrub_2_pixels};
Image shrub_3 = {.w = 9, .h = 11, .pixels = shrub_3_pixels};
Image strong_block = {.w = 16, .h = 16, .pixels = strong_block_pixels};
Image flag = {.w = 16, .h = 16, .pixels = flag_pixels};

Image shroom = {.w = 16, .h = 16, .pixels = shroom_pixels};

Image goomba_walk_1 = {.w = 16, .h = 16, .pixels = goomba_walk_1_pixels};
Image goomba_walk_2 = {.w = 16, .h = 16, .pixels = goomba_walk_2_pixels};
Image goomba_smash = {.w = 16, .h = 8, .pixels = goomba_smash_pixels};

Image mario_stand[] = {{.w = 16, .h = 16, .pixels = mario_1_stand_pixels}, {.w = 16, .h = 32, .pixels = mario_2_stand_pixels}};
Image mario_crouch = {.w = 16, .h = 22, .pixels = mario_crouch_pixels};
Image mario_trans = {.w = 16, .h = 24, .pixels = mario_trans_pixels};
Image mario_run_1[] = {{.w = 16, .h = 16, .pixels = mario_1_run_1_pixels}, {.w = 16, .h = 32, .pixels = mario_2_run_1_pixels}};
Image mario_run_2[] = {{.w = 16, .h = 16, .pixels = mario_1_run_2_pixels}, {.w = 16, .h = 32, .pixels = mario_2_run_2_pixels}};
Image mario_run_3[] = {{.w = 16, .h = 16, .pixels = mario_1_run_3_pixels}, {.w = 16, .h = 32, .pixels = mario_2_run_3_pixels}};
Image mario_jump[] = {{.w = 16, .h = 16, .pixels = mario_1_jump_pixels}, {.w = 16, .h = 32, .pixels = mario_2_jump_pixels}};
Image mario_flag[] = {{.w = 16, .h = 16, .pixels = mario_1_flag_pixels}, {.w = 16, .h = 32, .pixels = mario_2_flag_pixels}};
Image mario_hit = {.w = 16, .h = 16, .pixels = mario_hit_pixels};

unsigned short question_block_x_vals[] = {256, 336, 368, 1248, 1696, 1744, 1792, 2720};
unsigned short brick_block_x_vals[] = {320, 352, 384, 1232, 1264, 1504, 1600, 1888, 2064, 2688, 2704, 2736};
unsigned short qBlocks[8];
int frameCounter;

Scenery scenery[NUM_SCENERY];
int sceneryPointer = 0;
int flagPointer = 0;
Block blocks[NUM_BLOCKS];
int blockPointer = 0;
Enemy enemies[NUM_ENEMIES];
int enemyPointer = 0;
Shroom shrooms[NUM_SHROOMS];
int shroomPointer = 0;

Player mario;

bool gameOver = false;

Direction getXDirection(int x){
  if(x<JOYSTICK_THRESHOLD - JOYSTICK_BUFFER)
    return LEFT;
  else if(x>JOYSTICK_THRESHOLD + JOYSTICK_BUFFER)
    return RIGHT;
  return CENTER;
}

Direction getJYDirection(int y){
	if(y<JOYSTICK_THRESHOLD - JOYSTICK_BUFFER)
    return DOWN;
  else if(y>JOYSTICK_THRESHOLD + JOYSTICK_BUFFER)
    return UP;
  return CENTER;
}

Direction getYDirection(int y){
  if(y<0)
    return DOWN;
  else if(y>0)
    return UP;
  return CENTER;
}

void Player_Jump(){
  mario.entity.image = &mario_jump[mario.hp-1];
  mario.dy = mario.vy;
  mario.jumping = true;
}

void Player_Action(bool action){
  if(action)
    mario.dx = 9;
  else
    mario.dx = 6;
}

int Entity_Collision(Entity a, Entity b){
	if((a.x <= b.x && a.x+a.image->w > b.x) || (b.x <= a.x && b.x+b.image->w > a.x))
		if((a.y <= b.y && a.y+a.image->h > b.y) || (b.y <= a.y && b.y+b.image->h > a.y))
			return true;
  return false;
}

int Check_Box_Hitbox(Entity e){
  for(int i=0; i<NUM_BLOCKS; i++){
    if(Entity_Collision(e, blocks[i].entity))
      return i;
  }
  return -1;
}

int Check_Enemy_Hitbox(Entity e){
	for(int i=0; i<NUM_ENEMIES; i++){
		if(Entity_Collision(e, enemies[i].entity))
			return i;
	}
	return -1;
}

void Init_Shroom(int x, int y){
	Entity e = {.x = x, .y = y, .image = &shroom, .mirror = false};
	shrooms[shroomPointer].entity = e;
	shrooms[shroomPointer].dy = 0;
	shroomPointer++;
}
	
int boxToggle = -1;
int toggleCounter = 0;
Sound Player_Move(Direction dir){//TODO: before each, collision detect
	if(boxToggle != -1){
		toggleCounter++;
		if(toggleCounter == 3){
			blocks[boxToggle].entity.y -=2;
			boxToggle = -1;
			toggleCounter = 0;
		}
	}
  switch(dir){
    case RIGHT:
      for(int i=mario.dx; i>0; i--){
        mario.entity.x += i;
        if(mario.entity.x > (MAX_X - SCREEN_W + INIT_X)){
          i += MAX_X - mario.entity.x;
          mario.entity.x = MAX_X;
        }
        if(Check_Box_Hitbox(mario.entity) != -1 || mario.entity.x > CASTLE_X+FLAG_X_OFFSET-6)
          mario.entity.x -= i;
        else break;
      }
      dir = DOWN;
      mario.jumping = true;
      if(mario.dy == 0)
        mario.dy = -1 * GRAVITY;
      break;
    case LEFT:
      for(int i=mario.dx; i>0; i--){
        mario.entity.x -= i;
        if(mario.entity.x < MIN_X){
          i += mario.entity.x - MIN_X;
          mario.entity.x = MIN_X;
        }
        if(Check_Box_Hitbox(mario.entity) != -1)
          mario.entity.x += i;
        else break;
      }
      dir = DOWN;
      mario.jumping = true;
      if(mario.dy == 0)
        mario.dy = -1 * GRAVITY;
      break;
  }
	int qHit = -1;
  switch(dir){
    case DOWN:
      for(int i=mario.dy; i<0; i++){
        mario.entity.y += i;
        if(Check_Box_Hitbox(mario.entity) != -1){
          mario.entity.y -= i;//Reset y
          mario.jumping = false;
          if(mario.entity.image == &mario_jump[mario.hp-1])
            mario.entity.image = &mario_stand[mario.hp-1];
        }
        else{
					int enemy = Check_Enemy_Hitbox(mario.entity);
					if(enemy >= 0){
						enemies[enemy].entity.image = &goomba_smash;
						mario.jumping = true;
						mario.dy = 6;
						return GOOMBA;
					}
					break;
				}
      }
      break;
    case UP:
      for(int i=mario.dy; i>0; i--){
        mario.entity.y += i;
				int boxNum = Check_Box_Hitbox(mario.entity);
        if(boxNum != -1){
					for(int i=0; i<sizeof(qBlocks)/sizeof(qBlocks[0]); i++){
						if(qBlocks[i] == boxNum)
							qHit = boxNum;
						mario.dy = 0;
						mario.entity.y -= i;
					}
					mario.entity.y += 2;
					blocks[boxNum].entity.y +=2;
					boxToggle = boxNum;
				}
        else break;
      }
			if(qHit > -1 && blocks[qHit].entity.image != &question_block_empty){//Q Block has been hit
				Init_Shroom(blocks[qHit].entity.x, blocks[qHit].entity.y + blocks[qHit].entity.image->h);
				blocks[qHit].entity.image = &question_block_empty;
			}
      break;
  }
	return NONE;
}

void Player_Run(Direction dir){
  //Check if need to switch direction
  if(dir == CENTER && !mario.jumping){
    mario.entity.image = &mario_stand[mario.hp-1];
  } else {
    //Move mario
    Player_Move(dir);
    //Sprite cycling
		if(mario.jumping == true && mario.dy < 0 && mario.entity.image != &mario_jump[mario.hp-1]){
			mario.entity.image = &mario_run_2[mario.hp-1];
		} else {
			if(mario.entity.image == &mario_stand[mario.hp-1] || mario.entity.image == &mario_crouch){
				mario.entity.image = &mario_run_1[mario.hp-1];
			} else if(mario.entity.image == &mario_run_1[mario.hp-1]){
				mario.entity.image = &mario_run_2[mario.hp-1];
			} else if(mario.entity.image == &mario_run_2[mario.hp-1]){
				mario.entity.image = &mario_run_3[mario.hp-1];
			} else if(mario.entity.image == &mario_run_3[mario.hp-1]){
				mario.entity.image = &mario_run_1[mario.hp-1];
			}
		}
  }
  //Mirror sprite if necessary
  if((mario.entity.mirror ^ (dir == LEFT)) && dir != CENTER){
    mario.entity.mirror = !mario.entity.mirror;
  }
}

Sound Player_Input(Input input){
  Sound sound = NONE;
	
	Player_Action(input.b);
	
  if(input.a && !mario.jumping){
    Player_Jump();
    sound = JUMP;
  }
  if(mario.jumping){
    Sound temp = Player_Move(getYDirection(mario.dy));
		if(temp!= NONE)
			sound = temp;
    if(mario.dy >= (-1*mario.vy))
      mario.dy -= GRAVITY;
  }
	
	Player_Run(getXDirection(input.x));
	
	//if(getJYDirection(input.y) == DOWN && mario.entity.image == &mario_stand[1]){//Crouch
		//mario.entity.image = &mario_crouch;
	//}
	
  if(mario.entity.y + mario.entity.image->h < 0)//Check 
    sound = DIE;
  return sound;
}

void Goomba_Sprite_Cycle(int g){
	if(enemies[g].entity.image == &goomba_walk_1)
		enemies[g].entity.image = &goomba_walk_2;
	else if(enemies[g].entity.image == &goomba_walk_2)
		enemies[g].entity.image = &goomba_walk_1;
}

void Update_Mario_Sprite(){
	mario.entity.image = &mario_stand[mario.hp-1];
}

void Goomba_Move(int g){
	if(enemies[g].entity.image != &goomba_smash){//If not smashed
		int dir = 1;
		if(enemies[g].entity.mirror)
			dir = -1;
		for(int i=GOOMBA_SPEED; i>0; i++){//LEFT RIGHT Goomba hitbox detection
			enemies[g].entity.x += GOOMBA_SPEED * dir;
			if(Check_Box_Hitbox(enemies[g].entity) != -1){
				enemies[g].entity.x -= i*dir;
				enemies[g].entity.mirror = !enemies[g].entity.mirror;
			} else {
				int otherEnemy = Check_Enemy_Hitbox(enemies[g].entity);
				if(otherEnemy != g){
					enemies[g].entity.x -= i*dir;
					enemies[g].entity.mirror = !enemies[g].entity.mirror;
					enemies[otherEnemy].entity.mirror = !enemies[otherEnemy].entity.mirror;
				}
				break;
			}
		}
		for(int i=0; i<GRAVITY; i++){//Add Gravity
			enemies[g].dy -= (GRAVITY-i);
			enemies[g].entity.y += enemies[g].dy;
			if(Check_Box_Hitbox(enemies[g].entity) != -1){//Hit floor
				enemies[g].entity.y -= enemies[g].dy;
				enemies[g].dy += (GRAVITY-i);
			}
		}
		if(Check_Enemy_Hitbox(mario.entity) == g && mario.entity.y <= enemies[g].entity.y && mario.refresh == 0){//Check if should hurt mario
			mario.hp--;
			mario.refresh = REFRESH;
			Update_Mario_Sprite();
		}
	} else {//Remove from screen
		enemies[g].smashCounter--;
		if(enemies[g].smashCounter == 0)
			enemies[g].entity.x = 0-enemies[g].entity.image->w;
	}
}

void Shroom_Move(int s){
		int dir = 1;//Right
		if(shrooms[s].entity.mirror)
			dir = -1;//Left
		for(int i=GOOMBA_SPEED; i>0; i++){//LEFT RIGHT Shroom hitbox detection
			shrooms[s].entity.x += GOOMBA_SPEED * dir;
			if(Check_Box_Hitbox(shrooms[s].entity) != -1 || Check_Enemy_Hitbox(shrooms[s].entity) != -1){
				shrooms[s].entity.x -= i*dir;
				shrooms[s].entity.mirror = !shrooms[s].entity.mirror;
			} else break;
		}
		for(int i=0; i<(-1*shrooms[s].dy)+GRAVITY; i++){//Add Gravity
			shrooms[s].dy -= (GRAVITY-i);
			shrooms[s].entity.y += shrooms[s].dy;
			if(Check_Box_Hitbox(shrooms[s].entity) != -1){//Hit floor
				shrooms[s].entity.y -= shrooms[s].dy;
				shrooms[s].dy += (GRAVITY-i);
			}
		}
		if(Entity_Collision(shrooms[s].entity, mario.entity)){
			shrooms[s].eaten = true;
			shrooms[s].entity.x = -1*shrooms[s].entity.image->w;
			if(mario.hp < 2)
				mario.hp = 2;
				Update_Mario_Sprite();
		}
}

void Enemy_Update(void){
	for(int i=0; i<NUM_ENEMIES; i++){
		Goomba_Sprite_Cycle(i);
		if(enemies[i].entity.x < mario.entity.x+SCREEN_W-INIT_X)
			Goomba_Move(i);
	}
}

void Shroom_Update(void){
	for(int i=0; i<shroomPointer; i++){
		if(!shrooms[i].eaten)
			Shroom_Move(i);
	}
}

void Question_Block_Update(){
	frameCounter++;
	switch(frameCounter){
		case 5:
			for(int i=0; i<sizeof(qBlocks)/sizeof(int); i++)
				if(blocks[qBlocks[i]].entity.image != &question_block_empty)
					blocks[qBlocks[i]].entity.image = &question_block_2;
			break;
		case 6:
			for(int i=0; i<sizeof(qBlocks)/sizeof(int); i++)
				if(blocks[qBlocks[i]].entity.image != &question_block_empty)
					blocks[qBlocks[i]].entity.image = &question_block_3;
			break;
		case 7:
			for(int i=0; i<sizeof(qBlocks)/sizeof(int); i++)
				if(blocks[qBlocks[i]].entity.image != &question_block_empty)
					blocks[qBlocks[i]].entity.image = &question_block_1;
			frameCounter = 0;
			break;
	}
}

Sound Player_Update(Input input){
	Sound sound;
	if(mario.refresh > 0)
		mario.refresh--;
	if(mario.entity.x >= CASTLE_X + FLAG_X_OFFSET-6){//Check if touching flag pole
		gameOver = true;
		mario.entity.image = &mario_flag[mario.hp-1];
		sound = WIN;
	}
	if(mario.entity.y < 0-mario.entity.image->h && !gameOver){//Check if fell off world
		gameOver = true;
		sound = DIE;
	} else if(mario.hp < 1) {//Died
		if(!gameOver){
			gameOver = true;
			mario.dy = 16;//Launch mario
			sound = DIE;
			mario.entity.image = &mario_hit;
		}
		mario.entity.y += mario.dy;
		mario.dy-=GRAVITY;
	}
	if(!gameOver){
		sound = Player_Input(input);
	} else {//Game over, lock player controls ^
		if(mario.entity.y > base_block.h+strong_block.h)//Mario pole slide
			mario.entity.y -= POLE_SLIDE_SPEED;
		if(scenery[flagPointer].entity.y > base_block.h+strong_block.h)//Flag pole slide
			scenery[flagPointer].entity.y -= POLE_SLIDE_SPEED;
	}
	return sound;
}

//Source: entity
//Destination: img
bool draw(Entity* entity, Frame* img){
  bool onScreen = false;
  for(int r=0; r<entity->image->h; r++){//For each row in the entity
    int y = entity->y + r;
    if(y < SCREEN_H && y >= 0){
      for(int c=0; c<entity->image->w; c++){//For each column in the row
        int left = mario.entity.x - INIT_X;
        int right = left + SCREEN_W;
        int x = entity->x + c;
        if(left <= x && x < right){//If pixel is on screen
          onScreen = true;
          int yOffset = img->w * (r+entity->y);
          char pixel;
          if(entity->mirror)
            pixel = entity->image->pixels[(entity->image->w*(r+1)) - c - 1];
          else
            pixel = entity->image->pixels[(entity->image->w*r) + c];
          if(getOpacity(pixel)){
						//if((img->pixels[yOffset + x - left]&0x7f) == (pixel&0x7f))//Hasn't changed
							//img->pixels[yOffset + x - left] &= 0x7f;
						//else
							img->pixels[yOffset + x - left] = pixel;//Draw on image
					}
        }
      }
    }
  }
  return onScreen;
}

//Updates gameR and returns frame (160x128)
Frame Next_Frame(Input input){
  //Init frame
  Frame frame;
  frame.h = SCREEN_H;
  frame.w = SCREEN_W;

	frame.sound = Player_Update(input);
  Enemy_Update();
	Question_Block_Update();
	Shroom_Update();

  //Draw sky layer
  for(int i=0; i<SCREEN_H*SCREEN_W; i++)
		sky_pixels[i] = SKY;
	frame.pixels = sky_pixels;
  //Draw scenery layer
  for(int i=0; i<sizeof(scenery)/sizeof(scenery[0]); i++)
    draw(&scenery[i].entity, &frame);
  //Draw block layer
  for(int i=0; i<sizeof(blocks)/sizeof(blocks[0]); i++)
    draw(&blocks[i].entity, &frame);
	//Draw shrooms
	for(int i=0; i<shroomPointer; i++)
		draw(&shrooms[i].entity, &frame);
	//Draw enemies
	for(int i=0; i<NUM_ENEMIES; i++)
		draw(&enemies[i].entity, &frame);
	//Draw mario
  draw(&mario.entity, &frame);
  return frame;
}

void Add_Scenery(int x, int y, Image* img){
  if(sceneryPointer < NUM_SCENERY){
    scenery[sceneryPointer].entity.x = x;
    scenery[sceneryPointer].entity.y = y;
    scenery[sceneryPointer].entity.image = img;
    sceneryPointer++;
  }
}

void Add_Block(int x, int y, Image* img){
  if(blockPointer < NUM_BLOCKS){
    blocks[blockPointer].entity.x = x;
    blocks[blockPointer].entity.y = y;
    blocks[blockPointer].entity.image = img;
    blockPointer++;
  }
}

void Add_Stairs(Direction dir, int x, int size){
  if(dir == LEFT)
    for(int c=0; c<size; c++)
      for(int r=0; r<=c; r++)
        Add_Block(x+(c*strong_block.w), base_block.h+(r*strong_block.h), &strong_block);
  else
    for(int c=0; c<size; c++)
      for(int r=0; r<size-c; r++)
        Add_Block(x+(c*strong_block.w), base_block.h+(r*strong_block.h), &strong_block);
}

void Add_Castle(int x){
  Add_Stairs(LEFT, x+FLAG_X_OFFSET, 1);//Stair block
  int poleXOffset = (base_block.w-pole.w)/2;
  Add_Scenery(x+FLAG_X_OFFSET+poleXOffset, base_block.h+strong_block.h, &pole);//Flag Pole
	flagPointer = sceneryPointer;
	Add_Scenery(x+FLAG_X_OFFSET+poleXOffset+1-flag.w, base_block.h+strong_block.h+pole.h-flag.h, &flag);//Flag
  int ballXOffset = (base_block.w-flag_ball.w)/2;//Flag ball
  Add_Scenery(x+FLAG_X_OFFSET+ballXOffset, base_block.h+strong_block.h+pole.h, &flag_ball);
  Add_Scenery(x, base_block.h, &castle_bottom);//Actual castle
  Add_Scenery(x+16, base_block.h+castle_bottom.h, &castle_top);
}

void Add_Cloud(int round, int x, int y, int size){
  Add_Scenery((SCENERY_REPEAT_OFFSET*round)+x, y+3, &cloud_1);
  for(int i=0; i<size; i++)
    Add_Scenery((SCENERY_REPEAT_OFFSET*round)+x+cloud_1.w+(i*cloud_2.w), y, &cloud_2);
  Add_Scenery((SCENERY_REPEAT_OFFSET*round)+x+cloud_1.w+(size*cloud_2.w), y+1, &cloud_3);
}

void Add_Shrub(int round, int size){
  int offset = 185;
  if(size == 1)
    offset = 377;
  else if(size == 2)
    offset = 665;
  Add_Scenery((SCENERY_REPEAT_OFFSET*round)+offset, base_block.h, &shrub_1);//Shrub 1
  for(int i=0; i<size; i++)
    Add_Scenery((SCENERY_REPEAT_OFFSET*round)+offset+(i*shrub_2.w + shrub_1.w), base_block.h, &shrub_2);//Shrub 2
  Add_Scenery((SCENERY_REPEAT_OFFSET*round)+offset+(size*shrub_2.w + shrub_1.w), base_block.h, &shrub_3);//Shrub 3
}

void Add_Small_Bush(int round){
  Add_Scenery((SCENERY_REPEAT_OFFSET*round)+256, base_block.h, &bush_top);
}

void Add_Tall_Bush(int round){
  Add_Scenery(SCENERY_REPEAT_OFFSET*round, base_block.h, &bush_base);
  Add_Scenery(SCENERY_REPEAT_OFFSET*round+16, base_block.h+bush_base.h, &bush_top);
}

void Scenery_Init(){
  for(int i=0; i<5; i++){//Add 5 rounds of shrubs
    Add_Tall_Bush(i);
    Add_Small_Bush(i);
    Add_Shrub(i, 3);
    Add_Cloud(i, 136, 71, 1);
    if(i != 4){//Leave out last two shrubs and last clouds on last round
      Add_Shrub(i, 1);
      Add_Shrub(i, 2);
      Add_Cloud(i, 312, 87, 1);
      Add_Cloud(i, 440, 71, 3);
      Add_Cloud(i, 584, 87, 2);
    }
  }
  Add_Castle(CASTLE_X);
}

void Floating_Init(){
  for(int i=0; i<sizeof(question_block_x_vals)/sizeof(question_block_x_vals[0]); i++){//Add question blocks
		qBlocks[i] = blockPointer;
    Add_Block(question_block_x_vals[i], FLOAT+base_block.h, &question_block_1);
	}
  for(int i=0; i<sizeof(brick_block_x_vals)/sizeof(brick_block_x_vals[0]); i++)//Add brick blocks
    Add_Block(brick_block_x_vals[i], FLOAT+base_block.h, &brick_block);
}

void Stairs_Init(){
  Add_Stairs(LEFT, 2144, 4);
  Add_Stairs(RIGHT, 2240, 4);
  Add_Stairs(LEFT, 2384, 4);
  Add_Stairs(RIGHT, 2480, 4);
  Add_Stairs(LEFT, 2896, 4);
}

void Add_Pipe(int x, int size){
  Add_Block(x, base_block.h+(size*pipe.h), &pipe_top);
  for(int i=0; i<size; i++){
    int xOffset = (pipe_top.w-pipe.w)/2;
    Add_Block(x+xOffset, base_block.h+(i*pipe.h), &pipe);
  }
}

void Pipes_Init(){
  Add_Pipe(448, 1);
  Add_Pipe(607, 2);
  Add_Pipe(736, 3);
  Add_Pipe(912, 3);
  Add_Pipe(2608, 1);
  Add_Pipe(2864, 1);
}

void Floor_Init(){
  for(int i=0; i<69; i++)
    Add_Block(base_block.w*i, 0, &base_block);
  for(int i=71; i<86; i++)
    Add_Block(base_block.w*i, 0, &base_block);
  for(int i=89; i<153; i++)
    Add_Block(base_block.w*i, 0, &base_block);
  for(int i=155; i<212; i++)
    Add_Block(base_block.w*i, 0, &base_block);
}

void Blocks_Init(){
  Floor_Init();
  Pipes_Init();
  Stairs_Init();
  Floating_Init();
}

void Goomba_Init(int x, int y){
	Entity entity = {.image = &goomba_walk_1, .x = x, .y = y, .mirror = true};
	Enemy goomba = {.entity = entity, .smashCounter = GOOMBA_LINGER, .dy = 0};
  enemies[enemyPointer] = goomba;
	enemyPointer++;
}

void Enemies_Init(){
	Goomba_Init(22*16, 16);
	Goomba_Init(37*16, 16);
	Goomba_Init(55*16, 16);
	Goomba_Init(56*16, 16);
	Goomba_Init(81*16, 16);
	Goomba_Init(83*16, 16);
	Goomba_Init(100*16, 16);
	Goomba_Init(120*16, 16);
	Goomba_Init(140*16, 16);
	Goomba_Init(160*16, 16);
}

void Player_Init(){
  mario.entity.x = INIT_X;
  mario.entity.y = INIT_Y;
  mario.dy = 0;
  mario.dx = 6;
  mario.vy = 15;
	mario.hp = 1;
  mario.entity.image = &mario_stand[mario.hp-1];
  mario.entity.mirror = false;
  mario.jumping = false;
	mario.refresh = 0;
}

void Init_Game(){
  Player_Init();
  Enemies_Init();
  Blocks_Init();
  Scenery_Init();
	frameCounter = 0;
}
