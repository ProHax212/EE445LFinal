#include "..//inc//tm4c123gh6pm.h"
#include <stdint.h>
#include "game.h"
#include "SysTick.h"

void DisableInterrupts(void); // Disable interrupts
void EnableInterrupts(void);  // Enable interrupts
long StartCritical (void);    // previous I bit, disable interrupts
void EndCritical(long sr);    // restore I bit to previous value
void WaitForInterrupt(void);  // low power mode
void (*PeriodicTask0)(void);   // user function for Timer 0
void (*PeriodicTask1)(void);   // user function for Timer 1
void (*PeriodicTask2)(void);	// user function for Timer 2

#define WN 48
#define HN 24
#define THN 16
#define QN 12
#define TQN 8
#define EN 6
#define SN 3

#define R 0

#define C3 130.81
#define C3S 138.59
#define D3 146.83
#define D3S 155.56
#define E3 164.81
#define F3 174.61
#define F3S 185
#define G3 196.00
#define G3S 207.65
#define A3 220.00
#define A3S 233.08
#define B3 246.94
#define C4 261.63
#define C4S 277.18
#define D4 293.66
#define D4S 311.13
#define E4 329.63
#define F4 349.23
#define F4S 369.99
#define G4 392.00
#define G4S 415.30
#define A4 440.00
#define A4S 466.16
#define B4 493.88
#define C5 523.25
#define C5S 554.37
#define D5 587.33
#define D5S 622.25
#define E5 659.25
#define F5 698.46
#define F5S 739.99
#define G5 783.99

#define BPM 1080

typedef struct{
	double frequencies[500];
	int durations[500];
	int songPointer;
	int songLength;
} Song;

const Song song = {.frequencies={E4, E4, R, E4, R, C4, E4, R, G4, R, G3, R, C4, R, G3, R, E3, R, A3, R, B3, R, A3S, A3, R, G3, E4, G4, A4, R, F4, G4, R, E4, R, C4, D4, B3, R, C4, R, G3, R, E3, R, A3, R, B3, R, A3S, A3, R, G3, E4, G4, A4, R, F4, G4, R, E4, R, C4, D4, B3, R, G4, F4S, F4, D4S, R, E4, R, G3S, A3, C4, R, A3, C4, D4, R, G4, F4S, F4, D4S, R, E4, R, C5, R, C5, C5, R, G4, F4S, F4, D4S, R, E4, R, G3S, A3, C4, R, A3, C4, D4, R, D4S, R, D4, R, C4, R, G4, F4S, F4, D4S, R, E4, R, G3S, A3, C4, R, A3, C4, D4, R, G4, F4S, F4, D4S, R, E4, R, C5, R, C5, C5, R, G4, F4S, F4, D4S, R, E4, R, G3S, A3, C4, R, A3, C4, D4, R, D4S, R, D4, R, C4, R, C4, C4, R, C4, R, C4, D4, R, E4, C4, R, A3, G3, R, C4, C4, R, C4, R, C4, D4, E4, R, C4, C4, R, C4, R, C4, D4, R, E4, C4, R, A3, G3, R, E4, E4, R, E4, R, C4, E4, R, G4, R, G3, R, C4, R, G3, R, E3, R, A3, R, B3, R, A3S, A3, R, G3, E4, G4, A4, R, F4, G4, R, E4, R, C4, D4, B3, R, C4, R, G3, R, E3, R, A3, R, B3, R, A3S, A3, R, G3, E4, G4, A4, R, F4, G4, R, E4, R, C4, D4, B3, R, E4, C4, R, G3, R, G3S, R, A3, F4, R, F4, A3, R, B3, A4, A4, A4, G4, F4, E4, C4, R, A3, G3, R, E4, C4, R, G3, R, G3S, R, A3, F4, R, F4, A3, R, B3, F4, R, F4, F4, E4, D4, C4, E3, R, E3, C3, R, E4, C4, R, G3, R, G3S, R, A3, F4, R, F4, A3, R, B3, A4, A4, A4, G4, F4, E4, C4, R, A3, G3, R, E4, C4, R, G3, R, G3S, R, A3, F4, R, F4, A3, R, B3, F4, R, F4, F4, E4, D4, C4, E3, R, E3, C3, R, C5, G4, E4, C5, G4, E4, C5, C5S, G4S, F4, C5S, G4S, F4, C5S, D5S, A4S, G4, D5S, A4S, G4,
D5S, F5, F5, F5, G5},
.durations={QN, QN, QN, QN, QN, QN, QN, QN, QN, QN+HN, QN, QN+HN, QN, HN, QN, HN, QN, HN, QN, QN, QN, QN, QN, QN, QN, THN, THN, THN, QN, QN, QN, QN, QN, QN, QN, QN, QN, QN, HN, QN, HN, QN, HN, QN, HN, QN, QN, QN, QN, QN, QN, QN, THN, THN, THN, QN, QN, QN, QN, QN, QN, QN, QN, QN, QN, WN,QN, QN, QN, QN, QN, QN, QN, QN, QN, QN, QN, QN, QN, QN, HN, QN, QN, QN, QN, QN, QN, QN, QN, QN, QN, QN, WN+QN, QN, QN, QN, QN, QN, QN, QN, QN, QN, QN, QN, QN, QN, QN, HN, QN, HN, QN, HN, QN, WN+WN+QN, QN, QN, QN, QN, QN, QN, QN, QN, QN, QN, QN, QN, QN, QN, HN, QN, QN, QN, QN, QN, QN, QN, QN, QN, QN, QN, WN+QN, QN, QN, QN, QN, QN, QN, QN, QN, QN, QN, QN, QN, QN, QN, HN, QN, HN, QN, HN, QN, WN+HN+QN, QN, QN, QN, QN, QN, QN, QN, QN, QN, QN, QN, QN, QN, HN+QN, QN, QN, QN, QN, QN, QN, QN, QN, WN+WN, QN, QN, QN, QN, QN, QN, QN, QN, QN, QN, QN, QN, QN, HN+QN, QN, QN, QN, QN, QN, QN, QN, QN, QN, HN+QN, QN, HN+QN, QN, HN, QN, HN, QN, HN, QN, QN, QN, QN, QN, QN, QN, THN, THN, THN, QN, QN, QN, QN, QN, QN, QN, QN, QN, QN, HN, QN, HN, QN, HN, QN, HN, QN, QN, QN, QN, QN, QN, QN, THN, THN, THN, QN, QN, QN, QN, QN, QN, QN, QN, QN, QN, HN, QN, QN, QN, QN, HN, QN, QN, QN, QN, QN, QN, QN, HN+QN, THN, THN, THN, THN, THN, THN, QN, QN, QN, QN, QN, HN+QN, QN, QN, QN, QN, HN, QN, QN, QN, QN, QN, QN, QN, QN+HN, QN, QN, QN, QN, THN, THN, THN, QN, QN, QN, QN, QN, QN+HN, QN, QN, QN, QN, HN, QN, QN, QN, QN, QN, QN, QN, HN+QN, THN, THN, THN, THN, THN, THN, QN, QN, QN, QN, QN, HN+QN, QN, QN, QN, QN, HN, QN, QN, QN, QN, QN, QN, QN, HN+QN, QN, QN, QN, QN, THN, THN, THN, QN, QN, QN, QN, QN, HN+QN, TQN, TQN, TQN, TQN, TQN, TQN, WN, TQN, TQN, TQN, TQN, TQN, TQN, WN, TQN, TQN, TQN, TQN, TQN, TQN,
HN, TQN, TQN, TQN, WN},
.songPointer = 0, .songLength = 392};
static int songPointer = 0;

const unsigned short Flute[32] = {
	1007, 1252, 1374, 1548, 1698, 1797, 1825, 1797, 1675, 1562, 1383,
	1219, 1092, 1007, 913, 890, 833, 847, 810, 777, 744, 674,
	598, 551, 509, 476, 495, 533, 589, 659, 758, 876
};

const unsigned short Horn[32] = {
	1063, 1082, 1119, 1275, 1678, 1748, 1275, 755, 661, 661, 703,
	731, 769, 845, 1039, 1134, 1209, 1332, 1465, 1545, 1427, 1588,
	1370, 1086, 708, 519, 448, 490, 566, 684, 802, 992
};

const unsigned short Trumpet[32] = {
	1007, 1088, 1156, 1194, 1067, 789, 303, 99, 789, 1510, 1476,
	1173, 1067, 1037, 1084, 1062, 1011, 1015, 1045, 1062, 1011, 1011,
	1058, 1113, 1084, 1075, 1079, 1105, 1088, 1049, 1015, 1045
};

const int backgroundMusicArray[] = {0};
int backgroundMusicLength = sizeof(backgroundMusicArray) / sizeof(int);
int backgroundMusicIndex = 0;
	
// WAV arrays for sound effects
static const unsigned short jumpSound[6506] = {2048,2048,2048,2048,2048,2048,2048,2048,2048,2048,2048,2048,2048,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2048,2048};
static int soundEffectCounter = 0;
	
Sound currentSoundEffect;
static int currentDuration = 0;
static int amplitudePointer = 0;
	
// Send data out the DAC
void SSI2_Out(uint16_t code){
	while((SSI2_SR_R&0x02) == 0){};	// Wait until transmit not full
	SSI2_DR_R = code;	// Send the data out
}

// Send data out the DAC
void SSI1_Out(uint16_t code){
	while((SSI1_SR_R&0x00000002)==0){};// SSI Transmit FIFO Not Full
  SSI1_DR_R = code; }                // data out, no reply

// Called by the Systick Handler to set which sound effect is being played
void Set_Sound_Effect(Sound s){
	if(s == NONE) return;
	if(s == currentSoundEffect) return;
	
	currentSoundEffect = s;
	soundEffectCounter = 0;
	TIMER2_TAILR_R = (80000000 / 11025);	// Output at 11.025 KHz for a 80MHz clock
}

// Next beat
void nextBeat(){		
	if(currentDuration == 0){
		// Delay for separation of notes
		//for(int i = 0; i < 250000; i++);
		songPointer += 1;
		if(songPointer == song.songLength) songPointer = 0;
		if(song.frequencies[songPointer] == R) TIMER1_TAILR_R = 0;
		else TIMER1_TAILR_R = (80000000 / (song.frequencies[songPointer] * 32));
		currentDuration = song.durations[songPointer];
	}
	
	currentDuration -= 1;
}

// Output to the DAC
void backgroundOutputDac(){
	
	int amplitude = Flute[amplitudePointer % 32];
	amplitude /= 4;
	amplitude &= 0x0FFF;
	amplitude |= 0x6000;
	amplitude = 0;//Turn off sound while working
	SSI1_Out(amplitude);
	
	amplitudePointer += 1;
}

// ***************** Timer0A_Init ****************
// Activate TIMER0 interrupts to run user task periodically
// Inputs:  task is a pointer to a user function
//          period in units (1/clockfreq), 32 bits
// Outputs: none
void Timer0A_Init(void(*task)(void)){long sr;
  sr = StartCritical();
  SYSCTL_RCGCTIMER_R |= 0x01;   // 0) activate TIMER0
  PeriodicTask0 = task;          // user function
  TIMER0_CTL_R = 0x00000000;    // 1) disable TIMER0A during setup
  TIMER0_CFG_R = 0x00000000;    // 2) configure for 32-bit mode
  TIMER0_TAMR_R = 0x00000002;   // 3) configure for periodic mode, default down-count settings
  TIMER0_TAILR_R = ((80000000 / (BPM / 60)) / 4);    // 4) Each beat is a 16th note
  TIMER0_TAPR_R = 0;            // 5) bus clock resolution
  TIMER0_ICR_R = 0x00000001;    // 6) clear TIMER0A timeout flag
  TIMER0_IMR_R = 0x00000001;    // 7) arm timeout interrupt
  //NVIC_PRI4_R = (NVIC_PRI4_R&0x00FFFFFF)|0x80000000; // 8) priority 4
	NVIC_PRI4_R = (NVIC_PRI4_R&0x00FFFFFF)|0x00000000; // 8) priority 0
// interrupts enabled in the main program after all devices initialized
// vector number 35, interrupt number 19
  NVIC_EN0_R = 1<<19;           // 9) enable IRQ 19 in NVIC
  TIMER0_CTL_R = 0x00000001;    // 10) enable TIMER0A
  EndCritical(sr);
}

void Timer0A_Handler(void){
  TIMER0_ICR_R = TIMER_ICR_TATOCINT;// acknowledge timer0A timeout
  (*PeriodicTask0)();                // execute user task
}

void Timer1_Init(void(*task)(void)){
  SYSCTL_RCGCTIMER_R |= 0x02;   // 0) activate TIMER1
  PeriodicTask1 = task;          // user function
  TIMER1_CTL_R = 0x00000000;    // 1) disable TIMER1A during setup
  TIMER1_CFG_R = 0x00000000;    // 2) configure for 32-bit mode
  TIMER1_TAMR_R = 0x00000002;   // 3) configure for periodic mode, default down-count settings
  TIMER1_TAILR_R = (80000000 / (song.frequencies[song.songPointer] * 32)) - 1;    // 4) Frequency of the first note
  TIMER1_TAPR_R = 0;            // 5) bus clock resolution
  TIMER1_ICR_R = 0x00000001;    // 6) clear TIMER1A timeout flag
  TIMER1_IMR_R = 0x00000001;    // 7) arm timeout interrupt
  //NVIC_PRI5_R = (NVIC_PRI5_R&0xFFFF00FF)|0x00008000; // 8) priority 4
	NVIC_PRI5_R = (NVIC_PRI5_R&0xFFFF00FF)|0x00000000; // 8) priority 0
// interrupts enabled in the main program after all devices initialized
// vector number 37, interrupt number 21
  NVIC_EN0_R = 1<<21;           // 9) enable IRQ 21 in NVIC
  TIMER1_CTL_R = 0x00000001;    // 10) enable TIMER1A
}

void Timer1A_Handler(void){
  TIMER1_ICR_R = TIMER_ICR_TATOCINT;// acknowledge TIMER1A timeout
  (*PeriodicTask1)();                // execute user task
}

// ***************** Timer2_Init ****************
// Activate Timer2 interrupts to run user task periodically
// Inputs:  task is a pointer to a user function
//          period in units (1/clockfreq)
// Outputs: none
void Timer2_Init(void(*task)(void)){
  SYSCTL_RCGCTIMER_R |= 0x04;   // 0) activate timer2
  PeriodicTask2 = task;          // user function
  TIMER2_CTL_R = 0x00000000;    // 1) disable timer2A during setup
  TIMER2_CFG_R = 0x00000000;    // 2) configure for 32-bit mode
  TIMER2_TAMR_R = 0x00000002;   // 3) configure for periodic mode, default down-count settings
  TIMER2_TAILR_R = 0;    // 4) Initially no sound effect
  TIMER2_TAPR_R = 0;            // 5) bus clock resolution
  TIMER2_ICR_R = 0x00000001;    // 6) clear timer2A timeout flag
  TIMER2_IMR_R = 0x00000001;    // 7) arm timeout interrupt
  //NVIC_PRI5_R = (NVIC_PRI5_R&0x00FFFFFF)|0x80000000; // 8) priority 4
	NVIC_PRI5_R = (NVIC_PRI5_R&0x00FFFFFF)|0x00000000; // 8) priority 0
// interrupts enabled in the main program after all devices initialized
// vector number 39, interrupt number 23
  NVIC_EN0_R = 1<<23;           // 9) enable IRQ 23 in NVIC
  TIMER2_CTL_R = 0x00000001;    // 10) enable timer2A
}

void Timer2A_Handler(void){
  TIMER2_ICR_R = TIMER_ICR_TATOCINT;// acknowledge TIMER2A timeout
  (*PeriodicTask2)();                // execute user task
}

// Check if a sound is being played - output the WAV of the sound
void soundEffectTask(){	
	switch(currentSoundEffect){
		case NONE:
			
		break;
		case JUMP:
			// Check if counter reached the end
			if(soundEffectCounter >= 6506){
				currentSoundEffect = NONE;
				soundEffectCounter = 0;
				TIMER2_TAILR_R = 0;
				return;
			}
			// Output and increment counter
			SSI2_Out(jumpSound[soundEffectCounter] / 32);
			soundEffectCounter += 1;
		break;
	}
	
}

// Initialize the SSI module
// SSI 1 and SSI2
void SSI_Init(){
	SYSCTL_RCGCSSI_R |= 0x06;	// Enable SSI 1 and 2
	
	// PORT D INITIALIZATION
	/*SYSCTL_RCGCGPIO_R |= 0x08;	// Enable port D
	while((SYSCTL_RCGCGPIO_R & 0X08) == 0);	// Wait
	GPIO_PORTD_AFSEL_R |= 0x0F;	// Enable AFSEL on PD0-3
	GPIO_PORTD_PCTL_R = (GPIO_PORTD_PCTL_R&0xFFFF0000) + 0x00002222;	// SSI1 for PD0-3
	GPIO_PORTD_DEN_R |= 0x0F;	// Digital I/O for PD0-3
	GPIO_PORTD_DATA_R |= 0x02;	// PD1 FSS is high*/
	
	// PORT B INITIALIZATION
	SYSCTL_RCGCGPIO_R |= 0x02;	// Enable port B
	while((SYSCTL_RCGCGPIO_R & 0x02) == 0);	// Wait
	GPIO_PORTB_AFSEL_R |= 0xF0;	// Enable AFSEL on PB4-7
	GPIO_PORTB_PCTL_R = (GPIO_PORTB_PCTL_R & 0x0000FFFF) + 0x22220000;	// SSI2 for PB4-7
	GPIO_PORTB_DEN_R |= 0xF0;	// Digital I/O for PB4-7
	GPIO_PORTB_DATA_R |= 0x20;	// PB5 FSS is high
	
	// PORT F INITIALIZATION - TEMPORARY FOR DEMO
	SYSCTL_RCGCGPIO_R |= 0x20;	// Enable Port F
	while((SYSCTL_RCGCGPIO_R & 0x20) == 0);	// Wait
	GPIO_PORTF_LOCK_R = 0x4C4F434B;   // 2) unlock GPIO Port F
	GPIO_PORTF_CR_R = 0x1F;           // allow changes to PF4-0
	GPIO_PORTF_AFSEL_R |= 0x0F;	// Enable AFSEL on PF0-3
	GPIO_PORTF_PCTL_R = (GPIO_PORTF_PCTL_R & 0x0000) + 0x2222;	// SSI1 for PF0-3
	GPIO_PORTF_DEN_R |= 0x0F;	// Digital I/O for PF0-3
	GPIO_PORTF_DATA_R |= 0x08;	// PF3 Fss is high
	
	// SSI1 INITIALIZATION
	SSI1_CR1_R &= 0;	// Disable SSI1 and set to master
	SSI1_CPSR_R = 0x06;	// Prescale divisor = 6
	SSI1_CR0_R &= ~0xFFF0;	// Clear everything | SCR = 0, SPH = 0, SPO = 0 Freescale
	SSI1_CR0_R |= 0x0F;	// 16 bit data
	
	// SSI2 INITIALIZATION
	SSI2_CR1_R &= 0;	// Disable SSI2 and set to master
	SSI2_CPSR_R = 0x06;	// Prescale divisor = 6
	SSI2_CR0_R &= ~(0x0000FFF0);    // SCR = 0, SPH = 0, SPO = 0 Freescale
  SSI2_CR0_R |= 0x0F;             // DSS = 16-bit data
	
	SSI2_CR1_R |= 0x02;	// Enable SSI 2
	SSI1_CR1_R |= 0x02;	// Enable SSI 1
}

// Initialize the Song module
void Sound_Init(){
	SSI_Init();
	currentDuration = song.durations[songPointer];
	Timer0A_Init(&nextBeat);
	Timer1_Init(&backgroundOutputDac);
	Timer2_Init(&soundEffectTask);
}
